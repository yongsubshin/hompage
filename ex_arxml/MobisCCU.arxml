[part 6 of 9: package /System/Service/Deployment]
AUTOSAR XML (schema 00049)
package /System/Service/Deployment  (continued)
  114 x someip service interface deployment:  (continued)
    ConnectionContext_Someip: service-interface=ConnectionContext, service-interface-id=6343, service-interface-version={major-version=2, minor-version=1}
      28 x someip field deployment:
        AccessPointName_Field: field=AccessPointName
          get getter: maximum-segment-length-request=0, maximum-segment-length-response=0, method-id=8196, transport-protocol=TCP
          notifier notifier: event-id=8196, maximum-segment-length=0, transport-protocol=TCP
          set setter: maximum-segment-length-request=0, maximum-segment-length-response=0, method-id=12292, transport-protocol=TCP
        AutoConnect_Field: field=AutoConnect
          get getter: maximum-segment-length-request=0, maximum-segment-length-response=0, method-id=8222, transport-protocol=TCP
          notifier notifier: event-id=8222, maximum-segment-length=0, transport-protocol=TCP
          set setter: maximum-segment-length-request=0, maximum-segment-length-response=0, method-id=12318, transport-protocol=TCP
        ContextIndex_Field: field=ContextIndex
          get getter: maximum-segment-length-request=0, maximum-segment-length-response=0, method-id=8221, transport-protocol=TCP
          notifier notifier: event-id=8221, maximum-segment-length=0, transport-protocol=TCP
        ContextPath_Field: field=ContextPath
          get getter: maximum-segment-length-request=0, maximum-segment-length-response=0, method-id=8193, transport-protocol=TCP
          notifier notifier: event-id=8193, maximum-segment-length=0, transport-protocol=TCP
        DeactivateReason_Field: field=DeactivateReason
          get getter: maximum-segment-length-request=0, maximum-segment-length-response=0, method-id=8195, transport-protocol=TCP
          notifier notifier: event-id=8195, maximum-segment-length=0, transport-protocol=TCP
        IPV6_Settings_Address_Field: field=IPV6_Settings_Address
          get getter: maximum-segment-length-request=0, maximum-segment-length-response=0, method-id=8210, transport-protocol=TCP
          notifier notifier: event-id=8210, maximum-segment-length=0, transport-protocol=TCP
        IPV6_Settings_DomainNameServers_Field: field=IPV6_Settings_DomainNameServers
          get getter: maximum-segment-length-request=0, maximum-segment-length-response=0, method-id=8212, transport-protocol=TCP
          notifier notifier: event-id=8212, maximum-segment-length=0, transport-protocol=TCP
        IPV6_Settings_Gateway_Field: field=IPV6_Settings_Gateway
          get getter: maximum-segment-length-request=0, maximum-segment-length-response=0, method-id=8213, transport-protocol=TCP
          notifier notifier: event-id=8213, maximum-segment-length=0, transport-protocol=TCP
        IPV6_Settings_Interface_Field: field=IPV6_Settings_Interface
          get getter: maximum-segment-length-request=0, maximum-segment-length-response=0, method-id=8209, transport-protocol=TCP
          notifier notifier: event-id=8209, maximum-segment-length=0, transport-protocol=TCP
        IPV6_Settings_PrefixLength_Field: field=IPV6_Settings_PrefixLength
          get getter: maximum-segment-length-request=0, maximum-segment-length-response=0, method-id=8211, transport-protocol=TCP
          notifier notifier: event-id=8211, maximum-segment-length=0, transport-protocol=TCP
        IVN_Settings_Address_Field: field=IVN_Settings_Address
          get getter: maximum-segment-length-request=0, maximum-segment-length-response=0, method-id=8218, transport-protocol=TCP
          notifier notifier: event-id=8218, maximum-segment-length=0, transport-protocol=TCP
        IVN_Settings_Interface_Field: field=IVN_Settings_Interface
          get getter: maximum-segment-length-request=0, maximum-segment-length-response=0, method-id=8217, transport-protocol=TCP
          notifier notifier: event-id=8217, maximum-segment-length=0, transport-protocol=TCP
        IVN_Settings_Netmask_Field: field=IVN_Settings_Netmask
          get getter: maximum-segment-length-request=0, maximum-segment-length-response=0, method-id=8220, transport-protocol=TCP
          notifier notifier: event-id=8220, maximum-segment-length=0, transport-protocol=TCP
        IVN_Settings_RemoteAddress_Field: field=IVN_Settings_RemoteAddress
          get getter: maximum-segment-length-request=0, maximum-segment-length-response=0, method-id=8219, transport-protocol=TCP
          notifier notifier: event-id=8219, maximum-segment-length=0, transport-protocol=TCP
        IVN_Settings_VLANID_Field: field=IVN_Settings_VLANID
          get getter: maximum-segment-length-request=0, maximum-segment-length-response=0, method-id=8216, transport-protocol=TCP
          notifier notifier: event-id=8216, maximum-segment-length=0, transport-protocol=TCP
        Name_Field: field=ConnectionContext/Name
          get getter: maximum-segment-length-request=0, maximum-segment-length-response=0, method-id=8201, transport-protocol=TCP
          notifier notifier: event-id=8201, maximum-segment-length=0, transport-protocol=TCP
          set setter: maximum-segment-length-request=0, maximum-segment-length-response=0, method-id=12297, transport-protocol=TCP
        Password_Field: field=Password
          get getter: maximum-segment-length-request=0, maximum-segment-length-response=0, method-id=8199, transport-protocol=TCP
          notifier notifier: event-id=8199, maximum-segment-length=0, transport-protocol=TCP
          set setter: maximum-segment-length-request=0, maximum-segment-length-response=0, method-id=12295, transport-protocol=TCP
        Protocol_Field: field=Protocol
          get getter: maximum-segment-length-request=0, maximum-segment-length-response=0, method-id=8200, transport-protocol=TCP
          notifier notifier: event-id=8200, maximum-segment-length=0, transport-protocol=TCP
          set setter: maximum-segment-length-request=0, maximum-segment-length-response=0, method-id=12296, transport-protocol=TCP
        Settings_Address_Field: field=Settings_Address
          get getter: maximum-segment-length-request=0, maximum-segment-length-response=0, method-id=8204, transport-protocol=TCP
          notifier notifier: event-id=8204, maximum-segment-length=0, transport-protocol=TCP
        Settings_DomainNameServers_Field: field=Settings_DomainNameServers
          get getter: maximum-segment-length-request=0, maximum-segment-length-response=0, method-id=8206, transport-protocol=TCP
          notifier notifier: event-id=8206, maximum-segment-length=0, transport-protocol=TCP
        Settings_Gateway_Field: field=Settings_Gateway
          get getter: maximum-segment-length-request=0, maximum-segment-length-response=0, method-id=8207, transport-protocol=TCP
          notifier notifier: event-id=8207, maximum-segment-length=0, transport-protocol=TCP
        Settings_Interface_Field: field=Settings_Interface
          get getter: maximum-segment-length-request=0, maximum-segment-length-response=0, method-id=8202, transport-protocol=TCP
          notifier notifier: event-id=8202, maximum-segment-length=0, transport-protocol=TCP
        Settings_Method_Field: field=Settings_Method
          get getter: maximum-segment-length-request=0, maximum-segment-length-response=0, method-id=8203, transport-protocol=TCP
          notifier notifier: event-id=8203, maximum-segment-length=0, transport-protocol=TCP
        Settings_Netmask_Field: field=Settings_Netmask
          get getter: maximum-segment-length-request=0, maximum-segment-length-response=0, method-id=8205, transport-protocol=TCP
          notifier notifier: event-id=8205, maximum-segment-length=0, transport-protocol=TCP
        Settings_Proxy_Field: field=Settings_Proxy
          get getter: maximum-segment-length-request=0, maximum-segment-length-response=0, method-id=8208, transport-protocol=TCP
          notifier notifier: event-id=8208, maximum-segment-length=0, transport-protocol=TCP
        Status_Field: field=ConnectionContext/Status
          get getter: maximum-segment-length-request=0, maximum-segment-length-response=0, method-id=8194, transport-protocol=TCP
          notifier notifier: event-id=8194, maximum-segment-length=0, transport-protocol=TCP
        Type_Field: field=Type
          get getter: maximum-segment-length-request=0, maximum-segment-length-response=0, method-id=8197, transport-protocol=TCP
          notifier notifier: event-id=8197, maximum-segment-length=0, transport-protocol=TCP
          set setter: maximum-segment-length-request=0, maximum-segment-length-response=0, method-id=12293, transport-protocol=TCP
        Username_Field: field=Username
          get getter: maximum-segment-length-request=0, maximum-segment-length-response=0, method-id=8198, transport-protocol=TCP
          notifier notifier: event-id=8198, maximum-segment-length=0, transport-protocol=TCP
          set setter: maximum-segment-length-request=0, maximum-segment-length-response=0, method-id=12294, transport-protocol=TCP
      someip method deployment Activate_Method: method=ConnectionContext/Activate, maximum-segment-length-response=0, method-id=4097, transport-protocol=TCP
      someip method deployment Deactivate_Method: method=Deactivate, maximum-segment-length-response=0, method-id=4098, transport-protocol=TCP
      someip method deployment SetContextIndex_Method: method=SetContextIndex, maximum-segment-length-request=0, maximum-segment-length-response=0, method-id=4099, transport-protocol=TCP
      someip event group SomeIpEventGroups: event-group-id=8193, event=[AccessPointName_Field/notifier, AutoConnect_Field/notifier, ContextIndex_Field/notifier, ContextPath_Field/notifier, DeactivateReason_Field/notifier, IPV6_Settings_Address_Field/notifier, IPV6_Settings_DomainNameServers_Field/notifier, IPV6_Settings_Gateway_Field/notifier, IPV6_Settings_Interface_Field/notifier, IPV6_Settings_PrefixLength_Field/notifier, IVN_Settings_Address_Field/notifier, IVN_Settings_Interface_Field/notifier, IVN_Settings_Netmask_Field/notifier, IVN_Settings_RemoteAddress_Field/notifier, IVN_Settings_VLANID_Field/notifier, Name_Field/notifier, Password_Field/notifier, Protocol_Field/notifier, Settings_Address_Field/notifier, Settings_DomainNameServers_Field/notifier, Settings_Gateway_Field/notifier, Settings_Interface_Field/notifier, Settings_Method_Field/notifier, Settings_Netmask_Field/notifier, Settings_Proxy_Field/notifier, Status_Field/notifier, Type_Field/notifier, Username_Field/notifier]
    ConnectionManager_Someip: service-interface=ConnectionManager, service-interface-id=6342, service-interface-version={major-version=2, minor-version=0}
      someip event deployment ContextAdded_Event: event=ContextAdded, event-id=4097, maximum-segment-length=0, transport-protocol=UDP
      someip event deployment ContextRemoved_Event: event=ContextRemoved, event-id=4098, maximum-segment-length=0, transport-protocol=UDP
      5 x someip method deployment, all with maximum-segment-length-response=0, transport-protocol=TCP:
        AddContext_Method: method=AddContext, maximum-segment-length-request=0, method-id=4098
        DeactivateAll_Method: method=DeactivateAll, method-id=4097
        GetContext_Method: method=GetContext, maximum-segment-length-request=0, method-id=4101
        GetContexts_Method: method=GetContexts, method-id=4100
        RemoveContext_Method: method=RemoveContext, maximum-segment-length-request=0, method-id=4099
      someip event group SomeIpEventGroups: event-group-id=4097, event=[ContextAdded_Event, ContextRemoved_Event]
    DataCollection_Someip: service-interface=DataCollection, service-interface-id=3097, service-interface-version={major-version=1, minor-version=0}
      someip event deployment CapturedMessages_Event: event=CapturedMessages, event-id=4097, maximum-segment-length=1, transport-protocol=UDP
      someip method deployment SubscribeToMessages_Method: method=SubscribeToMessages, maximum-segment-length-request=1, maximum-segment-length-response=1, method-id=4097, transport-protocol=UDP
      someip event group NewEventGroup1: event-group-id=1, event=CapturedMessages_Event
    DebugSnapshot_Someip: service-interface=DebugSnapshot, service-interface-id=3133, service-interface-version={major-version=1, minor-version=0}
      someip event deployment IsCompleteDebugSnapshot_Event: event=IsCompleteDebugSnapshot, event-id=4097, maximum-segment-length=0, transport-protocol=UDP
      someip method deployment InsertTag_Method: method=InsertTag, maximum-segment-length-request=0, method-id=4098, transport-protocol=UDP
      someip method deployment StartDebugSnapshot_Method: method=StartDebugSnapshot, maximum-segment-length-request=0, method-id=4097, transport-protocol=UDP
      someip event group NewEventGroup: event-group-id=1, event=IsCompleteDebugSnapshot_Event
    DeltaUpdate_Someip: service-interface=DeltaUpdate, service-interface-id=3091, service-interface-version={major-version=1, minor-version=0}
      someip field deployment CurrentSelfUpdateStatus_Field: field=CurrentSelfUpdateStatus
        get getter: maximum-segment-length-request=0, maximum-segment-length-response=0, method-id=8193, transport-protocol=UDP
        notifier notifier: event-id=8193, maximum-segment-length=0, transport-protocol=UDP
      someip field deployment ProcessProgress_Field: field=ProcessProgress
        get getter: maximum-segment-length-request=0, maximum-segment-length-response=0, method-id=8194, transport-protocol=UDP
        notifier notifier: event-id=8194, maximum-segment-length=0, transport-protocol=UDP
      10 x someip method deployment, all with transport-protocol=UDP:
        ActivatingUpdate_Method: method=ActivatingUpdate, maximum-segment-length-response=0, method-id=4100
        ExecuteFwDeltaUpdate_Method: method=ExecuteFwDeltaUpdate, maximum-segment-length-request=0, maximum-segment-length-response=0, method-id=4098
        FinishUpdate_Method: method=DeltaUpdate/FinishUpdate, maximum-segment-length-response=0, method-id=4102
        GetVersion_Method: method=DeltaUpdate/GetVersion, maximum-segment-length-response=0, method-id=4105
        InitUpdate_Method: method=DeltaUpdate/InitUpdate, maximum-segment-length-response=0, method-id=4104
        RevertUpdate_Method: method=RevertUpdate, maximum-segment-length-response=0, method-id=4099
        RollingbackUpdate_Method: method=RollingbackUpdate, maximum-segment-length-response=0, method-id=4101
        SelfUpdateDowngradeCheck_Method: method=SelfUpdateDowngradeCheck, maximum-segment-length-response=0, method-id=4106
        StartSelfUpdate_Method: method=StartSelfUpdate, maximum-segment-length-request=0, maximum-segment-length-response=0, method-id=4097
        StopSelfUpdate_Method: method=StopSelfUpdate, maximum-segment-length-request=0, method-id=4103
      someip event group NewEventGroup: event-group-id=1, event=CurrentSelfUpdateStatus_Field/notifier
      someip event group NewEventGroup1: event-group-id=2, event=ProcessProgress_Field/notifier
    DiagnosticRouting_Someip: service-interface=DiagnosticRouting, service-interface-id=7428, service-interface-version={major-version=2, minor-version=2}
      someip event deployment DiagnosisStateChanged_Event: event=DiagnosisStateChanged, event-id=4097, maximum-segment-length=0, transport-protocol=TCP
      someip event deployment HigherPriorityDiagnosisServiceStarted_Event: event=HigherPriorityDiagnosisServiceStarted, event-id=4098, maximum-segment-length=0, transport-protocol=TCP
      someip field deployment DiagnosisQueue_Field: field=DiagnosisQueue
        get getter: maximum-segment-length-request=0, maximum-segment-length-response=0, method-id=8194, transport-protocol=TCP
        notifier notifier: event-id=8194, maximum-segment-length=0, transport-protocol=TCP
      someip field deployment DiagnosisService_Field: field=DiagnosisService
        get getter: maximum-segment-length-request=0, maximum-segment-length-response=0, method-id=8195, transport-protocol=TCP
        notifier notifier: event-id=8195, maximum-segment-length=0, transport-protocol=TCP
      someip field deployment Status_Field: field=DiagnosticRouting/Status
        get getter: maximum-segment-length-request=0, maximum-segment-length-response=0, method-id=8193, transport-protocol=TCP
        notifier notifier: event-id=8193, maximum-segment-length=0, transport-protocol=TCP
      5 x someip method deployment, all with maximum-segment-length-request=0, transport-protocol=TCP:
        GetDiagnosisService_Method: method=GetDiagnosisService, maximum-segment-length-response=0, method-id=4098
        GetDiagnosisTarget_Method: method=GetDiagnosisTarget, maximum-segment-length-response=0, method-id=4100
        ReleaseDiagnosisService_Method: method=ReleaseDiagnosisService, method-id=4099
        ReleaseDiagnosisTarget_Method: method=ReleaseDiagnosisTarget, method-id=4101
        RequestDiagnosis_Method: method=RequestDiagnosis, maximum-segment-length-response=0, method-id=4097
      someip event group SomeIpEventGroups: event-group-id=4097, event=[DiagnosisQueue_Field/notifier, DiagnosisService_Field/notifier, DiagnosisStateChanged_Event, HigherPriorityDiagnosisServiceStarted_Event, Status_Field/notifier]
    DiagnosticService_Someip: service-interface=DiagnosticService, service-interface-id=7427, service-interface-version={major-version=2, minor-version=0}
      someip method deployment GetVIN_Method: method=GetVIN, maximum-segment-length-response=0, method-id=4098, transport-protocol=TCP
    DynamicRouting_Someip: service-interface=DynamicRouting, service-interface-id=3098, service-interface-version={major-version=1, minor-version=0}
      someip method deployment GetPDUlist_Method: method=GetPDUlist, maximum-segment-length-request=1, maximum-segment-length-response=1, method-id=4097, transport-protocol=UDP
    EIDSDiagInfo_Someip: service-interface=EIDSDiagInfo, service-interface-id=3125, service-interface-version={major-version=1, minor-version=0}
      someip method deployment GetAppInfo_Method: method=EIDSDiagInfo/GetAppInfo, maximum-segment-length-response=0, method-id=4098, transport-protocol=UDP
      someip method deployment GetAppState_Method: method=EIDSDiagInfo/GetAppState, maximum-segment-length-response=0, method-id=4097, transport-protocol=UDP
    EIDSInfo_Someip: service-interface=EIDSInfo, service-interface-id=3081, service-interface-version={major-version=1, minor-version=0}
      someip field deployment EidsAppInfo_Field: field=EidsAppInfo
        get getter: maximum-segment-length-request=0, maximum-segment-length-response=0, method-id=8193, transport-protocol=UDP
        notifier notifier: event-id=8193, maximum-segment-length=0, transport-protocol=UDP
      someip field deployment EidsAppState_Field: field=EidsAppState
        get getter: maximum-segment-length-request=0, maximum-segment-length-response=0, method-id=8194, transport-protocol=UDP
        notifier notifier: event-id=8194, maximum-segment-length=0, transport-protocol=UDP
      someip method deployment GetEidsStatistics_Method: method=GetEidsStatistics, maximum-segment-length-response=0, method-id=4097, transport-protocol=UDP
      someip method deployment GetVersionInfo_Method: method=EIDSInfo/GetVersionInfo, maximum-segment-length-response=0, method-id=4098, transport-protocol=UDP
      someip event group NewEventGroup: event-group-id=1, event=EidsAppInfo_Field/notifier
      someip event group NewEventGroup1: event-group-id=2, event=EidsAppState_Field/notifier
    EcDec_Someip: service-interface=EcDec, service-interface-id=3137, service-interface-version={major-version=1, minor-version=3}
      19 x someip method deployment, all with maximum-segment-length-request=0, maximum-segment-length-response=0, transport-protocol=UDP:
        CrypCMAC_Buf_Method: method=CrypCMAC_Buf, method-id=4106
        CrypDelete_Data_Method: method=CrypDelete_Data, method-id=4109
        CrypDelete_aes_key_from_hse_Method: method=CrypDelete_aes_key_from_hse, method-id=4116
        CrypDelete_aes_key_from_ss_Method: method=CrypDelete_aes_key_from_ss, method-id=4114
        CrypEcDec_Buf_Method: method=CrypEcDec_Buf, method-id=4099
        CrypEcDec_File_Method: method=CrypEcDec_File, method-id=4100
        CrypGet_Data_Method: method=CrypGet_Data, method-id=4117
        CrypGet_PBKDF2_Method: method=CrypGet_PBKDF2, method-id=4111
        CrypGet_RandomNumber_Method: method=CrypGet_RandomNumber, method-id=4110
        CrypImport_aes_key_from_ss_to_hse_Method: method=CrypImport_aes_key_from_ss_to_hse, method-id=4115
        CrypKeyDelete_Method: method=CrypKeyDelete, method-id=4105
        CrypKeyImport_Method: method=CrypKeyImport, method-id=4104
        CrypLoad_Data_Method: method=CrypLoad_Data, method-id=4108
        CrypSave_Data_Method: method=CrypSave_Data, method-id=4107
        CrypShaDigest_Method: method=CrypShaDigest, method-id=4101
        CrypVerify_Buf_Method: method=CrypVerify_Buf, method-id=4102
        CrypVerify_CMAC_Method: method=CrypVerify_CMAC, method-id=4112
        CrypVerify_File_Method: method=CrypVerify_File, method-id=4103
        CrypVerify_Sign_Method: method=CrypVerify_Sign, method-id=4113
    EngineeringMode_Someip: service-interface=Service/EngineeringMode, service-interface-id=6344, service-interface-version={major-version=2, minor-version=1}
      someip method deployment GetProperty_Method: method=EngineeringMode/GetProperty, maximum-segment-length-request=0, maximum-segment-length-response=0, method-id=4097, transport-protocol=TCP
      someip method deployment SetProperty_Method: method=EngineeringMode/SetProperty, maximum-segment-length-request=0, maximum-segment-length-response=0, method-id=4098, transport-protocol=TCP
    EngineeringMode_Someip: service-interface=Service/EngineeringMode, service-interface-id=5249, service-interface-version={major-version=2, minor-version=0}
      someip field deployment ActionLists_Field: field=ActionLists
        get getter: maximum-segment-length-request=0, maximum-segment-length-response=0, method-id=8193, transport-protocol=TCP
        notifier notifier: event-id=8193, maximum-segment-length=0, transport-protocol=TCP
      someip method deployment StartLogTransfer_Method: method=StartLogTransfer, maximum-segment-length-request=0, maximum-segment-length-response=0, method-id=4097, transport-protocol=TCP
      someip method deployment StopLogTransfer_Method: method=StopLogTransfer, maximum-segment-length-request=0, maximum-segment-length-response=0, method-id=4099, transport-protocol=TCP
      someip method deployment TransferLogFile_Method: method=TransferLogFile, maximum-segment-length-request=0, maximum-segment-length-response=0, method-id=4098, transport-protocol=TCP
      someip event group SomeIpEventGroups: event-group-id=1, event=ActionLists_Field/notifier
    EngineeringMode_Someip: service-interface=Service/EngineeringMode, service-interface-id=7299, service-interface-version={major-version=1, minor-version=0}
      someip method deployment GetProperty_Method: method=EngineeringMode/GetProperty, maximum-segment-length-request=0, maximum-segment-length-response=0, method-id=4097, transport-protocol=UDP
      someip method deployment SetProperty_Method: method=EngineeringMode/SetProperty, maximum-segment-length-request=0, maximum-segment-length-response=0, method-id=4098, transport-protocol=UDP
    EngineeringMode_Someip: service-interface=Service/EngineeringMode, service-interface-id=5441, service-interface-version={major-version=2, minor-version=2}
      4 x someip field deployment:
        EnvironmentsAddress_Field: field=EngineeringMode/EnvironmentsAddress
          get getter: maximum-segment-length-request=0, maximum-segment-length-response=0, method-id=8195, transport-protocol=TCP
          notifier notifier: event-id=8195, maximum-segment-length=0, transport-protocol=TCP
        Environments_Field: field=EngineeringMode/Environments
          get getter: maximum-segment-length-request=0, maximum-segment-length-response=0, method-id=8194, transport-protocol=TCP
          notifier notifier: event-id=8194, maximum-segment-length=0, transport-protocol=TCP
        TestIdentifiers_Field: field=TestIdentifiers
          get getter: maximum-segment-length-request=0, maximum-segment-length-response=0, method-id=8196, transport-protocol=TCP
          notifier notifier: event-id=8196, maximum-segment-length=0, transport-protocol=TCP
        TimeStamp_Field: field=EngineeringMode/TimeStamp
          get getter: maximum-segment-length-request=0, maximum-segment-length-response=0, method-id=8193, transport-protocol=TCP
          notifier notifier: event-id=8193, maximum-segment-length=0, transport-protocol=TCP
      13 x someip method deployment, all with transport-protocol=TCP:
        GetProvisioningStatus_Method: method=GetProvisioningStatus, maximum-segment-length-response=0, method-id=4099
        GetTestICCID_Method: method=GetTestICCID, maximum-segment-length-response=0, method-id=4105
        GetTestIMSI_Method: method=GetTestIMSI, maximum-segment-length-response=0, method-id=4107
        GetTestMDN_Method: method=GetTestMDN, maximum-segment-length-response=0, method-id=4101
        GetTestMSISDN_Method: method=GetTestMSISDN, maximum-segment-length-response=0, method-id=4109
        GetTestVIN_Method: method=GetTestVIN, maximum-segment-length-response=0, method-id=4103
        ResetProvisioningStatus_Method: method=ResetProvisioningStatus, maximum-segment-length-response=0, method-id=4098
        SetProvisioningStatus_Method: method=SetProvisioningStatus, maximum-segment-length-request=0, method-id=4097
        SetTestICCID_Method: method=SetTestICCID, maximum-segment-length-request=0, method-id=4104
        SetTestIMSI_Method: method=SetTestIMSI, maximum-segment-length-request=0, method-id=4106
        SetTestMDN_Method: method=SetTestMDN, maximum-segment-length-request=0, method-id=4100
        SetTestMSISDN_Method: method=SetTestMSISDN, maximum-segment-length-request=0, method-id=4108
        SetTestVIN_Method: method=SetTestVIN, maximum-segment-length-request=0, method-id=4102
      someip event group SomeIpEventGroups: event-group-id=4097, event=[EnvironmentsAddress_Field/notifier, Environments_Field/notifier, TimeStamp_Field/notifier]
      someip event group SomeIpEventGroups2: event-group-id=1, event=TestIdentifiers_Field/notifier
    EthernetSwitchMgr_Someip: service-interface=EthernetSwitchMgr, service-interface-id=3083, service-interface-version={major-version=1, minor-version=1}
      someip field deployment EmtLinkUp_Field: field=EmtLinkUp
        get getter: maximum-segment-length-request=0, maximum-segment-length-response=0, method-id=8193, transport-protocol=UDP
        notifier notifier: event-id=8193, maximum-segment-length=0, transport-protocol=UDP
      31 x someip method deployment, all with transport-protocol=UDP:
        DownloadImage_Method: method=DownloadImage, maximum-segment-length-request=0, maximum-segment-length-response=0, method-id=4097
        EnableERTLogging_Method: method=EnableERTLogging, maximum-segment-length-request=0, method-id=4137
        FinishImage_Method: method=FinishImage, maximum-segment-length-response=0, method-id=4126
        GetConfigurationVersion_Method: method=GetConfigurationVersion, maximum-segment-length-response=0, method-id=4098
        GetLinkStatus_Method: method=GetLinkStatus, maximum-segment-length-request=0, maximum-segment-length-response=0, method-id=4100
        GetOtpStatus_Method: method=GetOtpStatus, maximum-segment-length-response=0, method-id=4134
        GetPartitionVersion_Method: method=GetPartitionVersion, maximum-segment-length-request=0, maximum-segment-length-response=0, method-id=4130
        GetSQI_Method: method=GetSQI, maximum-segment-length-request=0, maximum-segment-length-response=0, method-id=4104
        GetSwitchException_Method: method=GetSwitchException, maximum-segment-length-response=0, method-id=4105
        GetSwitchIVD_Method: method=GetSwitchIVD, maximum-segment-length-response=0, method-id=4128
        GetSwitchRecoveryCount_Method: method=GetSwitchRecoveryCount, maximum-segment-length-response=0, method-id=4129
        GetSwitchStats_Method: method=GetSwitchStats, maximum-segment-length-request=0, maximum-segment-length-response=0, method-id=4106
        GetSwitchStatus_Method: method=GetSwitchStatus, maximum-segment-length-response=0, method-id=4107
        GetSwitchTemp_Method: method=GetSwitchTemp, maximum-segment-length-response=0, method-id=4133
        GetWireStatus_Method: method=GetWireStatus, maximum-segment-length-request=0, maximum-segment-length-response=0, method-id=4108
        GetWorstSQI_Method: method=GetWorstSQI, maximum-segment-length-request=0, maximum-segment-length-response=0, method-id=4109
        InitializeUpdate_Method: method=InitializeUpdate, maximum-segment-length-response=0, method-id=4127
        RequestSleep_Method: method=RequestSleep, maximum-segment-length-response=0, method-id=4132
        RequestWakeup_Method: method=RequestWakeup, maximum-segment-length-response=0, method-id=4131
        RevertImage_Method: method=RevertImage, maximum-segment-length-response=0, method-id=4124
        RollbackImage_Method: method=RollbackImage, maximum-segment-length-response=0, method-id=4125
        SleepRemotePhys_Method: method=SleepRemotePhys, maximum-segment-length-request=0, maximum-segment-length-response=0, method-id=4101
        StartETHMirroring_Method: method=StartETHMirroring, maximum-segment-length-request=0, method-id=4135
        StartIDSMirroring_Method: method=StartIDSMirroring, maximum-segment-length-response=0, method-id=4118
        StartVCRMMirroring_Method: method=StartVCRMMirroring, maximum-segment-length-response=0, method-id=4119
        StopETHMirroring_Method: method=StopETHMirroring, maximum-segment-length-request=0, method-id=4136
        StopIDSMirroring_Method: method=StopIDSMirroring, maximum-segment-length-response=0, method-id=4120
        StopVCRMMirroring_Method: method=StopVCRMMirroring, maximum-segment-length-response=0, method-id=4121
        UpdateImage_Method: method=UpdateImage, maximum-segment-length-response=0, method-id=4099
        UpdatePhys_Method: method=UpdatePhys, maximum-segment-length-request=0, maximum-segment-length-response=0, method-id=4102
        WakeupRemotePhys_Method: method=WakeupRemotePhys, maximum-segment-length-request=0, maximum-segment-length-response=0, method-id=4103
      someip event group NewEventGroup: event-group-id=1, event=EmtLinkUp_Field/notifier
    Extended_Someip: service-interface=Extended, service-interface-id=3099, service-interface-version={major-version=1, minor-version=4}
      14 x someip event deployment, all with maximum-segment-length=0, transport-protocol=UDP:
        FR_CMR_FRSD_01_00ms_Event: event=FR_CMR_FRSD_01_00ms, event-id=4105
        FR_CMR_FRSD_02_00ms_Event: event=FR_CMR_FRSD_02_00ms, event-id=4106
        FR_CMR_FRSD_03_00ms_Event: event=FR_CMR_FRSD_03_00ms, event-id=4107
        FR_CMR_FRSD_04_00ms_Event: event=FR_CMR_FRSD_04_00ms, event-id=4108
        FR_CMR_FRSD_05_00ms_Event: event=FR_CMR_FRSD_05_00ms, event-id=4109
        FR_CMR_RSD_01_00ms_Event: event=FR_CMR_RSD_01_00ms, event-id=4097
        FR_CMR_RSD_02_00ms_Event: event=FR_CMR_RSD_02_00ms, event-id=4098
        FR_CMR_RSD_03_00ms_Event: event=FR_CMR_RSD_03_00ms, event-id=4099
        FR_CMR_RSD_04_00ms_Event: event=FR_CMR_RSD_04_00ms, event-id=4100
        FR_CMR_RSD_05_00ms_Event: event=FR_CMR_RSD_05_00ms, event-id=4101
        FR_CMR_RSD_06_00ms_Event: event=FR_CMR_RSD_06_00ms, event-id=4102
        FR_CMR_RSD_07_00ms_Event: event=FR_CMR_RSD_07_00ms, event-id=4103
        FR_CMR_RSD_08_00ms_Event: event=FR_CMR_RSD_08_00ms, event-id=4104
        IMU_01_10ms_Event: event=IMU_01_10ms, event-id=4110
      191 x someip field deployment:
        AcnECompCnsmptPwrVal_Field: field=AcnECompCnsmptPwrVal
          get getter: maximum-segment-length-request=0, maximum-segment-length-response=0, method-id=8300, transport-protocol=UDP
          notifier notifier: event-id=8300, maximum-segment-length=0, transport-protocol=UDP
        AirCleaningOptionInfo_Field: field=AirCleaningOptionInfo
          get getter: maximum-segment-length-request=0, maximum-segment-length-response=0, method-id=8193, transport-protocol=UDP
          notifier notifier: event-id=8193, maximum-segment-length=0, transport-protocol=UDP
        AirCleaningState_Field: field=AirCleaningState
          get getter: maximum-segment-length-request=0, maximum-segment-length-response=0, method-id=8194, transport-protocol=UDP
          notifier notifier: event-id=8194, maximum-segment-length=0, transport-protocol=UDP
        AirCleaningStepColor_Field: field=AirCleaningStepColor
          get getter: maximum-segment-length-request=0, maximum-segment-length-response=0, method-id=8195, transport-protocol=UDP
          notifier notifier: event-id=8195, maximum-segment-length=0, transport-protocol=UDP
        AirConditioningOperationState_Field: field=AirConditioningOperationState
          get getter: maximum-segment-length-request=0, maximum-segment-length-response=0, method-id=8196, transport-protocol=UDP
          notifier notifier: event-id=8196, maximum-segment-length=0, transport-protocol=UDP
        AirbagCrashActiveState_Field: field=AirbagCrashActiveState
          get getter: maximum-segment-length-request=0, maximum-segment-length-response=0, method-id=8223, transport-protocol=UDP
          notifier notifier: event-id=8223, maximum-segment-length=0, transport-protocol=UDP
        AirconElectricCompressorFaultState_Field: field=AirconElectricCompressorFaultState
          get getter: maximum-segment-length-request=0, maximum-segment-length-response=0, method-id=8197, transport-protocol=UDP
          notifier notifier: event-id=8197, maximum-segment-length=0, transport-protocol=UDP
        BattCompPwrCnsmptn_Field: field=BattCompPwrCnsmptn
          get getter: maximum-segment-length-request=0, maximum-segment-length-response=0, method-id=8301, transport-protocol=UDP
          notifier notifier: event-id=8301, maximum-segment-length=0, transport-protocol=UDP
        DATCIntakeSta_Field: field=DATCIntakeSta
          get getter: maximum-segment-length-request=0, maximum-segment-length-response=0, method-id=8332, transport-protocol=UDP
          notifier notifier: event-id=8332, maximum-segment-length=0, transport-protocol=UDP
        DATCOptSys_Field: field=DATCOptSys
          get getter: maximum-segment-length-request=0, maximum-segment-length-response=0, method-id=8302, transport-protocol=UDP
          notifier notifier: event-id=8302, maximum-segment-length=0, transport-protocol=UDP
        DATCTypAll_Field: field=DATCTypAll
          get getter: maximum-segment-length-request=0, maximum-segment-length-response=0, method-id=8308, transport-protocol=UDP
          notifier notifier: event-id=8308, maximum-segment-length=0, transport-protocol=UDP
        DATC_3rdAutoDis_Field: field=DATC_3rdAutoDis
          get getter: maximum-segment-length-request=0, maximum-segment-length-response=0, method-id=8394, transport-protocol=UDP
          notifier notifier: event-id=8394, maximum-segment-length=0, transport-protocol=UDP
        DATC_3rdRowBlowerDisplay_Field: field=DATC_3rdRowBlowerDisplay
          get getter: maximum-segment-length-request=0, maximum-segment-length-response=0, method-id=8217, transport-protocol=UDP
          notifier notifier: event-id=8217, maximum-segment-length=0, transport-protocol=UDP
        DATC_3rdSysOnOffDis_Field: field=DATC_3rdSysOnOffDis
          get getter: maximum-segment-length-request=0, maximum-segment-length-response=0, method-id=8401, transport-protocol=UDP
          notifier notifier: event-id=8401, maximum-segment-length=0, transport-protocol=UDP
        DATC_AUTOStep3rd_Field: field=DATC_AUTOStep3rd
          get getter: maximum-segment-length-request=0, maximum-segment-length-response=0, method-id=8389, transport-protocol=UDP
          notifier notifier: event-id=8389, maximum-segment-length=0, transport-protocol=UDP
        DATC_AUTOStepPS_Field: field=DATC_AUTOStepPS
          get getter: maximum-segment-length-request=0, maximum-segment-length-response=0, method-id=8386, transport-protocol=UDP
          notifier notifier: event-id=8386, maximum-segment-length=0, transport-protocol=UDP
        DATC_AUTOStepRRPass_Field: field=DATC_AUTOStepRRPass
          get getter: maximum-segment-length-request=0, maximum-segment-length-response=0, method-id=8388, transport-protocol=UDP
          notifier notifier: event-id=8388, maximum-segment-length=0, transport-protocol=UDP
        DATC_AUTOStepRR_Field: field=DATC_AUTOStepRR
          get getter: maximum-segment-length-request=0, maximum-segment-length-response=0, method-id=8387, transport-protocol=UDP
          notifier notifier: event-id=8387, maximum-segment-length=0, transport-protocol=UDP
        DATC_AUTOStep_Field: field=DATC_AUTOStep
          get getter: maximum-segment-length-request=0, maximum-segment-length-response=0, method-id=8385, transport-protocol=UDP
          notifier notifier: event-id=8385, maximum-segment-length=0, transport-protocol=UDP
        DATC_BlwrLvl_Field: field=DATC_BlwrLvl
          get getter: maximum-segment-length-request=0, maximum-segment-length-response=0, method-id=8334, transport-protocol=UDP
          notifier notifier: event-id=8334, maximum-segment-length=0, transport-protocol=UDP
        DATC_DriverOnly_Field: field=DATC_DriverOnly
          get getter: maximum-segment-length-request=0, maximum-segment-length-response=0, method-id=8218, transport-protocol=UDP
          notifier notifier: event-id=8218, maximum-segment-length=0, transport-protocol=UDP
        DATC_DrvAutoDis_Field: field=DATC_DrvAutoDis
          get getter: maximum-segment-length-request=0, maximum-segment-length-response=0, method-id=8390, transport-protocol=UDP
          notifier notifier: event-id=8390, maximum-segment-length=0, transport-protocol=UDP
        DATC_FrSysOnOffDis_Field: field=DATC_FrSysOnOffDis
          get getter: maximum-segment-length-request=0, maximum-segment-length-response=0, method-id=8399, transport-protocol=UDP
          notifier notifier: event-id=8399, maximum-segment-length=0, transport-protocol=UDP
        DATC_FragStrhDis_Field: field=DATC_FragStrhDis
          get getter: maximum-segment-length-request=0, maximum-segment-length-response=0, method-id=8333, transport-protocol=UDP
          notifier notifier: event-id=8333, maximum-segment-length=0, transport-protocol=UDP
        DATC_FrtAstEVntModeSet_Disp_Field: field=DATC_FrtAstEVntModeSet_Disp
          get getter: maximum-segment-length-request=0, maximum-segment-length-response=0, method-id=8396, transport-protocol=UDP
          notifier notifier: event-id=8396, maximum-segment-length=0, transport-protocol=UDP
        DATC_FrtDrvEVntModeSet_Disp_Field: field=DATC_FrtDrvEVntModeSet_Disp
          get getter: maximum-segment-length-request=0, maximum-segment-length-response=0, method-id=8395, transport-protocol=UDP
          notifier notifier: event-id=8395, maximum-segment-length=0, transport-protocol=UDP
        DATC_PsAutoDis_Field: field=DATC_PsAutoDis
          get getter: maximum-segment-length-request=0, maximum-segment-length-response=0, method-id=8391, transport-protocol=UDP
          notifier notifier: event-id=8391, maximum-segment-length=0, transport-protocol=UDP
        DATC_RrAstEVntModeSet_Disp_Field: field=DATC_RrAstEVntModeSet_Disp
          get getter: maximum-segment-length-request=0, maximum-segment-length-response=0, method-id=8398, transport-protocol=UDP
          notifier notifier: event-id=8398, maximum-segment-length=0, transport-protocol=UDP
        DATC_RrAutoDis_Field: field=DATC_RrAutoDis
          get getter: maximum-segment-length-request=0, maximum-segment-length-response=0, method-id=8392, transport-protocol=UDP
          notifier notifier: event-id=8392, maximum-segment-length=0, transport-protocol=UDP
        DATC_RrBlowerDisplay_Field: field=DATC_RrBlowerDisplay
          get getter: maximum-segment-length-request=0, maximum-segment-length-response=0, method-id=8219, transport-protocol=UDP
          notifier notifier: event-id=8219, maximum-segment-length=0, transport-protocol=UDP
        DATC_RrDrvEVntModeSet_Disp_Field: field=DATC_RrDrvEVntModeSet_Disp
          get getter: maximum-segment-length-request=0, maximum-segment-length-response=0, method-id=8397, transport-protocol=UDP
          notifier notifier: event-id=8397, maximum-segment-length=0, transport-protocol=UDP
        DATC_RrPassAutoDis_Field: field=DATC_RrPassAutoDis
          get getter: maximum-segment-length-request=0, maximum-segment-length-response=0, method-id=8393, transport-protocol=UDP
          notifier notifier: event-id=8393, maximum-segment-length=0, transport-protocol=UDP
        DATC_RrSysOnOffDis_Field: field=DATC_RrSysOnOffDis
          get getter: maximum-segment-length-request=0, maximum-segment-length-response=0, method-id=8400, transport-protocol=UDP
          notifier notifier: event-id=8400, maximum-segment-length=0, transport-protocol=UDP
        DATC_SyncDisplay_Field: field=DATC_SyncDisplay
          get getter: maximum-segment-length-request=0, maximum-segment-length-response=0, method-id=8220, transport-protocol=UDP
          notifier notifier: event-id=8220, maximum-segment-length=0, transport-protocol=UDP
        DATC_Typ_All_2_Field: field=DATC_Typ_All_2
          get getter: maximum-segment-length-request=0, maximum-segment-length-response=0, method-id=8402, transport-protocol=UDP
          notifier notifier: event-id=8402, maximum-segment-length=0, transport-protocol=UDP
        DATC_Typ_All_3_Field: field=DATC_Typ_All_3
          get getter: maximum-segment-length-request=0, maximum-segment-length-response=0, method-id=8403, transport-protocol=UDP
          notifier notifier: event-id=8403, maximum-segment-length=0, transport-protocol=UDP
        DATC_Typ_All_4_Field: field=DATC_Typ_All_4
          get getter: maximum-segment-length-request=0, maximum-segment-length-response=0, method-id=8335, transport-protocol=UDP
          notifier notifier: event-id=8335, maximum-segment-length=0, transport-protocol=UDP
        DATC_Typ_All_5_Field: field=DATC_Typ_All_5
          get getter: maximum-segment-length-request=0, maximum-segment-length-response=0, method-id=8336, transport-protocol=UDP
          notifier notifier: event-id=8336, maximum-segment-length=0, transport-protocol=UDP
        DriverBlowState_Field: field=DriverBlowState
          get getter: maximum-segment-length-request=0, maximum-segment-length-response=0, method-id=8198, transport-protocol=UDP
          notifier notifier: event-id=8198, maximum-segment-length=0, transport-protocol=UDP
        DriverTemperature_C_Field: field=DriverTemperature_C
          get getter: maximum-segment-length-request=0, maximum-segment-length-response=0, method-id=8199, transport-protocol=UDP
          notifier notifier: event-id=8199, maximum-segment-length=0, transport-protocol=UDP
        DriverTemperature_F_Field: field=DriverTemperature_F
          get getter: maximum-segment-length-request=0, maximum-segment-length-response=0, method-id=8200, transport-protocol=UDP
          notifier notifier: event-id=8200, maximum-segment-length=0, transport-protocol=UDP
        DrivingModeState_Field: field=Extended/DrivingModeState
          get getter: maximum-segment-length-request=0, maximum-segment-length-response=0, method-id=8201, transport-protocol=UDP
          notifier notifier: event-id=8201, maximum-segment-length=0, transport-protocol=UDP
        Drv3rdTempCDis_Field: field=Drv3rdTempCDis
          get getter: maximum-segment-length-request=0, maximum-segment-length-response=0, method-id=8314, transport-protocol=UDP
          notifier notifier: event-id=8314, maximum-segment-length=0, transport-protocol=UDP
        Drv3rdTempFDis_Field: field=Drv3rdTempFDis
          get getter: maximum-segment-length-request=0, maximum-segment-length-response=0, method-id=8318, transport-protocol=UDP
          notifier notifier: event-id=8318, maximum-segment-length=0, transport-protocol=UDP
        FRSD_Buffer_Field: field=FRSD_Buffer
          get getter: maximum-segment-length-request=0, maximum-segment-length-response=0, method-id=8232, transport-protocol=UDP
          notifier notifier: event-id=8232, maximum-segment-length=0, transport-protocol=UDP
        FRSD_CRC16_Field: field=FRSD_CRC16
          get getter: maximum-segment-length-request=0, maximum-segment-length-response=0, method-id=8233, transport-protocol=UDP
          notifier notifier: event-id=8233, maximum-segment-length=0, transport-protocol=UDP
        FRSD_MSGID_Field: field=FRSD_MSGID
          get getter: maximum-segment-length-request=0, maximum-segment-length-response=0, method-id=8230, transport-protocol=UDP
          notifier notifier: event-id=8230, maximum-segment-length=0, transport-protocol=UDP
        FRSD_MSGType_Field: field=FRSD_MSGType
          get getter: maximum-segment-length-request=0, maximum-segment-length-response=0, method-id=8234, transport-protocol=UDP
          notifier notifier: event-id=8234, maximum-segment-length=0, transport-protocol=UDP
        FRSD_PayloadSeg1_1_Field: field=FRSD_PayloadSeg1_1
          get getter: maximum-segment-length-request=0, maximum-segment-length-response=0, method-id=8236, transport-protocol=UDP
          notifier notifier: event-id=8236, maximum-segment-length=0, transport-protocol=UDP
        FRSD_PayloadSeg1_2_Field: field=FRSD_PayloadSeg1_2
          get getter: maximum-segment-length-request=0, maximum-segment-length-response=0, method-id=8237, transport-protocol=UDP
          notifier notifier: event-id=8237, maximum-segment-length=0, transport-protocol=UDP
        FRSD_PayloadSeg1_3_Field: field=FRSD_PayloadSeg1_3
          get getter: maximum-segment-length-request=0, maximum-segment-length-response=0, method-id=8238, transport-protocol=UDP
          notifier notifier: event-id=8238, maximum-segment-length=0, transport-protocol=UDP
        FRSD_PayloadSeg1_4_Field: field=FRSD_PayloadSeg1_4
          get getter: maximum-segment-length-request=0, maximum-segment-length-response=0, method-id=8239, transport-protocol=UDP
          notifier notifier: event-id=8239, maximum-segment-length=0, transport-protocol=UDP
        FRSD_PayloadSeg2_1_Field: field=FRSD_PayloadSeg2_1
          get getter: maximum-segment-length-request=0, maximum-segment-length-response=0, method-id=8240, transport-protocol=UDP
          notifier notifier: event-id=8240, maximum-segment-length=0, transport-protocol=UDP
        FRSD_PayloadSeg2_2_Field: field=FRSD_PayloadSeg2_2
          get getter: maximum-segment-length-request=0, maximum-segment-length-response=0, method-id=8241, transport-protocol=UDP
          notifier notifier: event-id=8241, maximum-segment-length=0, transport-protocol=UDP
        FRSD_PayloadSeg2_3_Field: field=FRSD_PayloadSeg2_3
          get getter: maximum-segment-length-request=0, maximum-segment-length-response=0, method-id=8242, transport-protocol=UDP
          notifier notifier: event-id=8242, maximum-segment-length=0, transport-protocol=UDP
        FRSD_PayloadSeg2_4_Field: field=FRSD_PayloadSeg2_4
          get getter: maximum-segment-length-request=0, maximum-segment-length-response=0, method-id=8243, transport-protocol=UDP
          notifier notifier: event-id=8243, maximum-segment-length=0, transport-protocol=UDP
        FRSD_PayloadSeg3_1_Field: field=FRSD_PayloadSeg3_1
          get getter: maximum-segment-length-request=0, maximum-segment-length-response=0, method-id=8244, transport-protocol=UDP
          notifier notifier: event-id=8244, maximum-segment-length=0, transport-protocol=UDP
        FRSD_PayloadSeg3_2_Field: field=FRSD_PayloadSeg3_2
          get getter: maximum-segment-length-request=0, maximum-segment-length-response=0, method-id=8245, transport-protocol=UDP
          notifier notifier: event-id=8245, maximum-segment-length=0, transport-protocol=UDP
        FRSD_PayloadSeg3_3_Field: field=FRSD_PayloadSeg3_3
          get getter: maximum-segment-length-request=0, maximum-segment-length-response=0, method-id=8246, transport-protocol=UDP
          notifier notifier: event-id=8246, maximum-segment-length=0, transport-protocol=UDP
        FRSD_PayloadSeg3_4_Field: field=FRSD_PayloadSeg3_4
          get getter: maximum-segment-length-request=0, maximum-segment-length-response=0, method-id=8247, transport-protocol=UDP
          notifier notifier: event-id=8247, maximum-segment-length=0, transport-protocol=UDP
        FRSD_PayloadSeg4_1_Field: field=FRSD_PayloadSeg4_1
          get getter: maximum-segment-length-request=0, maximum-segment-length-response=0, method-id=8248, transport-protocol=UDP
          notifier notifier: event-id=8248, maximum-segment-length=0, transport-protocol=UDP
        FRSD_PayloadSeg4_2_Field: field=FRSD_PayloadSeg4_2
          get getter: maximum-segment-length-request=0, maximum-segment-length-response=0, method-id=8249, transport-protocol=UDP
          notifier notifier: event-id=8249, maximum-segment-length=0, transport-protocol=UDP
        FRSD_PayloadSeg4_3_Field: field=FRSD_PayloadSeg4_3
          get getter: maximum-segment-length-request=0, maximum-segment-length-response=0, method-id=8250, transport-protocol=UDP
          notifier notifier: event-id=8250, maximum-segment-length=0, transport-protocol=UDP
        FRSD_PayloadSeg4_4_Field: field=FRSD_PayloadSeg4_4
          get getter: maximum-segment-length-request=0, maximum-segment-length-response=0, method-id=8251, transport-protocol=UDP
          notifier notifier: event-id=8251, maximum-segment-length=0, transport-protocol=UDP
        FRSD_Size_Field: field=FRSD_Size
          get getter: maximum-segment-length-request=0, maximum-segment-length-response=0, method-id=8235, transport-protocol=UDP
          notifier notifier: event-id=8235, maximum-segment-length=0, transport-protocol=UDP
        FRSD_Zero_Field: field=FRSD_Zero
          get getter: maximum-segment-length-request=0, maximum-segment-length-response=0, method-id=8231, transport-protocol=UDP
          notifier notifier: event-id=8231, maximum-segment-length=0, transport-protocol=UDP
        FineDustSensorOptionInfo_Field: field=FineDustSensorOptionInfo
          get getter: maximum-segment-length-request=0, maximum-segment-length-response=0, method-id=8202, transport-protocol=UDP
          notifier notifier: event-id=8202, maximum-segment-length=0, transport-protocol=UDP
        FineDustSensorValue_Field: field=FineDustSensorValue
          get getter: maximum-segment-length-request=0, maximum-segment-length-response=0, method-id=8203, transport-protocol=UDP
          notifier notifier: event-id=8203, maximum-segment-length=0, transport-protocol=UDP
        FineDustStep_Field: field=FineDustStep
          get getter: maximum-segment-length-request=0, maximum-segment-length-response=0, method-id=8204, transport-protocol=UDP
          notifier notifier: event-id=8204, maximum-segment-length=0, transport-protocol=UDP
        FragKindDis_Field: field=FragKindDis
          get getter: maximum-segment-length-request=0, maximum-segment-length-response=0, method-id=8303, transport-protocol=UDP
          notifier notifier: event-id=8303, maximum-segment-length=0, transport-protocol=UDP
        FrontDefogLEDState_Field: field=FrontDefogLEDState
          get getter: maximum-segment-length-request=0, maximum-segment-length-response=0, method-id=8205, transport-protocol=UDP
          notifier notifier: event-id=8205, maximum-segment-length=0, transport-protocol=UDP
        FuelLevelState_Field: field=FuelLevelState
          get getter: maximum-segment-length-request=0, maximum-segment-length-response=0, method-id=8206, transport-protocol=UDP
          notifier notifier: event-id=8206, maximum-segment-length=0, transport-protocol=UDP
        LowFuelWarningState_Field: field=LowFuelWarningState
          get getter: maximum-segment-length-request=0, maximum-segment-length-response=0, method-id=8207, transport-protocol=UDP
          notifier notifier: event-id=8207, maximum-segment-length=0, transport-protocol=UDP
        OutTempOption_Field: field=OutTempOption
          get getter: maximum-segment-length-request=0, maximum-segment-length-response=0, method-id=8222, transport-protocol=UDP
          notifier notifier: event-id=8222, maximum-segment-length=0, transport-protocol=UDP
        OutTempSensorValue_Field: field=OutTempSensorValue
          get getter: maximum-segment-length-request=0, maximum-segment-length-response=0, method-id=8384, transport-protocol=UDP
          notifier notifier: event-id=8384, maximum-segment-length=0, transport-protocol=UDP
        OutsideTemperature_C_Field: field=OutsideTemperature_C
          get getter: maximum-segment-length-request=0, maximum-segment-length-response=0, method-id=8224, transport-protocol=UDP
          notifier notifier: event-id=8224, maximum-segment-length=0, transport-protocol=UDP
        OutsideTemperature_F_Field: field=OutsideTemperature_F
          get getter: maximum-segment-length-request=0, maximum-segment-length-response=0, method-id=8225, transport-protocol=UDP
          notifier notifier: event-id=8225, maximum-segment-length=0, transport-protocol=UDP
        PassTempCDis_Field: field=PassTempCDis
          get getter: maximum-segment-length-request=0, maximum-segment-length-response=0, method-id=8311, transport-protocol=UDP
          notifier notifier: event-id=8311, maximum-segment-length=0, transport-protocol=UDP
        PassTempFDis_Field: field=PassTempFDis
          get getter: maximum-segment-length-request=0, maximum-segment-length-response=0, method-id=8315, transport-protocol=UDP
          notifier notifier: event-id=8315, maximum-segment-length=0, transport-protocol=UDP
        PtcFaultState_Field: field=PtcFaultState
          get getter: maximum-segment-length-request=0, maximum-segment-length-response=0, method-id=8208, transport-protocol=UDP
          notifier notifier: event-id=8208, maximum-segment-length=0, transport-protocol=UDP
        RRSyncDis_Field: field=RRSyncDis
          get getter: maximum-segment-length-request=0, maximum-segment-length-response=0, method-id=8319, transport-protocol=UDP
          notifier notifier: event-id=8319, maximum-segment-length=0, transport-protocol=UDP
        RSD2nd_CRC16_Field: field=RSD2nd_CRC16
          get getter: maximum-segment-length-request=0, maximum-segment-length-response=0, method-id=8283, transport-protocol=UDP
          notifier notifier: event-id=8283, maximum-segment-length=0, transport-protocol=UDP
        RSD2nd_CyclicPacketCount_Field: field=RSD2nd_CyclicPacketCount
          get getter: maximum-segment-length-request=0, maximum-segment-length-response=0, method-id=8282, transport-protocol=UDP
          notifier notifier: event-id=8282, maximum-segment-length=0, transport-protocol=UDP
        RSD2nd_FirstPacketIndicate_Field: field=RSD2nd_FirstPacketIndicate
          get getter: maximum-segment-length-request=0, maximum-segment-length-response=0, method-id=8278, transport-protocol=UDP
          notifier notifier: event-id=8278, maximum-segment-length=0, transport-protocol=UDP
        RSD2nd_LastPacketIndicate_Field: field=RSD2nd_LastPacketIndicate
          get getter: maximum-segment-length-request=0, maximum-segment-length-response=0, method-id=8279, transport-protocol=UDP
          notifier notifier: event-id=8279, maximum-segment-length=0, transport-protocol=UDP
        RSD2nd_MSGID_Field: field=RSD2nd_MSGID
          get getter: maximum-segment-length-request=0, maximum-segment-length-response=0, method-id=8276, transport-protocol=UDP
          notifier notifier: event-id=8276, maximum-segment-length=0, transport-protocol=UDP
        RSD2nd_MSGType_Field: field=RSD2nd_MSGType
          get getter: maximum-segment-length-request=0, maximum-segment-length-response=0, method-id=8284, transport-protocol=UDP
          notifier notifier: event-id=8284, maximum-segment-length=0, transport-protocol=UDP
        RSD2nd_PayloadSeg1_1_Field: field=RSD2nd_PayloadSeg1_1
          get getter: maximum-segment-length-request=0, maximum-segment-length-response=0, method-id=8286, transport-protocol=UDP
          notifier notifier: event-id=8286, maximum-segment-length=0, transport-protocol=UDP
        RSD2nd_PayloadSeg1_2_Field: field=RSD2nd_PayloadSeg1_2
          get getter: maximum-segment-length-request=0, maximum-segment-length-response=0, method-id=8287, transport-protocol=UDP
          notifier notifier: event-id=8287, maximum-segment-length=0, transport-protocol=UDP
        RSD2nd_PayloadSeg1_3_Field: field=RSD2nd_PayloadSeg1_3
          get getter: maximum-segment-length-request=0, maximum-segment-length-response=0, method-id=8288, transport-protocol=UDP
          notifier notifier: event-id=8288, maximum-segment-length=0, transport-protocol=UDP
        RSD2nd_PayloadSeg2_1_Field: field=RSD2nd_PayloadSeg2_1
          get getter: maximum-segment-length-request=0, maximum-segment-length-response=0, method-id=8289, transport-protocol=UDP
          notifier notifier: event-id=8289, maximum-segment-length=0, transport-protocol=UDP
        RSD2nd_PayloadSeg2_2_Field: field=RSD2nd_PayloadSeg2_2
          get getter: maximum-segment-length-request=0, maximum-segment-length-response=0, method-id=8290, transport-protocol=UDP
          notifier notifier: event-id=8290, maximum-segment-length=0, transport-protocol=UDP
        RSD2nd_PayloadSeg2_3_Field: field=RSD2nd_PayloadSeg2_3
          get getter: maximum-segment-length-request=0, maximum-segment-length-response=0, method-id=8291, transport-protocol=UDP
          notifier notifier: event-id=8291, maximum-segment-length=0, transport-protocol=UDP
        RSD2nd_PayloadSeg2_4_Field: field=RSD2nd_PayloadSeg2_4
          get getter: maximum-segment-length-request=0, maximum-segment-length-response=0, method-id=8292, transport-protocol=UDP
          notifier notifier: event-id=8292, maximum-segment-length=0, transport-protocol=UDP
        RSD2nd_PayloadSeg3_1_Field: field=RSD2nd_PayloadSeg3_1
          get getter: maximum-segment-length-request=0, maximum-segment-length-response=0, method-id=8293, transport-protocol=UDP
          notifier notifier: event-id=8293, maximum-segment-length=0, transport-protocol=UDP
        RSD2nd_PayloadSeg3_2_Field: field=RSD2nd_PayloadSeg3_2
          get getter: maximum-segment-length-request=0, maximum-segment-length-response=0, method-id=8294, transport-protocol=UDP
          notifier notifier: event-id=8294, maximum-segment-length=0, transport-protocol=UDP
        RSD2nd_PayloadSeg3_3_Field: field=RSD2nd_PayloadSeg3_3
          get getter: maximum-segment-length-request=0, maximum-segment-length-response=0, method-id=8295, transport-protocol=UDP
          notifier notifier: event-id=8295, maximum-segment-length=0, transport-protocol=UDP
        RSD2nd_PayloadSeg3_4_Field: field=RSD2nd_PayloadSeg3_4
          get getter: maximum-segment-length-request=0, maximum-segment-length-response=0, method-id=8296, transport-protocol=UDP
          notifier notifier: event-id=8296, maximum-segment-length=0, transport-protocol=UDP
        RSD2nd_PayloadSeg4_1_Field: field=RSD2nd_PayloadSeg4_1
          get getter: maximum-segment-length-request=0, maximum-segment-length-response=0, method-id=8297, transport-protocol=UDP
          notifier notifier: event-id=8297, maximum-segment-length=0, transport-protocol=UDP
        RSD2nd_PayloadSeg4_2_Field: field=RSD2nd_PayloadSeg4_2
          get getter: maximum-segment-length-request=0, maximum-segment-length-response=0, method-id=8298, transport-protocol=UDP
          notifier notifier: event-id=8298, maximum-segment-length=0, transport-protocol=UDP
        RSD2nd_PayloadSeg4_3_Field: field=RSD2nd_PayloadSeg4_3
          get getter: maximum-segment-length-request=0, maximum-segment-length-response=0, method-id=8299, transport-protocol=UDP
          notifier notifier: event-id=8299, maximum-segment-length=0, transport-protocol=UDP
        RSD2nd_SizeReferIndicate_Field: field=RSD2nd_SizeReferIndicate
          get getter: maximum-segment-length-request=0, maximum-segment-length-response=0, method-id=8281, transport-protocol=UDP
          notifier notifier: event-id=8281, maximum-segment-length=0, transport-protocol=UDP
        RSD2nd_Size_Field: field=RSD2nd_Size
          get getter: maximum-segment-length-request=0, maximum-segment-length-response=0, method-id=8285, transport-protocol=UDP
          notifier notifier: event-id=8285, maximum-segment-length=0, transport-protocol=UDP
        RSD2nd_WaitIndicate_Field: field=RSD2nd_WaitIndicate
          get getter: maximum-segment-length-request=0, maximum-segment-length-response=0, method-id=8280, transport-protocol=UDP
          notifier notifier: event-id=8280, maximum-segment-length=0, transport-protocol=UDP
        RSD2nd_Zero_Field: field=RSD2nd_Zero
          get getter: maximum-segment-length-request=0, maximum-segment-length-response=0, method-id=8277, transport-protocol=UDP
          notifier notifier: event-id=8277, maximum-segment-length=0, transport-protocol=UDP
        RSD_CRC16_Field: field=RSD_CRC16
          get getter: maximum-segment-length-request=0, maximum-segment-length-response=0, method-id=8259, transport-protocol=UDP
          notifier notifier: event-id=8259, maximum-segment-length=0, transport-protocol=UDP
        RSD_CyclicPacketCount_Field: field=RSD_CyclicPacketCount
          get getter: maximum-segment-length-request=0, maximum-segment-length-response=0, method-id=8258, transport-protocol=UDP
          notifier notifier: event-id=8258, maximum-segment-length=0, transport-protocol=UDP
        RSD_FirstPacketIndicate_Field: field=RSD_FirstPacketIndicate
          get getter: maximum-segment-length-request=0, maximum-segment-length-response=0, method-id=8254, transport-protocol=UDP
          notifier notifier: event-id=8254, maximum-segment-length=0, transport-protocol=UDP
        RSD_LastPacketIndicate_Field: field=RSD_LastPacketIndicate
          get getter: maximum-segment-length-request=0, maximum-segment-length-response=0, method-id=8255, transport-protocol=UDP
          notifier notifier: event-id=8255, maximum-segment-length=0, transport-protocol=UDP
        RSD_MSGID_Field: field=RSD_MSGID
          get getter: maximum-segment-length-request=0, maximum-segment-length-response=0, method-id=8252, transport-protocol=UDP
          notifier notifier: event-id=8252, maximum-segment-length=0, transport-protocol=UDP
        RSD_MSGType_Field: field=RSD_MSGType
          get getter: maximum-segment-length-request=0, maximum-segment-length-response=0, method-id=8260, transport-protocol=UDP
          notifier notifier: event-id=8260, maximum-segment-length=0, transport-protocol=UDP
        RSD_PayloadSeg1_1_Field: field=RSD_PayloadSeg1_1
          get getter: maximum-segment-length-request=0, maximum-segment-length-response=0, method-id=8262, transport-protocol=UDP
          notifier notifier: event-id=8262, maximum-segment-length=0, transport-protocol=UDP
        RSD_PayloadSeg1_2_Field: field=RSD_PayloadSeg1_2
          get getter: maximum-segment-length-request=0, maximum-segment-length-response=0, method-id=8263, transport-protocol=UDP
          notifier notifier: event-id=8263, maximum-segment-length=0, transport-protocol=UDP
        RSD_PayloadSeg1_3_Field: field=RSD_PayloadSeg1_3
          get getter: maximum-segment-length-request=0, maximum-segment-length-response=0, method-id=8264, transport-protocol=UDP
          notifier notifier: event-id=8264, maximum-segment-length=0, transport-protocol=UDP
        RSD_PayloadSeg2_1_Field: field=RSD_PayloadSeg2_1
          get getter: maximum-segment-length-request=0, maximum-segment-length-response=0, method-id=8265, transport-protocol=UDP
          notifier notifier: event-id=8265, maximum-segment-length=0, transport-protocol=UDP
        RSD_PayloadSeg2_2_Field: field=RSD_PayloadSeg2_2
          get getter: maximum-segment-length-request=0, maximum-segment-length-response=0, method-id=8266, transport-protocol=UDP
          notifier notifier: event-id=8266, maximum-segment-length=0, transport-protocol=UDP
        RSD_PayloadSeg2_3_Field: field=RSD_PayloadSeg2_3
          get getter: maximum-segment-length-request=0, maximum-segment-length-response=0, method-id=8267, transport-protocol=UDP
          notifier notifier: event-id=8267, maximum-segment-length=0, transport-protocol=UDP
        RSD_PayloadSeg2_4_Field: field=RSD_PayloadSeg2_4
          get getter: maximum-segment-length-request=0, maximum-segment-length-response=0, method-id=8268, transport-protocol=UDP
          notifier notifier: event-id=8268, maximum-segment-length=0, transport-protocol=UDP
        RSD_PayloadSeg3_1_Field: field=RSD_PayloadSeg3_1
          get getter: maximum-segment-length-request=0, maximum-segment-length-response=0, method-id=8269, transport-protocol=UDP
          notifier notifier: event-id=8269, maximum-segment-length=0, transport-protocol=UDP
        RSD_PayloadSeg3_2_Field: field=RSD_PayloadSeg3_2
          get getter: maximum-segment-length-request=0, maximum-segment-length-response=0, method-id=8270, transport-protocol=UDP
          notifier notifier: event-id=8270, maximum-segment-length=0, transport-protocol=UDP
        RSD_PayloadSeg3_3_Field: field=RSD_PayloadSeg3_3
          get getter: maximum-segment-length-request=0, maximum-segment-length-response=0, method-id=8271, transport-protocol=UDP
          notifier notifier: event-id=8271, maximum-segment-length=0, transport-protocol=UDP
        RSD_PayloadSeg3_4_Field: field=RSD_PayloadSeg3_4
          get getter: maximum-segment-length-request=0, maximum-segment-length-response=0, method-id=8272, transport-protocol=UDP
          notifier notifier: event-id=8272, maximum-segment-length=0, transport-protocol=UDP
        RSD_PayloadSeg4_1_Field: field=RSD_PayloadSeg4_1
          get getter: maximum-segment-length-request=0, maximum-segment-length-response=0, method-id=8273, transport-protocol=UDP
          notifier notifier: event-id=8273, maximum-segment-length=0, transport-protocol=UDP
        RSD_PayloadSeg4_2_Field: field=RSD_PayloadSeg4_2
          get getter: maximum-segment-length-request=0, maximum-segment-length-response=0, method-id=8274, transport-protocol=UDP
          notifier notifier: event-id=8274, maximum-segment-length=0, transport-protocol=UDP
        RSD_PayloadSeg4_3_Field: field=RSD_PayloadSeg4_3
          get getter: maximum-segment-length-request=0, maximum-segment-length-response=0, method-id=8275, transport-protocol=UDP
          notifier notifier: event-id=8275, maximum-segment-length=0, transport-protocol=UDP
        RSD_SizeReferIndicate_Field: field=RSD_SizeReferIndicate
          get getter: maximum-segment-length-request=0, maximum-segment-length-response=0, method-id=8257, transport-protocol=UDP
          notifier notifier: event-id=8257, maximum-segment-length=0, transport-protocol=UDP
        RSD_Size_Field: field=RSD_Size
          get getter: maximum-segment-length-request=0, maximum-segment-length-response=0, method-id=8261, transport-protocol=UDP
          notifier notifier: event-id=8261, maximum-segment-length=0, transport-protocol=UDP
        RSD_WaitIndicate_Field: field=RSD_WaitIndicate
          get getter: maximum-segment-length-request=0, maximum-segment-length-response=0, method-id=8256, transport-protocol=UDP
          notifier notifier: event-id=8256, maximum-segment-length=0, transport-protocol=UDP
        RSD_Zero_Field: field=RSD_Zero
          get getter: maximum-segment-length-request=0, maximum-segment-length-response=0, method-id=8253, transport-protocol=UDP
          notifier notifier: event-id=8253, maximum-segment-length=0, transport-protocol=UDP
        RrDrvTempCDis_Field: field=RrDrvTempCDis
          get getter: maximum-segment-length-request=0, maximum-segment-length-response=0, method-id=8312, transport-protocol=UDP
          notifier notifier: event-id=8312, maximum-segment-length=0, transport-protocol=UDP
        RrDrvTempFDis_Field: field=RrDrvTempFDis
          get getter: maximum-segment-length-request=0, maximum-segment-length-response=0, method-id=8316, transport-protocol=UDP
          notifier notifier: event-id=8316, maximum-segment-length=0, transport-protocol=UDP
        RrPassTempCDis_Field: field=RrPassTempCDis
          get getter: maximum-segment-length-request=0, maximum-segment-length-response=0, method-id=8313, transport-protocol=UDP
          notifier notifier: event-id=8313, maximum-segment-length=0, transport-protocol=UDP
        RrPassTempFDis_Field: field=RrPassTempFDis
          get getter: maximum-segment-length-request=0, maximum-segment-length-response=0, method-id=8317, transport-protocol=UDP
          notifier notifier: event-id=8317, maximum-segment-length=0, transport-protocol=UDP
        SeatBeltDriverBuckleFaultStatus_Field: field=SeatBeltDriverBuckleFaultStatus
          get getter: maximum-segment-length-request=0, maximum-segment-length-response=0, method-id=8226, transport-protocol=UDP
          notifier notifier: event-id=8226, maximum-segment-length=0, transport-protocol=UDP
        SeatBeltDriverBuckleStatus_Field: field=SeatBeltDriverBuckleStatus
          get getter: maximum-segment-length-request=0, maximum-segment-length-response=0, method-id=8227, transport-protocol=UDP
          notifier notifier: event-id=8227, maximum-segment-length=0, transport-protocol=UDP
        SeatBeltPassengerBuckleFaultStatus_Field: field=SeatBeltPassengerBuckleFaultStatus
          get getter: maximum-segment-length-request=0, maximum-segment-length-response=0, method-id=8228, transport-protocol=UDP
          notifier notifier: event-id=8228, maximum-segment-length=0, transport-protocol=UDP
        SeatBeltPassengerBuckleStatus_Field: field=SeatBeltPassengerBuckleStatus
          get getter: maximum-segment-length-request=0, maximum-segment-length-response=0, method-id=8229, transport-protocol=UDP
          notifier notifier: event-id=8229, maximum-segment-length=0, transport-protocol=UDP
        TemperatureStatus_Field: field=TemperatureStatus
          get getter: maximum-segment-length-request=0, maximum-segment-length-response=0, method-id=8209, transport-protocol=UDP
          notifier notifier: event-id=8209, maximum-segment-length=0, transport-protocol=UDP
        TemperatureUnitState_Field: field=TemperatureUnitState
          get getter: maximum-segment-length-request=0, maximum-segment-length-response=0, method-id=8210, transport-protocol=UDP
          notifier notifier: event-id=8210, maximum-segment-length=0, transport-protocol=UDP
        VAPI_2ndAstAuto_Res_Field: field=VAPI_2ndAstAuto_Res
          get getter: maximum-segment-length-request=0, maximum-segment-length-response=0, method-id=8364, transport-protocol=UDP
          notifier notifier: event-id=8364, maximum-segment-length=0, transport-protocol=UDP
        VAPI_2ndAstBlr_Res_Field: field=VAPI_2ndAstBlr_Res
          get getter: maximum-segment-length-request=0, maximum-segment-length-response=0, method-id=8346, transport-protocol=UDP
          notifier notifier: event-id=8346, maximum-segment-length=0, transport-protocol=UDP
        VAPI_2ndAstEvntOpSta_Res_Field: field=VAPI_2ndAstEvntOpSta_Res
          get getter: maximum-segment-length-request=0, maximum-segment-length-response=0, method-id=8382, transport-protocol=UDP
          notifier notifier: event-id=8382, maximum-segment-length=0, transport-protocol=UDP
        VAPI_2ndAstMod_Res_Field: field=VAPI_2ndAstMod_Res
          get getter: maximum-segment-length-request=0, maximum-segment-length-response=0, method-id=8340, transport-protocol=UDP
          notifier notifier: event-id=8340, maximum-segment-length=0, transport-protocol=UDP
        VAPI_2ndAstMtAutoBlr_Res_Field: field=VAPI_2ndAstMtAutoBlr_Res
          get getter: maximum-segment-length-request=0, maximum-segment-length-response=0, method-id=8359, transport-protocol=UDP
          notifier notifier: event-id=8359, maximum-segment-length=0, transport-protocol=UDP
        VAPI_2ndAstTmpVal_Res_Field: field=VAPI_2ndAstTmpVal_Res
          get getter: maximum-segment-length-request=0, maximum-segment-length-response=0, method-id=8354, transport-protocol=UDP
          notifier notifier: event-id=8354, maximum-segment-length=0, transport-protocol=UDP
        VAPI_2ndDrvAuto_Res_Field: field=VAPI_2ndDrvAuto_Res
          get getter: maximum-segment-length-request=0, maximum-segment-length-response=0, method-id=8363, transport-protocol=UDP
          notifier notifier: event-id=8363, maximum-segment-length=0, transport-protocol=UDP
        VAPI_2ndDrvBlr_Res_Field: field=VAPI_2ndDrvBlr_Res
          get getter: maximum-segment-length-request=0, maximum-segment-length-response=0, method-id=8345, transport-protocol=UDP
          notifier notifier: event-id=8345, maximum-segment-length=0, transport-protocol=UDP
        VAPI_2ndDrvEvntOpSta_Res_Field: field=VAPI_2ndDrvEvntOpSta_Res
          get getter: maximum-segment-length-request=0, maximum-segment-length-response=0, method-id=8381, transport-protocol=UDP
          notifier notifier: event-id=8381, maximum-segment-length=0, transport-protocol=UDP
        VAPI_2ndDrvMod_Res_Field: field=VAPI_2ndDrvMod_Res
          get getter: maximum-segment-length-request=0, maximum-segment-length-response=0, method-id=8339, transport-protocol=UDP
          notifier notifier: event-id=8339, maximum-segment-length=0, transport-protocol=UDP
        VAPI_2ndDrvMtAutoBlr_Res_Field: field=VAPI_2ndDrvMtAutoBlr_Res
          get getter: maximum-segment-length-request=0, maximum-segment-length-response=0, method-id=8358, transport-protocol=UDP
          notifier notifier: event-id=8358, maximum-segment-length=0, transport-protocol=UDP
        VAPI_2ndDrvTmpVal_Res_Field: field=VAPI_2ndDrvTmpVal_Res
          get getter: maximum-segment-length-request=0, maximum-segment-length-response=0, method-id=8353, transport-protocol=UDP
          notifier notifier: event-id=8353, maximum-segment-length=0, transport-protocol=UDP
        VAPI_3rdDrvAuto_Res_Field: field=VAPI_3rdDrvAuto_Res
          get getter: maximum-segment-length-request=0, maximum-segment-length-response=0, method-id=8365, transport-protocol=UDP
          notifier notifier: event-id=8365, maximum-segment-length=0, transport-protocol=UDP
        VAPI_3rdDrvBlr_Res_Field: field=VAPI_3rdDrvBlr_Res
          get getter: maximum-segment-length-request=0, maximum-segment-length-response=0, method-id=8347, transport-protocol=UDP
          notifier notifier: event-id=8347, maximum-segment-length=0, transport-protocol=UDP
        VAPI_3rdDrvMod_Res_Field: field=VAPI_3rdDrvMod_Res
          get getter: maximum-segment-length-request=0, maximum-segment-length-response=0, method-id=8341, transport-protocol=UDP
          notifier notifier: event-id=8341, maximum-segment-length=0, transport-protocol=UDP
        VAPI_3rdDrvMtAutoBlr_Res_Field: field=VAPI_3rdDrvMtAutoBlr_Res
          get getter: maximum-segment-length-request=0, maximum-segment-length-response=0, method-id=8360, transport-protocol=UDP
          notifier notifier: event-id=8360, maximum-segment-length=0, transport-protocol=UDP
        VAPI_3rdDrvTmpVal_Res_Field: field=VAPI_3rdDrvTmpVal_Res
          get getter: maximum-segment-length-request=0, maximum-segment-length-response=0, method-id=8355, transport-protocol=UDP
          notifier notifier: event-id=8355, maximum-segment-length=0, transport-protocol=UDP
        VAPI_AllSeatCtrl_Res_Field: field=VAPI_AllSeatCtrl_Res
          get getter: maximum-segment-length-request=0, maximum-segment-length-response=0, method-id=8383, transport-protocol=UDP
          notifier notifier: event-id=8383, maximum-segment-length=0, transport-protocol=UDP
        VAPI_AstAuto_Res_Field: field=VAPI_AstAuto_Res
          get getter: maximum-segment-length-request=0, maximum-segment-length-response=0, method-id=8362, transport-protocol=UDP
          notifier notifier: event-id=8362, maximum-segment-length=0, transport-protocol=UDP
        VAPI_AstBlr_Res_Field: field=VAPI_AstBlr_Res
          get getter: maximum-segment-length-request=0, maximum-segment-length-response=0, method-id=8344, transport-protocol=UDP
          notifier notifier: event-id=8344, maximum-segment-length=0, transport-protocol=UDP
        VAPI_AstEvntOpSta_Res_Field: field=VAPI_AstEvntOpSta_Res
          get getter: maximum-segment-length-request=0, maximum-segment-length-response=0, method-id=8380, transport-protocol=UDP
          notifier notifier: event-id=8380, maximum-segment-length=0, transport-protocol=UDP
        VAPI_AstMod_Res_Field: field=VAPI_AstMod_Res
          get getter: maximum-segment-length-request=0, maximum-segment-length-response=0, method-id=8338, transport-protocol=UDP
          notifier notifier: event-id=8338, maximum-segment-length=0, transport-protocol=UDP
        VAPI_AstMtAutoBlr_Res_Field: field=VAPI_AstMtAutoBlr_Res
          get getter: maximum-segment-length-request=0, maximum-segment-length-response=0, method-id=8357, transport-protocol=UDP
          notifier notifier: event-id=8357, maximum-segment-length=0, transport-protocol=UDP
        VAPI_AstTmpVal_Res_Field: field=VAPI_AstTmpVal_Res
          get getter: maximum-segment-length-request=0, maximum-segment-length-response=0, method-id=8352, transport-protocol=UDP
          notifier notifier: event-id=8352, maximum-segment-length=0, transport-protocol=UDP
        VAPI_BlrPrio_Res_Field: field=VAPI_BlrPrio_Res
          get getter: maximum-segment-length-request=0, maximum-segment-length-response=0, method-id=8348, transport-protocol=UDP
          notifier notifier: event-id=8348, maximum-segment-length=0, transport-protocol=UDP
        VAPI_Def_Res_Field: field=VAPI_Def_Res
          get getter: maximum-segment-length-request=0, maximum-segment-length-response=0, method-id=8378, transport-protocol=UDP
          notifier notifier: event-id=8378, maximum-segment-length=0, transport-protocol=UDP
        VAPI_DrvAuto_Res_Field: field=VAPI_DrvAuto_Res
          get getter: maximum-segment-length-request=0, maximum-segment-length-response=0, method-id=8361, transport-protocol=UDP
          notifier notifier: event-id=8361, maximum-segment-length=0, transport-protocol=UDP
        VAPI_DrvBlr_Res_Field: field=VAPI_DrvBlr_Res
          get getter: maximum-segment-length-request=0, maximum-segment-length-response=0, method-id=8343, transport-protocol=UDP
          notifier notifier: event-id=8343, maximum-segment-length=0, transport-protocol=UDP
        VAPI_DrvEvntOpSta_Res_Field: field=VAPI_DrvEvntOpSta_Res
          get getter: maximum-segment-length-request=0, maximum-segment-length-response=0, method-id=8379, transport-protocol=UDP
          notifier notifier: event-id=8379, maximum-segment-length=0, transport-protocol=UDP
        VAPI_DrvMod_Res_Field: field=VAPI_DrvMod_Res
          get getter: maximum-segment-length-request=0, maximum-segment-length-response=0, method-id=8337, transport-protocol=UDP
          notifier notifier: event-id=8337, maximum-segment-length=0, transport-protocol=UDP
        VAPI_DrvMtAutoBlr_Res_Field: field=VAPI_DrvMtAutoBlr_Res
          get getter: maximum-segment-length-request=0, maximum-segment-length-response=0, method-id=8356, transport-protocol=UDP
          notifier notifier: event-id=8356, maximum-segment-length=0, transport-protocol=UDP
        VAPI_DrvTmpVal_Res_Field: field=VAPI_DrvTmpVal_Res
          get getter: maximum-segment-length-request=0, maximum-segment-length-response=0, method-id=8351, transport-protocol=UDP
          notifier notifier: event-id=8351, maximum-segment-length=0, transport-protocol=UDP
        VAPI_FragCartKind_Res_Field: field=VAPI_FragCartKind_Res
          get getter: maximum-segment-length-request=0, maximum-segment-length-response=0, method-id=8370, transport-protocol=UDP
          notifier notifier: event-id=8370, maximum-segment-length=0, transport-protocol=UDP
        VAPI_FragCartStrh_Res_Field: field=VAPI_FragCartStrh_Res
          get getter: maximum-segment-length-request=0, maximum-segment-length-response=0, method-id=8371, transport-protocol=UDP
          notifier notifier: event-id=8371, maximum-segment-length=0, transport-protocol=UDP
        VAPI_HVAC2ndExtSwLck_Res_Field: field=VAPI_HVAC2ndExtSwLck_Res
          get getter: maximum-segment-length-request=0, maximum-segment-length-response=0, method-id=8375, transport-protocol=UDP
          notifier notifier: event-id=8375, maximum-segment-length=0, transport-protocol=UDP
        VAPI_HVAC2ndSwLck_Res_Field: field=VAPI_HVAC2ndSwLck_Res
          get getter: maximum-segment-length-request=0, maximum-segment-length-response=0, method-id=8374, transport-protocol=UDP
          notifier notifier: event-id=8374, maximum-segment-length=0, transport-protocol=UDP
        VAPI_HVAC2ndSysSta_Res_Field: field=VAPI_HVAC2ndSysSta_Res
          get getter: maximum-segment-length-request=0, maximum-segment-length-response=0, method-id=8368, transport-protocol=UDP
          notifier notifier: event-id=8368, maximum-segment-length=0, transport-protocol=UDP
        VAPI_HVAC3rdExtSwLck_Res_Field: field=VAPI_HVAC3rdExtSwLck_Res
          get getter: maximum-segment-length-request=0, maximum-segment-length-response=0, method-id=8377, transport-protocol=UDP
          notifier notifier: event-id=8377, maximum-segment-length=0, transport-protocol=UDP
        VAPI_HVAC3rdSwLck_Res_Field: field=VAPI_HVAC3rdSwLck_Res
          get getter: maximum-segment-length-request=0, maximum-segment-length-response=0, method-id=8376, transport-protocol=UDP
          notifier notifier: event-id=8376, maximum-segment-length=0, transport-protocol=UDP
        VAPI_HVAC3rdSysSta_Res_Field: field=VAPI_HVAC3rdSysSta_Res
          get getter: maximum-segment-length-request=0, maximum-segment-length-response=0, method-id=8369, transport-protocol=UDP
          notifier notifier: event-id=8369, maximum-segment-length=0, transport-protocol=UDP
        VAPI_HVACExtSwLck_Res_Field: field=VAPI_HVACExtSwLck_Res
          get getter: maximum-segment-length-request=0, maximum-segment-length-response=0, method-id=8373, transport-protocol=UDP
          notifier notifier: event-id=8373, maximum-segment-length=0, transport-protocol=UDP
        VAPI_HVACSwLck_Res_Field: field=VAPI_HVACSwLck_Res
          get getter: maximum-segment-length-request=0, maximum-segment-length-response=0, method-id=8372, transport-protocol=UDP
          notifier notifier: event-id=8372, maximum-segment-length=0, transport-protocol=UDP
        VAPI_HVACSysSta_Res_Field: field=VAPI_HVACSysSta_Res
          get getter: maximum-segment-length-request=0, maximum-segment-length-response=0, method-id=8367, transport-protocol=UDP
          notifier notifier: event-id=8367, maximum-segment-length=0, transport-protocol=UDP
        VAPI_IntakePrio_Res_Field: field=VAPI_IntakePrio_Res
          get getter: maximum-segment-length-request=0, maximum-segment-length-response=0, method-id=8350, transport-protocol=UDP
          notifier notifier: event-id=8350, maximum-segment-length=0, transport-protocol=UDP
        VAPI_Intake_Res_Field: field=VAPI_Intake_Res
          get getter: maximum-segment-length-request=0, maximum-segment-length-response=0, method-id=8349, transport-protocol=UDP
          notifier notifier: event-id=8349, maximum-segment-length=0, transport-protocol=UDP
        VAPI_ModPrio_Res_Field: field=VAPI_ModPrio_Res
          get getter: maximum-segment-length-request=0, maximum-segment-length-response=0, method-id=8342, transport-protocol=UDP
          notifier notifier: event-id=8342, maximum-segment-length=0, transport-protocol=UDP
        VAPI_Sync_Res_Field: field=VAPI_Sync_Res
          get getter: maximum-segment-length-request=0, maximum-segment-length-response=0, method-id=8366, transport-protocol=UDP
          notifier notifier: event-id=8366, maximum-segment-length=0, transport-protocol=UDP
        VehicleDistancetoEmptyUnit_Field: field=VehicleDistancetoEmptyUnit
          get getter: maximum-segment-length-request=0, maximum-segment-length-response=0, method-id=8213, transport-protocol=UDP
          notifier notifier: event-id=8213, maximum-segment-length=0, transport-protocol=UDP
        VehicleDistancetoEmpty_Field: field=VehicleDistancetoEmpty
          get getter: maximum-segment-length-request=0, maximum-segment-length-response=0, method-id=8212, transport-protocol=UDP
          notifier notifier: event-id=8212, maximum-segment-length=0, transport-protocol=UDP
        VehicleOdometer_Field: field=VehicleOdometer
          get getter: maximum-segment-length-request=0, maximum-segment-length-response=0, method-id=8214, transport-protocol=UDP
          notifier notifier: event-id=8214, maximum-segment-length=0, transport-protocol=UDP
        VehicleSpeedUnit_Field: field=VehicleSpeedUnit
          get getter: maximum-segment-length-request=0, maximum-segment-length-response=0, method-id=8216, transport-protocol=UDP
          notifier notifier: event-id=8216, maximum-segment-length=0, transport-protocol=UDP
        VehicleSpeed_Field: field=VehicleSpeed
          get getter: maximum-segment-length-request=0, maximum-segment-length-response=0, method-id=8215, transport-protocol=UDP
          notifier notifier: event-id=8215, maximum-segment-length=0, transport-protocol=UDP
      205 x someip event group:
        NewEventGroup: event-group-id=1, event=AcnECompCnsmptPwrVal_Field/notifier
        NewEventGroup1: event-group-id=2, event=AirCleaningOptionInfo_Field/notifier
        NewEventGroup10: event-group-id=11, event=DATC_RrBlowerDisplay_Field/notifier
        NewEventGroup100: event-group-id=101, event=TemperatureStatus_Field/notifier
        NewEventGroup101: event-group-id=102, event=TemperatureUnitState_Field/notifier
        NewEventGroup102: event-group-id=103, event=VehicleDistancetoEmpty_Field/notifier
        NewEventGroup103: event-group-id=104, event=VehicleDistancetoEmptyUnit_Field/notifier
        NewEventGroup104: event-group-id=105, event=VehicleOdometer_Field/notifier
        NewEventGroup105: event-group-id=106, event=VehicleSpeed_Field/notifier
        NewEventGroup106: event-group-id=107, event=VehicleSpeedUnit_Field/notifier
        NewEventGroup107: event-group-id=108, event=DATCOptSys_Field/notifier
        NewEventGroup108: event-group-id=109, event=FragKindDis_Field/notifier
        NewEventGroup11: event-group-id=12, event=DATC_SyncDisplay_Field/notifier
        NewEventGroup113: event-group-id=114, event=DATCTypAll_Field/notifier
        NewEventGroup116: event-group-id=117, event=PassTempCDis_Field/notifier
        NewEventGroup117: event-group-id=118, event=RrDrvTempCDis_Field/notifier
        NewEventGroup118: event-group-id=119, event=RrPassTempCDis_Field/notifier
        NewEventGroup119: event-group-id=120, event=Drv3rdTempCDis_Field/notifier
        NewEventGroup12: event-group-id=13, event=DriverBlowState_Field/notifier
        NewEventGroup120: event-group-id=121, event=PassTempFDis_Field/notifier
        NewEventGroup121: event-group-id=122, event=RrDrvTempFDis_Field/notifier
        NewEventGroup122: event-group-id=123, event=RrPassTempFDis_Field/notifier
        NewEventGroup123: event-group-id=124, event=Drv3rdTempFDis_Field/notifier
        NewEventGroup124: event-group-id=125, event=RRSyncDis_Field/notifier
        NewEventGroup13: event-group-id=14, event=DriverTemperature_C_Field/notifier
        NewEventGroup137: event-group-id=138, event=DATCIntakeSta_Field/notifier
        NewEventGroup139: event-group-id=139, event=DATC_FragStrhDis_Field/notifier
        NewEventGroup14: event-group-id=15, event=DriverTemperature_F_Field/notifier
        NewEventGroup140: event-group-id=140, event=DATC_BlwrLvl_Field/notifier
        NewEventGroup141: event-group-id=141, event=DATC_Typ_All_4_Field/notifier
        NewEventGroup142: event-group-id=142, event=DATC_Typ_All_5_Field/notifier
        NewEventGroup143: event-group-id=143, event=VAPI_DrvMod_Res_Field/notifier
        NewEventGroup144: event-group-id=144, event=VAPI_AstMod_Res_Field/notifier
        NewEventGroup145: event-group-id=145, event=VAPI_2ndDrvMod_Res_Field/notifier
        NewEventGroup146: event-group-id=146, event=VAPI_2ndAstMod_Res_Field/notifier
        NewEventGroup147: event-group-id=147, event=VAPI_3rdDrvMod_Res_Field/notifier
        NewEventGroup148: event-group-id=148, event=VAPI_ModPrio_Res_Field/notifier
        NewEventGroup149: event-group-id=149, event=VAPI_DrvBlr_Res_Field/notifier
        NewEventGroup15: event-group-id=16, event=DrivingModeState_Field/notifier
        NewEventGroup150: event-group-id=150, event=VAPI_AstBlr_Res_Field/notifier
        NewEventGroup151: event-group-id=151, event=VAPI_2ndDrvBlr_Res_Field/notifier
        NewEventGroup152: event-group-id=152, event=VAPI_2ndAstBlr_Res_Field/notifier
        NewEventGroup153: event-group-id=153, event=VAPI_3rdDrvBlr_Res_Field/notifier
        NewEventGroup154: event-group-id=154, event=VAPI_BlrPrio_Res_Field/notifier
        NewEventGroup155: event-group-id=155, event=VAPI_Intake_Res_Field/notifier
        NewEventGroup156: event-group-id=156, event=VAPI_IntakePrio_Res_Field/notifier
        NewEventGroup157: event-group-id=157, event=VAPI_DrvTmpVal_Res_Field/notifier
        NewEventGroup158: event-group-id=158, event=VAPI_AstTmpVal_Res_Field/notifier
        NewEventGroup159: event-group-id=159, event=VAPI_2ndDrvTmpVal_Res_Field/notifier
        NewEventGroup16: event-group-id=17, event=FRSD_Buffer_Field/notifier
        NewEventGroup160: event-group-id=160, event=VAPI_2ndAstTmpVal_Res_Field/notifier
        NewEventGroup161: event-group-id=161, event=VAPI_3rdDrvTmpVal_Res_Field/notifier
        NewEventGroup162: event-group-id=162, event=VAPI_DrvMtAutoBlr_Res_Field/notifier
        NewEventGroup163: event-group-id=163, event=VAPI_AstMtAutoBlr_Res_Field/notifier
        NewEventGroup164: event-group-id=164, event=VAPI_2ndDrvMtAutoBlr_Res_Field/notifier
        NewEventGroup165: event-group-id=165, event=VAPI_2ndAstMtAutoBlr_Res_Field/notifier
        NewEventGroup166: event-group-id=166, event=VAPI_3rdDrvMtAutoBlr_Res_Field/notifier
        NewEventGroup167: event-group-id=167, event=VAPI_DrvAuto_Res_Field/notifier
        NewEventGroup168: event-group-id=168, event=VAPI_AstAuto_Res_Field/notifier
        NewEventGroup169: event-group-id=169, event=VAPI_2ndDrvAuto_Res_Field/notifier
        NewEventGroup17: event-group-id=18, event=FRSD_CRC16_Field/notifier
        NewEventGroup170: event-group-id=170, event=VAPI_2ndAstAuto_Res_Field/notifier
        NewEventGroup171: event-group-id=171, event=VAPI_3rdDrvAuto_Res_Field/notifier
        NewEventGroup172: event-group-id=172, event=VAPI_Sync_Res_Field/notifier
        NewEventGroup173: event-group-id=173, event=VAPI_HVACSysSta_Res_Field/notifier
        NewEventGroup174: event-group-id=174, event=VAPI_HVAC2ndSysSta_Res_Field/notifier
        NewEventGroup175: event-group-id=175, event=VAPI_HVAC3rdSysSta_Res_Field/notifier
        NewEventGroup176: event-group-id=176, event=VAPI_FragCartKind_Res_Field/notifier
        NewEventGroup177: event-group-id=177, event=VAPI_FragCartStrh_Res_Field/notifier
        NewEventGroup178: event-group-id=178, event=VAPI_HVACSwLck_Res_Field/notifier
        NewEventGroup179: event-group-id=179, event=VAPI_HVACExtSwLck_Res_Field/notifier
        NewEventGroup18: event-group-id=19, event=FRSD_MSGID_Field/notifier
        NewEventGroup180: event-group-id=180, event=VAPI_HVAC2ndSwLck_Res_Field/notifier
        NewEventGroup181: event-group-id=181, event=VAPI_HVAC2ndExtSwLck_Res_Field/notifier
        NewEventGroup182: event-group-id=182, event=VAPI_HVAC3rdSwLck_Res_Field/notifier
        NewEventGroup183: event-group-id=183, event=VAPI_HVAC3rdExtSwLck_Res_Field/notifier
        NewEventGroup184: event-group-id=184, event=VAPI_Def_Res_Field/notifier
        NewEventGroup185: event-group-id=185, event=VAPI_DrvEvntOpSta_Res_Field/notifier
        NewEventGroup186: event-group-id=186, event=VAPI_AstEvntOpSta_Res_Field/notifier
        NewEventGroup187: event-group-id=187, event=VAPI_2ndDrvEvntOpSta_Res_Field/notifier
        NewEventGroup188: event-group-id=188, event=VAPI_2ndAstEvntOpSta_Res_Field/notifier
        NewEventGroup189: event-group-id=189, event=VAPI_AllSeatCtrl_Res_Field/notifier
        NewEventGroup19: event-group-id=20, event=FRSD_MSGType_Field/notifier
        NewEventGroup190: event-group-id=190, event=OutTempSensorValue_Field/notifier
        NewEventGroup191: event-group-id=191, event=FR_CMR_RSD_01_00ms_Event
        NewEventGroup192: event-group-id=192, event=FR_CMR_RSD_02_00ms_Event
        NewEventGroup193: event-group-id=193, event=FR_CMR_RSD_03_00ms_Event
        NewEventGroup194: event-group-id=194, event=FR_CMR_RSD_04_00ms_Event
        NewEventGroup195: event-group-id=195, event=FR_CMR_RSD_05_00ms_Event
        NewEventGroup196: event-group-id=196, event=FR_CMR_RSD_06_00ms_Event
        NewEventGroup197: event-group-id=197, event=FR_CMR_RSD_07_00ms_Event
        NewEventGroup198: event-group-id=198, event=FR_CMR_RSD_08_00ms_Event
        NewEventGroup199: event-group-id=199, event=FR_CMR_FRSD_01_00ms_Event
        NewEventGroup2: event-group-id=3, event=AirCleaningState_Field/notifier
        NewEventGroup20: event-group-id=21, event=FRSD_PayloadSeg1_1_Field/notifier
        NewEventGroup200: event-group-id=200, event=FR_CMR_FRSD_02_00ms_Event
        NewEventGroup201: event-group-id=201, event=FR_CMR_FRSD_03_00ms_Event
        NewEventGroup202: event-group-id=202, event=FR_CMR_FRSD_04_00ms_Event
        NewEventGroup203: event-group-id=203, event=FR_CMR_FRSD_05_00ms_Event
        NewEventGroup204: event-group-id=204, event=IMU_01_10ms_Event
        NewEventGroup205: event-group-id=205, event=DATC_AUTOStep_Field/notifier
        NewEventGroup206: event-group-id=206, event=DATC_AUTOStepPS_Field/notifier
        NewEventGroup207: event-group-id=207, event=DATC_AUTOStepRR_Field/notifier
        NewEventGroup208: event-group-id=208, event=DATC_AUTOStepRRPass_Field/notifier
        NewEventGroup209: event-group-id=209, event=DATC_AUTOStep3rd_Field/notifier
        NewEventGroup21: event-group-id=22, event=FRSD_PayloadSeg1_2_Field/notifier
        NewEventGroup210: event-group-id=210, event=DATC_DrvAutoDis_Field/notifier
        NewEventGroup211: event-group-id=211, event=DATC_PsAutoDis_Field/notifier
        NewEventGroup212: event-group-id=212, event=DATC_RrAutoDis_Field/notifier
        NewEventGroup213: event-group-id=213, event=DATC_RrPassAutoDis_Field/notifier
        NewEventGroup214: event-group-id=214, event=DATC_3rdAutoDis_Field/notifier
        NewEventGroup215: event-group-id=215, event=DATC_FrtDrvEVntModeSet_Disp_Field/notifier
        NewEventGroup216: event-group-id=216, event=DATC_FrtAstEVntModeSet_Disp_Field/notifier
        NewEventGroup217: event-group-id=217, event=DATC_RrDrvEVntModeSet_Disp_Field/notifier
        NewEventGroup218: event-group-id=218, event=DATC_RrAstEVntModeSet_Disp_Field/notifier
        NewEventGroup219: event-group-id=219, event=DATC_FrSysOnOffDis_Field/notifier
        NewEventGroup22: event-group-id=23, event=FRSD_PayloadSeg1_3_Field/notifier
        NewEventGroup220: event-group-id=220, event=DATC_RrSysOnOffDis_Field/notifier
        NewEventGroup221: event-group-id=221, event=DATC_3rdSysOnOffDis_Field/notifier
        NewEventGroup222: event-group-id=222, event=DATC_Typ_All_2_Field/notifier
        NewEventGroup223: event-group-id=223, event=DATC_Typ_All_3_Field/notifier
        NewEventGroup23: event-group-id=24, event=FRSD_PayloadSeg1_4_Field/notifier
        NewEventGroup24: event-group-id=25, event=FRSD_PayloadSeg2_1_Field/notifier
        NewEventGroup25: event-group-id=26, event=FRSD_PayloadSeg2_2_Field/notifier
        NewEventGroup26: event-group-id=27, event=FRSD_PayloadSeg2_3_Field/notifier
        NewEventGroup27: event-group-id=28, event=FRSD_PayloadSeg2_4_Field/notifier
        NewEventGroup28: event-group-id=29, event=FRSD_PayloadSeg3_1_Field/notifier
        NewEventGroup29: event-group-id=30, event=FRSD_PayloadSeg3_2_Field/notifier
        NewEventGroup3: event-group-id=4, event=AirCleaningStepColor_Field/notifier
        NewEventGroup30: event-group-id=31, event=FRSD_PayloadSeg3_3_Field/notifier
        NewEventGroup31: event-group-id=32, event=FRSD_PayloadSeg3_4_Field/notifier
        NewEventGroup32: event-group-id=33, event=FRSD_PayloadSeg4_1_Field/notifier
        NewEventGroup33: event-group-id=34, event=FRSD_PayloadSeg4_2_Field/notifier
        NewEventGroup34: event-group-id=35, event=FRSD_PayloadSeg4_3_Field/notifier
        NewEventGroup35: event-group-id=36, event=FRSD_PayloadSeg4_4_Field/notifier
        NewEventGroup36: event-group-id=37, event=FRSD_Size_Field/notifier
        NewEventGroup37: event-group-id=38, event=FRSD_Zero_Field/notifier
        NewEventGroup38: event-group-id=39, event=FineDustSensorOptionInfo_Field/notifier
        NewEventGroup39: event-group-id=40, event=FineDustSensorValue_Field/notifier
        NewEventGroup4: event-group-id=5, event=AirConditioningOperationState_Field/notifier
        NewEventGroup40: event-group-id=41, event=FineDustStep_Field/notifier
        NewEventGroup41: event-group-id=42, event=FrontDefogLEDState_Field/notifier
        NewEventGroup42: event-group-id=43, event=FuelLevelState_Field/notifier
        NewEventGroup43: event-group-id=44, event=LowFuelWarningState_Field/notifier
        NewEventGroup44: event-group-id=45, event=OutTempOption_Field/notifier
        NewEventGroup45: event-group-id=46, event=OutsideTemperature_C_Field/notifier
        NewEventGroup46: event-group-id=47, event=OutsideTemperature_F_Field/notifier
        NewEventGroup47: event-group-id=48, event=PtcFaultState_Field/notifier
        NewEventGroup48: event-group-id=49, event=RSD2nd_CRC16_Field/notifier
        NewEventGroup49: event-group-id=50, event=RSD2nd_CyclicPacketCount_Field/notifier
        NewEventGroup5: event-group-id=6, event=AirbagCrashActiveState_Field/notifier
        NewEventGroup50: event-group-id=51, event=RSD2nd_FirstPacketIndicate_Field/notifier
        NewEventGroup51: event-group-id=52, event=RSD2nd_LastPacketIndicate_Field/notifier
        NewEventGroup52: event-group-id=53, event=RSD2nd_MSGID_Field/notifier
        NewEventGroup53: event-group-id=54, event=RSD2nd_MSGType_Field/notifier
        NewEventGroup54: event-group-id=55, event=RSD2nd_PayloadSeg1_1_Field/notifier
        NewEventGroup55: event-group-id=56, event=RSD2nd_PayloadSeg1_2_Field/notifier
        NewEventGroup56: event-group-id=57, event=RSD2nd_PayloadSeg1_3_Field/notifier
        NewEventGroup57: event-group-id=58, event=RSD2nd_PayloadSeg2_1_Field/notifier
        NewEventGroup58: event-group-id=59, event=RSD2nd_PayloadSeg2_2_Field/notifier
        NewEventGroup59: event-group-id=60, event=RSD2nd_PayloadSeg2_3_Field/notifier
        NewEventGroup6: event-group-id=7, event=AirconElectricCompressorFaultState_Field/notifier
        NewEventGroup60: event-group-id=61, event=RSD2nd_PayloadSeg2_4_Field/notifier
        NewEventGroup61: event-group-id=62, event=RSD2nd_PayloadSeg3_1_Field/notifier
        NewEventGroup62: event-group-id=63, event=RSD2nd_PayloadSeg3_2_Field/notifier
        NewEventGroup63: event-group-id=64, event=RSD2nd_PayloadSeg3_3_Field/notifier
        NewEventGroup64: event-group-id=65, event=RSD2nd_PayloadSeg3_4_Field/notifier
        NewEventGroup65: event-group-id=66, event=RSD2nd_PayloadSeg4_1_Field/notifier
        NewEventGroup66: event-group-id=67, event=RSD2nd_PayloadSeg4_2_Field/notifier
        NewEventGroup67: event-group-id=68, event=RSD2nd_PayloadSeg4_3_Field/notifier
        NewEventGroup68: event-group-id=69, event=RSD2nd_Size_Field/notifier
        NewEventGroup69: event-group-id=70, event=RSD2nd_SizeReferIndicate_Field/notifier
        NewEventGroup7: event-group-id=8, event=BattCompPwrCnsmptn_Field/notifier
        NewEventGroup70: event-group-id=71, event=RSD2nd_WaitIndicate_Field/notifier
        NewEventGroup71: event-group-id=72, event=RSD2nd_Zero_Field/notifier
        NewEventGroup72: event-group-id=73, event=RSD_CRC16_Field/notifier
        NewEventGroup73: event-group-id=74, event=RSD_CyclicPacketCount_Field/notifier
        NewEventGroup74: event-group-id=75, event=RSD_FirstPacketIndicate_Field/notifier
        NewEventGroup75: event-group-id=76, event=RSD_LastPacketIndicate_Field/notifier
        NewEventGroup76: event-group-id=77, event=RSD_MSGID_Field/notifier
        NewEventGroup77: event-group-id=78, event=RSD_MSGType_Field/notifier
        NewEventGroup78: event-group-id=79, event=RSD_PayloadSeg1_1_Field/notifier
        NewEventGroup79: event-group-id=80, event=RSD_PayloadSeg1_2_Field/notifier
        NewEventGroup8: event-group-id=9, event=DATC_3rdRowBlowerDisplay_Field/notifier
        NewEventGroup80: event-group-id=81, event=RSD_PayloadSeg1_3_Field/notifier
        NewEventGroup81: event-group-id=82, event=RSD_PayloadSeg2_1_Field/notifier
        NewEventGroup82: event-group-id=83, event=RSD_PayloadSeg2_2_Field/notifier
        NewEventGroup83: event-group-id=84, event=RSD_PayloadSeg2_3_Field/notifier
        NewEventGroup84: event-group-id=85, event=RSD_PayloadSeg2_4_Field/notifier
        NewEventGroup85: event-group-id=86, event=RSD_PayloadSeg3_1_Field/notifier
        NewEventGroup86: event-group-id=87, event=RSD_PayloadSeg3_2_Field/notifier
        NewEventGroup87: event-group-id=88, event=RSD_PayloadSeg3_3_Field/notifier
        NewEventGroup88: event-group-id=89, event=RSD_PayloadSeg3_4_Field/notifier
        NewEventGroup89: event-group-id=90, event=RSD_PayloadSeg4_1_Field/notifier
        NewEventGroup9: event-group-id=10, event=DATC_DriverOnly_Field/notifier
        NewEventGroup90: event-group-id=91, event=RSD_PayloadSeg4_2_Field/notifier
        NewEventGroup91: event-group-id=92, event=RSD_PayloadSeg4_3_Field/notifier
        NewEventGroup92: event-group-id=93, event=RSD_Size_Field/notifier
        NewEventGroup93: event-group-id=94, event=RSD_SizeReferIndicate_Field/notifier
        NewEventGroup94: event-group-id=95, event=RSD_WaitIndicate_Field/notifier
        NewEventGroup95: event-group-id=96, event=RSD_Zero_Field/notifier
        NewEventGroup96: event-group-id=97, event=SeatBeltDriverBuckleFaultStatus_Field/notifier
        NewEventGroup97: event-group-id=98, event=SeatBeltDriverBuckleStatus_Field/notifier
        NewEventGroup98: event-group-id=99, event=SeatBeltPassengerBuckleFaultStatus_Field/notifier
        NewEventGroup99: event-group-id=100, event=SeatBeltPassengerBuckleStatus_Field/notifier
    FunctionGroupState_Someip: service-interface=FunctionGroupState, service-interface-id=4052, service-interface-version={major-version=1, minor-version=0}
      someip field deployment FunctionGroupState_Field: field=FunctionGroupState
        get getter: maximum-segment-length-request=0, maximum-segment-length-response=0, method-id=8193, transport-protocol=UDP
        notifier notifier: event-id=8194, maximum-segment-length=0, transport-protocol=UDP
      someip method deployment ReleaseRequest_Method: method=ReleaseRequest, maximum-segment-length-request=0, method-id=4098, transport-protocol=UDP
      someip method deployment RequestState_Method: method=RequestState, maximum-segment-length-request=0, method-id=4097, transport-protocol=UDP
      someip event group NewEventGroup: event-group-id=1, event=FunctionGroupState_Field/notifier
    GNSS_Someip: service-interface=GNSS, service-interface-id=5764, service-interface-version={major-version=1, minor-version=0}
      11 x someip field deployment:
        DGPSAge_Field: field=DGPSAge
          get getter: maximum-segment-length-request=0, maximum-segment-length-response=0, method-id=8196, transport-protocol=UDP
          notifier notifier: event-id=8196, maximum-segment-length=0, transport-protocol=UDP
        DOP_Field: field=DOP
          get getter: maximum-segment-length-request=0, maximum-segment-length-response=0, method-id=8195, transport-protocol=UDP
          notifier notifier: event-id=8195, maximum-segment-length=0, transport-protocol=UDP
        FixStatus_Field: field=FixStatus
          get getter: maximum-segment-length-request=0, maximum-segment-length-response=0, method-id=8197, transport-protocol=UDP
          notifier notifier: event-id=8197, maximum-segment-length=0, transport-protocol=UDP
        LocationAccuracy_Field: field=LocationAccuracy
          get getter: maximum-segment-length-request=0, maximum-segment-length-response=0, method-id=8200, transport-protocol=UDP
          notifier notifier: event-id=8200, maximum-segment-length=0, transport-protocol=UDP
        LocationFix_Field: field=LocationFix
          get getter: maximum-segment-length-request=0, maximum-segment-length-response=0, method-id=8199, transport-protocol=UDP
          notifier notifier: event-id=8199, maximum-segment-length=0, transport-protocol=UDP
        LocationGNSSData_Field: field=LocationGNSSData
          get getter: maximum-segment-length-request=0, maximum-segment-length-response=0, method-id=8201, transport-protocol=UDP
          notifier notifier: event-id=8201, maximum-segment-length=0, transport-protocol=UDP
        LocationStatus_Field: field=LocationStatus
          get getter: maximum-segment-length-request=0, maximum-segment-length-response=0, method-id=8202, transport-protocol=UDP
          notifier notifier: event-id=8202, maximum-segment-length=0, transport-protocol=UDP
        SVCount_Field: field=SVCount
          get getter: maximum-segment-length-request=0, maximum-segment-length-response=0, method-id=8203, transport-protocol=UDP
          notifier notifier: event-id=8203, maximum-segment-length=0, transport-protocol=UDP
        SearchMode_Field: field=SearchMode
          get getter: maximum-segment-length-request=0, maximum-segment-length-response=0, method-id=8198, transport-protocol=UDP
          notifier notifier: event-id=8198, maximum-segment-length=0, transport-protocol=UDP
        ValidityError_Field: field=ValidityError
          get getter: maximum-segment-length-request=0, maximum-segment-length-response=0, method-id=8194, transport-protocol=UDP
          notifier notifier: event-id=8194, maximum-segment-length=0, transport-protocol=UDP
        Validity_Field: field=Validity
          get getter: maximum-segment-length-request=0, maximum-segment-length-response=0, method-id=8193, transport-protocol=UDP
          notifier notifier: event-id=8193, maximum-segment-length=0, transport-protocol=UDP
      someip event group SomeIpEventGroups: event-group-id=8193, event=[DGPSAge_Field/notifier, DOP_Field/notifier, FixStatus_Field/notifier, LocationAccuracy_Field/notifier, LocationFix_Field/notifier, LocationGNSSData_Field/notifier, LocationStatus_Field/notifier, SVCount_Field/notifier, SearchMode_Field/notifier, ValidityError_Field/notifier, Validity_Field/notifier]
    GeneralSettings_Someip: service-interface=GeneralSettings, service-interface-id=6081, service-interface-version={major-version=1, minor-version=9}
      5 x someip field deployment:
        AvailableLanguages_Field: field=AvailableLanguages
          get getter: maximum-segment-length-request=0, maximum-segment-length-response=0, method-id=8194, transport-protocol=UDP
          notifier notifier: event-id=8194, maximum-segment-length=0, transport-protocol=UDP
        GeneralSettings_Field: field=GeneralSettings
          get getter: maximum-segment-length-request=0, maximum-segment-length-response=0, method-id=8193, transport-protocol=UDP
          notifier notifier: event-id=8193, maximum-segment-length=0, transport-protocol=UDP
        RearGeneralSettings_Field: field=RearGeneralSettings
          get getter: maximum-segment-length-request=0, maximum-segment-length-response=0, method-id=8196, transport-protocol=UDP
          notifier notifier: event-id=8196, maximum-segment-length=0, transport-protocol=UDP
        Themes_Field: field=Themes
          get getter: maximum-segment-length-request=0, maximum-segment-length-response=0, method-id=8197, transport-protocol=UDP
          notifier notifier: event-id=8197, maximum-segment-length=0, transport-protocol=UDP
        VersionInfo_Field: field=VersionInfo
          get getter: maximum-segment-length-request=0, maximum-segment-length-response=0, method-id=8195, transport-protocol=UDP
          notifier notifier: event-id=8195, maximum-segment-length=0, transport-protocol=UDP
      someip method deployment SetRearGeneralSettings_Method: method=SetRearGeneralSettings, maximum-segment-length-request=0, maximum-segment-length-response=0, method-id=4098, transport-protocol=UDP
      someip method deployment SetVersionInfo_Method: method=SetVersionInfo, maximum-segment-length-request=0, maximum-segment-length-response=0, method-id=4097, transport-protocol=UDP
      someip event group SomeIpEventGroups: event-group-id=4097, event=[AvailableLanguages_Field/notifier, GeneralSettings_Field/notifier, RearGeneralSettings_Field/notifier, Themes_Field/notifier, VersionInfo_Field/notifier]
    HTTPSimple_Someip: service-interface=HTTPSimple, service-interface-id=4055, service-interface-version={major-version=1, minor-version=1}
      someip method deployment RequestSimple_Method: method=HTTPSimple/RequestSimple, maximum-segment-length-request=0, maximum-segment-length-response=0, method-id=4097, transport-protocol=UDP
    HTTP_Someip: service-interface=HTTP, service-interface-id=3106, service-interface-version={major-version=1, minor-version=2}
      someip event deployment RequestCompletion_Event: event=RequestCompletion, event-id=4097, maximum-segment-length=0, transport-protocol=UDP
      someip event deployment ResponseMessage_Event: event=ResponseMessage, event-id=4099, maximum-segment-length=0, transport-protocol=UDP
      someip method deployment CancelRequest_Method: method=CancelRequest, maximum-segment-length-request=0, maximum-segment-length-response=0, method-id=4097, transport-protocol=UDP
      someip method deployment RequestSimple_Method: method=HTTP/RequestSimple, maximum-segment-length-request=0, maximum-segment-length-response=0, method-id=4099, transport-protocol=UDP
      someip method deployment Request_Method: method=Request, maximum-segment-length-request=0, maximum-segment-length-response=0, method-id=4098, transport-protocol=UDP
      someip event group NewEventGroup: event-group-id=1, event=RequestCompletion_Event
      someip event group NewEventGroup1: event-group-id=2, event=ResponseMessage_Event
    IOManager_Someip: service-interface=IOManager, service-interface-id=3072, service-interface-version={major-version=1, minor-version=0}
      someip field deployment PwrStatus_Field: field=PwrStatus
        get getter: maximum-segment-length-request=0, maximum-segment-length-response=0, method-id=8193, transport-protocol=UDP
        notifier notifier: event-id=8193, maximum-segment-length=0, transport-protocol=UDP
      someip field deployment WireInput_Field: field=WireInput
        get getter: maximum-segment-length-request=0, maximum-segment-length-response=0, method-id=8194, transport-protocol=UDP
        notifier notifier: event-id=8194, maximum-segment-length=0, transport-protocol=UDP
      someip method deployment SetWireOutput_Method: method=SetWireOutput, maximum-segment-length-request=0, method-id=4097, transport-protocol=UDP
      someip method deployment WireOutput_Method: method=WireOutput, maximum-segment-length-request=0, maximum-segment-length-response=0, method-id=4098, transport-protocol=UDP
      someip event group NewEventGroup: event-group-id=1, event=PwrStatus_Field/notifier
      someip event group NewEventGroup1: event-group-id=2, event=WireInput_Field/notifier
    IVPA_Someip: service-interface=IVPA, service-interface-id=4060, service-interface-version={major-version=1, minor-version=0}
      someip method deployment RequestDID_Method: method=RequestDID, maximum-segment-length-request=0, maximum-segment-length-response=0, method-id=4098, transport-protocol=UDP
      someip method deployment RequestRID_Method: method=RequestRID, maximum-segment-length-request=0, maximum-segment-length-response=0, method-id=4097, transport-protocol=UDP
    InformationProvider_Someip: service-interface=InformationProvider, service-interface-id=1, service-interface-version={major-version=2, minor-version=4}
      16 x someip field deployment:
        AverageFuelEconomyStr_Field: field=AverageFuelEconomyStr
          get getter: maximum-segment-length-request=0, maximum-segment-length-response=0, method-id=8201, transport-protocol=UDP
          notifier notifier: event-id=8201, maximum-segment-length=0, transport-protocol=UDP
        AverageFuelEconomy_Field: field=AverageFuelEconomy
          get getter: maximum-segment-length-request=0, maximum-segment-length-response=0, method-id=8194, transport-protocol=UDP
          notifier notifier: event-id=8194, maximum-segment-length=0, transport-protocol=UDP
        DTEStr_Field: field=DTEStr
          get getter: maximum-segment-length-request=0, maximum-segment-length-response=0, method-id=8200, transport-protocol=UDP
          notifier notifier: event-id=8200, maximum-segment-length=0, transport-protocol=UDP
        DTE_Field: field=DTE
          get getter: maximum-segment-length-request=0, maximum-segment-length-response=0, method-id=8193, transport-protocol=UDP
          notifier notifier: event-id=8193, maximum-segment-length=0, transport-protocol=UDP
        DrivingModes_Field: field=DrivingModes
          get getter: maximum-segment-length-request=0, maximum-segment-length-response=0, method-id=8198, transport-protocol=UDP
          notifier notifier: event-id=8198, maximum-segment-length=0, transport-protocol=UDP
        DynamicModePopupInfo_Field: field=DynamicModePopupInfo
          get getter: maximum-segment-length-request=0, maximum-segment-length-response=0, method-id=8209, transport-protocol=UDP
          notifier notifier: event-id=8209, maximum-segment-length=0, transport-protocol=UDP
        FuelStatusInfo_Field: field=FuelStatusInfo
          get getter: maximum-segment-length-request=0, maximum-segment-length-response=0, method-id=8207, transport-protocol=UDP
          notifier notifier: event-id=8207, maximum-segment-length=0, transport-protocol=UDP
        JourneyDistanceStr_Field: field=JourneyDistanceStr
          get getter: maximum-segment-length-request=0, maximum-segment-length-response=0, method-id=8202, transport-protocol=UDP
          notifier notifier: event-id=8202, maximum-segment-length=0, transport-protocol=UDP
        JourneyDistance_Field: field=JourneyDistance
          get getter: maximum-segment-length-request=0, maximum-segment-length-response=0, method-id=8195, transport-protocol=UDP
          notifier notifier: event-id=8195, maximum-segment-length=0, transport-protocol=UDP
        JourneyTime_Field: field=JourneyTime
          get getter: maximum-segment-length-request=0, maximum-segment-length-response=0, method-id=8196, transport-protocol=UDP
          notifier notifier: event-id=8196, maximum-segment-length=0, transport-protocol=UDP
        LanguageStatus_Field: field=LanguageStatus
          get getter: maximum-segment-length-request=0, maximum-segment-length-response=0, method-id=8203, transport-protocol=UDP
          notifier notifier: event-id=8203, maximum-segment-length=0, transport-protocol=UDP
        PreviousTripInformation_Field: field=PreviousTripInformation
          get getter: maximum-segment-length-request=0, maximum-segment-length-response=0, method-id=8205, transport-protocol=UDP
          notifier notifier: event-id=8205, maximum-segment-length=0, transport-protocol=UDP
        ProviderOptions_Field: field=ProviderOptions
          get getter: maximum-segment-length-request=0, maximum-segment-length-response=0, method-id=8199, transport-protocol=UDP
          notifier notifier: event-id=8199, maximum-segment-length=0, transport-protocol=UDP
        SpeedUnitDefault_Field: field=SpeedUnitDefault
          get getter: maximum-segment-length-request=0, maximum-segment-length-response=0, method-id=8204, transport-protocol=UDP
          notifier notifier: event-id=8204, maximum-segment-length=0, transport-protocol=UDP
        Telltale_Field: field=Telltale
          get getter: maximum-segment-length-request=0, maximum-segment-length-response=0, method-id=8197, transport-protocol=UDP
          notifier notifier: event-id=8197, maximum-segment-length=0, transport-protocol=UDP
        TripRawData_Field: field=TripRawData
          get getter: maximum-segment-length-request=0, maximum-segment-length-response=0, method-id=8206, transport-protocol=UDP
          notifier notifier: event-id=8206, maximum-segment-length=0, transport-protocol=UDP
      someip method deployment SetDrivingMode_Method: method=SetDrivingMode, maximum-segment-length-request=0, maximum-segment-length-response=0, method-id=4097, transport-protocol=UDP
      someip method deployment TermAverageFuelEconomyReset_Method: method=TermAverageFuelEconomyReset, method-id=4098, transport-protocol=UDP
      someip event group SomeIpEventGroups: event-group-id=4097, event=[AverageFuelEconomyStr_Field/notifier, AverageFuelEconomy_Field/notifier, DTEStr_Field/notifier, DTE_Field/notifier, DrivingModes_Field/notifier, DynamicModePopupInfo_Field/notifier, FuelStatusInfo_Field/notifier, JourneyDistanceStr_Field/notifier, JourneyDistance_Field/notifier, JourneyTime_Field/notifier, LanguageStatus_Field/notifier, PreviousTripInformation_Field/notifier, ProviderOptions_Field/notifier, SpeedUnitDefault_Field/notifier, Telltale_Field/notifier, TripRawData_Field/notifier]
    InteractionManager_Someip: service-interface=InteractionManager, service-interface-id=16, service-interface-version={major-version=2, minor-version=2}
      9 x someip field deployment:
        InteractionContents_Field: field=InteractionContents
          get getter: maximum-segment-length-request=0, maximum-segment-length-response=0, method-id=8196, transport-protocol=UDP
          notifier notifier: event-id=8196, maximum-segment-length=0, transport-protocol=UDP
        InteractionReady_Field: field=InteractionReady
          get getter: maximum-segment-length-request=0, maximum-segment-length-response=0, method-id=8198, transport-protocol=UDP
          notifier notifier: event-id=8198, maximum-segment-length=0, transport-protocol=UDP
        RequestUpdateInfoToCCU_Field: field=RequestUpdateInfoToCCU
          get getter: maximum-segment-length-request=0, maximum-segment-length-response=0, method-id=8200, transport-protocol=UDP
          notifier notifier: event-id=8200, maximum-segment-length=0, transport-protocol=UDP
        ScheduleUpdateMap_Field: field=ScheduleUpdateMap
          get getter: maximum-segment-length-request=0, maximum-segment-length-response=0, method-id=8201, transport-protocol=UDP
          notifier notifier: event-id=8201, maximum-segment-length=0, transport-protocol=UDP
        ScreenIndex_Field: field=ScreenIndex
          get getter: maximum-segment-length-request=0, maximum-segment-length-response=0, method-id=8197, transport-protocol=UDP
          notifier notifier: event-id=8197, maximum-segment-length=0, transport-protocol=UDP
        SettingsContents_Field: field=SettingsContents
          get getter: maximum-segment-length-request=0, maximum-segment-length-response=0, method-id=8195, transport-protocol=UDP
          notifier notifier: event-id=8195, maximum-segment-length=0, transport-protocol=UDP
        SoftwareReleaseApprovals_Field: field=SoftwareReleaseApprovals
          get getter: maximum-segment-length-request=0, maximum-segment-length-response=0, method-id=8194, transport-protocol=UDP
          notifier notifier: event-id=8194, maximum-segment-length=0, transport-protocol=UDP
        SoftwareReleaseLists_Field: field=SoftwareReleaseLists
          get getter: maximum-segment-length-request=0, maximum-segment-length-response=0, method-id=8193, transport-protocol=UDP
          notifier notifier: event-id=8193, maximum-segment-length=0, transport-protocol=UDP
        UpdateInfoMap_Field: field=UpdateInfoMap
          get getter: maximum-segment-length-request=0, maximum-segment-length-response=0, method-id=8199, transport-protocol=UDP
          notifier notifier: event-id=8199, maximum-segment-length=0, transport-protocol=UDP
      9 x someip method deployment, all with transport-protocol=UDP:
        DeleteReleaseInfo_Method: method=DeleteReleaseInfo, maximum-segment-length-request=0, maximum-segment-length-response=0, method-id=4098
        InitializeInteractionUI_Method: method=InitializeInteractionUI, maximum-segment-length-response=0, method-id=4102
        RequestInteractionUI_Method: method=RequestInteractionUI, maximum-segment-length-request=0, maximum-segment-length-response=0, method-id=4100
        RequestKeepScreenOn_Method: method=RequestKeepScreenOn, maximum-segment-length-request=0, maximum-segment-length-response=0, method-id=4101
        TransferUpdateInfoValue_Method: method=TransferUpdateInfoValue, maximum-segment-length-request=0, maximum-segment-length-response=0, method-id=4104
        TransferWhatsNewContentsCCUApp_Method: method=TransferWhatsNewContentsCCUApp, maximum-segment-length-request=1, maximum-segment-length-response=1, method-id=4105
        TransferWhatsNewContents_Method: method=TransferWhatsNewContents, maximum-segment-length-request=1, maximum-segment-length-response=1, method-id=4103
        UpdateReleaseInfo_Method: method=UpdateReleaseInfo, maximum-segment-length-request=0, maximum-segment-length-response=0, method-id=4097
        UpdateSettingsContentsMap_Method: method=UpdateSettingsContentsMap, maximum-segment-length-request=0, maximum-segment-length-response=0, method-id=4099
      someip event group SomeIpEventGroups: event-group-id=1, event=[InteractionContents_Field/notifier, InteractionReady_Field/notifier, RequestUpdateInfoToCCU_Field/notifier, ScheduleUpdateMap_Field/notifier, ScreenIndex_Field/notifier, SettingsContents_Field/notifier, SoftwareReleaseApprovals_Field/notifier, SoftwareReleaseLists_Field/notifier, UpdateInfoMap_Field/notifier]
    Location_Someip: service-interface=Location, service-interface-id=3100, service-interface-version={major-version=1, minor-version=0}
      8 x someip field deployment:
        AntennaStatus_Field: field=AntennaStatus
          get getter: maximum-segment-length-request=0, maximum-segment-length-response=0, method-id=8193, transport-protocol=UDP
          notifier notifier: event-id=8193, maximum-segment-length=0, transport-protocol=UDP
        CurrentLocation_Field: field=CurrentLocation
          get getter: maximum-segment-length-request=0, maximum-segment-length-response=0, method-id=8194, transport-protocol=UDP
          notifier notifier: event-id=8194, maximum-segment-length=0, transport-protocol=UDP
        LocationMapmatching_Field: field=LocationMapmatching
          get getter: maximum-segment-length-request=0, maximum-segment-length-response=0, method-id=8195, transport-protocol=UDP
          notifier notifier: event-id=8195, maximum-segment-length=0, transport-protocol=UDP
        MapMatchingDataType_Field: field=MapMatchingDataType
          get getter: maximum-segment-length-request=0, maximum-segment-length-response=0, method-id=8196, transport-protocol=UDP
          notifier notifier: event-id=8196, maximum-segment-length=0, transport-protocol=UDP
        TimeDST_Field: field=TimeDST
          get getter: maximum-segment-length-request=0, maximum-segment-length-response=0, method-id=8198, transport-protocol=UDP
          notifier notifier: event-id=8198, maximum-segment-length=0, transport-protocol=UDP
        TimeOffset_Field: field=TimeOffset
          get getter: maximum-segment-length-request=0, maximum-segment-length-response=0, method-id=8199, transport-protocol=UDP
          notifier notifier: event-id=8199, maximum-segment-length=0, transport-protocol=UDP
        TimeValidity_Field: field=TimeValidity
          get getter: maximum-segment-length-request=0, maximum-segment-length-response=0, method-id=8200, transport-protocol=UDP
          notifier notifier: event-id=8200, maximum-segment-length=0, transport-protocol=UDP
        Time_Field: field=Time
          get getter: maximum-segment-length-request=0, maximum-segment-length-response=0, method-id=8197, transport-protocol=UDP
          notifier notifier: event-id=8197, maximum-segment-length=0, transport-protocol=UDP
      8 x someip event group:
        NewEventGroup: event-group-id=1, event=AntennaStatus_Field/notifier
        NewEventGroup1: event-group-id=2, event=CurrentLocation_Field/notifier
        NewEventGroup2: event-group-id=3, event=LocationMapmatching_Field/notifier
        NewEventGroup3: event-group-id=4, event=MapMatchingDataType_Field/notifier
        NewEventGroup4: event-group-id=5, event=Time_Field/notifier
        NewEventGroup5: event-group-id=6, event=TimeDST_Field/notifier
        NewEventGroup6: event-group-id=7, event=TimeOffset_Field/notifier
        NewEventGroup7: event-group-id=8, event=TimeValidity_Field/notifier
    Log_Someip: service-interface=Log, service-interface-id=3110, service-interface-version={major-version=1, minor-version=0}
      someip method deployment requestBackupLogs_Method: method=requestBackupLogs, maximum-segment-length-request=0, maximum-segment-length-response=0, method-id=4097, transport-protocol=UDP
    Logging_Someip: service-interface=Logging, service-interface-id=3138, service-interface-version={major-version=1, minor-version=2}
      4 x someip method deployment, all with maximum-segment-length-request=0, transport-protocol=UDP:
        ControlCANStreamingRT_Method: method=ControlCANStreamingRT, method-id=4100
        ControlCanStreaming_Method: method=ControlCanStreaming, maximum-segment-length-response=0, method-id=4099
        StartLogging_Method: method=StartLogging, maximum-segment-length-response=0, method-id=4097
        StopLogging_Method: method=StopLogging, maximum-segment-length-response=0, method-id=4098
    MQTT_Someip: service-interface=MQTT, service-interface-id=3108, service-interface-version={major-version=1, minor-version=0}
      someip event deployment MqttRequestStatus_Event: event=MqttRequestStatus, event-id=4101, maximum-segment-length=0, transport-protocol=UDP
      someip event deployment TopicMessageV5_Event: event=TopicMessageV5, event-id=4100, maximum-segment-length=0, transport-protocol=UDP
      someip event deployment TopicMessage_Event: event=TopicMessage, event-id=4098, maximum-segment-length=0, transport-protocol=UDP
      someip field deployment ConnectionState_Field: field=ConnectionState
        get getter: maximum-segment-length-request=0, maximum-segment-length-response=0, method-id=8193, transport-protocol=UDP
        notifier notifier: event-id=8193, maximum-segment-length=0, transport-protocol=UDP
      8 x someip method deployment, all with maximum-segment-length-response=0, transport-protocol=UDP:
        GetExtraPropertyInfo_Method: method=GetExtraPropertyInfo, method-id=4100
        GetTopicInformation_Method: method=GetTopicInformation, method-id=4101
        PublishV5_Method: method=PublishV5, maximum-segment-length-request=0, method-id=4102
        Publish_Method: method=Publish, maximum-segment-length-request=0, method-id=4097
        SubscribeV5_Method: method=SubscribeV5, maximum-segment-length-request=0, method-id=4103
        Subscribe_Method: method=Subscribe, maximum-segment-length-request=0, method-id=4098
        UnsubscribeV5_Method: method=UnsubscribeV5, maximum-segment-length-request=0, method-id=4104
        Unsubscribe_Method: method=Unsubscribe, maximum-segment-length-request=0, method-id=4099
      4 x someip event group:
        NewEventGroup: event-group-id=1, event=ConnectionState_Field/notifier
        NewEventGroup1: event-group-id=2, event=MqttRequestStatus_Event
        NewEventGroup2: event-group-id=3, event=TopicMessage_Event
        NewEventGroup3: event-group-id=4, event=TopicMessageV5_Event
    Manager2_Someip: service-interface=Manager2, service-interface-id=7235, service-interface-version={major-version=1, minor-version=1}
      someip field deployment Activity_Field: field=Activity
        get getter: maximum-segment-length-request=0, maximum-segment-length-response=0, method-id=8194, transport-protocol=TCP
        notifier notifier: event-id=8194, maximum-segment-length=0, transport-protocol=TCP
      someip field deployment ServiceGroups_Field: field=ServiceGroups
        get getter: maximum-segment-length-request=0, maximum-segment-length-response=0, method-id=8193, transport-protocol=TCP
        notifier notifier: event-id=8193, maximum-segment-length=0, transport-protocol=TCP
      someip field deployment TetheringService_Field: field=TetheringService
        get getter: maximum-segment-length-request=0, maximum-segment-length-response=0, method-id=8195, transport-protocol=TCP
        notifier notifier: event-id=8195, maximum-segment-length=0, transport-protocol=TCP
      someip method deployment TetheringActivate_Method: method=TetheringActivate, maximum-segment-length-response=0, method-id=4097, transport-protocol=TCP
      someip method deployment TetheringDeactivate_Method: method=TetheringDeactivate, maximum-segment-length-response=0, method-id=4098, transport-protocol=TCP
      someip event group SomeIpEventGroups: event-group-id=4097, event=[Activity_Field/notifier, ServiceGroups_Field/notifier, TetheringService_Field/notifier]
    Manager_Someip: service-interface=Service/Manager, service-interface-id=4289, service-interface-version={major-version=1, minor-version=1}
      14 x someip field deployment:
        FrontIspConfigInfo_Field: field=FrontIspConfigInfo
          get getter: maximum-segment-length-request=0, maximum-segment-length-response=0, method-id=8200, transport-protocol=UDP
          notifier notifier: event-id=8200, maximum-segment-length=0, transport-protocol=UDP
        FrontIspFwInfo_Field: field=FrontIspFwInfo
          get getter: maximum-segment-length-request=0, maximum-segment-length-response=0, method-id=8199, transport-protocol=UDP
          notifier notifier: event-id=8199, maximum-segment-length=0, transport-protocol=UDP
        HwInfo_Field: field=HwInfo
          get getter: maximum-segment-length-request=0, maximum-segment-length-response=0, method-id=8197, transport-protocol=UDP
          notifier notifier: event-id=8197, maximum-segment-length=0, transport-protocol=UDP
        OtherInfo_Field: field=OtherInfo
          get getter: maximum-segment-length-request=0, maximum-segment-length-response=0, method-id=8206, transport-protocol=UDP
          notifier notifier: event-id=8206, maximum-segment-length=0, transport-protocol=UDP
        PlatformInfo_Field: field=PlatformInfo
          get getter: maximum-segment-length-request=0, maximum-segment-length-response=0, method-id=8195, transport-protocol=UDP
          notifier notifier: event-id=8195, maximum-segment-length=0, transport-protocol=UDP
        PlatformSwInfo_Field: field=PlatformSwInfo
          get getter: maximum-segment-length-request=0, maximum-segment-length-response=0, method-id=8196, transport-protocol=UDP
          notifier notifier: event-id=8196, maximum-segment-length=0, transport-protocol=UDP
        RearIspConfigInfo_Field: field=RearIspConfigInfo
          get getter: maximum-segment-length-request=0, maximum-segment-length-response=0, method-id=8202, transport-protocol=UDP
          notifier notifier: event-id=8202, maximum-segment-length=0, transport-protocol=UDP
        RearIspFwInfo_Field: field=RearIspFwInfo
          get getter: maximum-segment-length-request=0, maximum-segment-length-response=0, method-id=8201, transport-protocol=UDP
          notifier notifier: event-id=8201, maximum-segment-length=0, transport-protocol=UDP
        Region_Field: field=Region
          get getter: maximum-segment-length-request=0, maximum-segment-length-response=0, method-id=8205, transport-protocol=UDP
          notifier notifier: event-id=8205, maximum-segment-length=0, transport-protocol=UDP
        Status_Field: field=Manager/Status
          get getter: maximum-segment-length-request=0, maximum-segment-length-response=0, method-id=8194, transport-protocol=UDP
          notifier notifier: event-id=8194, maximum-segment-length=0, transport-protocol=UDP
        SwBuildDate_Field: field=SwBuildDate
          get getter: maximum-segment-length-request=0, maximum-segment-length-response=0, method-id=8204, transport-protocol=UDP
          notifier notifier: event-id=8204, maximum-segment-length=0, transport-protocol=UDP
        SwInfoMcu_Field: field=SwInfoMcu
          get getter: maximum-segment-length-request=0, maximum-segment-length-response=0, method-id=8198, transport-protocol=UDP
          notifier notifier: event-id=8198, maximum-segment-length=0, transport-protocol=UDP
        SwInfo_Field: field=SwInfo
          get getter: maximum-segment-length-request=0, maximum-segment-length-response=0, method-id=8193, transport-protocol=UDP
          notifier notifier: event-id=8193, maximum-segment-length=0, transport-protocol=UDP
        VehicleModel_Field: field=VehicleModel
          get getter: maximum-segment-length-request=0, maximum-segment-length-response=0, method-id=8203, transport-protocol=UDP
          notifier notifier: event-id=8203, maximum-segment-length=0, transport-protocol=UDP
      someip event group SomeIpEventGroups: event-group-id=4097, event=[Status_Field/notifier, SwInfo_Field/notifier]
      someip event group SomeIpEventGroups2: event-group-id=8193, event=[FrontIspConfigInfo_Field/notifier, FrontIspFwInfo_Field/notifier, HwInfo_Field/notifier, OtherInfo_Field/notifier, PlatformInfo_Field/notifier, PlatformSwInfo_Field/notifier, RearIspConfigInfo_Field/notifier, RearIspFwInfo_Field/notifier, Region_Field/notifier, SwBuildDate_Field/notifier, SwInfoMcu_Field/notifier, VehicleModel_Field/notifier]
    Manager_Someip: service-interface=Service/Manager, service-interface-id=3113, service-interface-version={major-version=1, minor-version=1}
      someip event deployment svcGroupConnectionStatus_Event: event=svcGroupConnectionStatus, event-id=4097, maximum-segment-length=0, transport-protocol=UDP
      someip field deployment EndpointConfigInformation_Field: field=EndpointConfigInformation
        get getter: maximum-segment-length-request=0, maximum-segment-length-response=0, method-id=8193, transport-protocol=UDP
        notifier notifier: event-id=8193, maximum-segment-length=0, transport-protocol=UDP
      someip method deployment isDataAvailable_Method: method=isDataAvailable, maximum-segment-length-request=0, maximum-segment-length-response=0, method-id=4097, transport-protocol=UDP
      someip event group NewEventGroup: event-group-id=1, event=EndpointConfigInformation_Field/notifier
      someip event group NewEventGroup1: event-group-id=2, event=svcGroupConnectionStatus_Event
    Manager_Someip: service-interface=Service/Manager, service-interface-id=15, service-interface-version={major-version=1, minor-version=0}
      someip field deployment DEVInfo_Field: field=DEVInfo
        get getter: maximum-segment-length-request=0, maximum-segment-length-response=0, method-id=8193, transport-protocol=UDP
        notifier notifier: event-id=8193, maximum-segment-length=0, transport-protocol=UDP
      someip method deployment FinishTransmitting_Method: method=Manager/FinishTransmitting, maximum-segment-length-request=0, maximum-segment-length-response=0, method-id=4098, transport-protocol=TCP
      someip method deployment RequestFile_Method: method=Manager/RequestFile, maximum-segment-length-request=0, maximum-segment-length-response=0, method-id=4097, transport-protocol=TCP
      someip event group SomeIpEventGroups: event-group-id=1, event=DEVInfo_Field/notifier
    Manager_Someip: service-interface=Service/Manager, service-interface-id=4353, service-interface-version={major-version=3, minor-version=0}
      someip field deployment PEVInfo_Field: field=PEVInfo
        get getter: maximum-segment-length-request=0, maximum-segment-length-response=0, method-id=8194, transport-protocol=UDP
        notifier notifier: event-id=8194, maximum-segment-length=0, transport-protocol=UDP
      someip field deployment PEVOprableTime_Field: field=PEVOprableTime
        get getter: maximum-segment-length-request=0, maximum-segment-length-response=0, method-id=8193, transport-protocol=UDP
        notifier notifier: event-id=8193, maximum-segment-length=0, transport-protocol=UDP
      someip method deployment FinishTransmitting_Method: method=Manager/FinishTransmitting, maximum-segment-length-request=0, maximum-segment-length-response=0, method-id=4098, transport-protocol=UDP
      someip method deployment RequestFile_Method: method=Manager/RequestFile, maximum-segment-length-request=0, maximum-segment-length-response=0, method-id=4097, transport-protocol=TCP
      someip event group SomeIpEventGroups: event-group-id=4097, event=[PEVInfo_Field/notifier, PEVOprableTime_Field/notifier]
    MapMatching_Someip: service-interface=MapMatching, service-interface-id=5761, service-interface-version={major-version=1, minor-version=1}
      someip field deployment MapMatchingData_Field: field=MapMatchingData
        get getter: maximum-segment-length-request=0, maximum-segment-length-response=0, method-id=8193, transport-protocol=UDP
        notifier notifier: event-id=8193, maximum-segment-length=0, transport-protocol=UDP
      someip field deployment MapMatchingType_Field: field=MapMatchingType
        get getter: maximum-segment-length-request=0, maximum-segment-length-response=0, method-id=8194, transport-protocol=UDP
        notifier notifier: event-id=8194, maximum-segment-length=0, transport-protocol=UDP
      someip event group SomeIpEventGroups: event-group-id=4097, event=[MapMatchingData_Field/notifier, MapMatchingType_Field/notifier]
    MassProc_Someip: service-interface=MassProc, service-interface-id=3141, service-interface-version={major-version=1, minor-version=1}
      someip method deployment FactoryKeyProvStatus_Method: method=FactoryKeyProvStatus, maximum-segment-length-request=0, maximum-segment-length-response=0, method-id=4098, transport-protocol=UDP
      someip method deployment FactoryKeyProv_Method: method=FactoryKeyProv, maximum-segment-length-response=0, method-id=4097, transport-protocol=UDP
      someip method deployment GetAllKeyProvisioningStatus_Method: method=GetAllKeyProvisioningStatus, maximum-segment-length-response=0, method-id=4099, transport-protocol=UDP
    MessageManager_Someip: service-interface=Service/MessageManager, service-interface-id=6341, service-interface-version={major-version=2, minor-version=0}
      someip event deployment ReceiveMessageAdded_Event: event=ReceiveMessageAdded, event-id=4097, maximum-segment-length=0, transport-protocol=UDP
      someip event deployment ReceiveMessageRemoved_Event: event=ReceiveMessageRemoved, event-id=4098, maximum-segment-length=0, transport-protocol=UDP
      someip event deployment SendMessageResult_Event: event=MessageManager/SendMessageResult, event-id=4099, maximum-segment-length=0, transport-protocol=UDP
      4 x someip method deployment, all with maximum-segment-length-response=0, transport-protocol=TCP:
        GetAllReceiveMessages_Method: method=GetAllReceiveMessages, method-id=4098
        GetReceiveMessage_Method: method=MessageManager/GetReceiveMessage, maximum-segment-length-request=0, method-id=4097
        RemoveReceiveMessages_Method: method=RemoveReceiveMessages, maximum-segment-length-request=0, method-id=4099
        SendMessage_Method: method=SendMessage, maximum-segment-length-request=0, method-id=4100
      someip event group SomeIpEventGroups: event-group-id=4097, event=[ReceiveMessageAdded_Event, ReceiveMessageRemoved_Event, MessageManager_Someip/SendMessageResult_Event]
    MessageManager_Someip: service-interface=Service/MessageManager, service-interface-id=3087, service-interface-version={major-version=1, minor-version=0}
      someip event deployment OnNotifyReceiveMessage_Event: event=OnNotifyReceiveMessage, event-id=4097, maximum-segment-length=0, transport-protocol=UDP
      someip event deployment SendMessageResult_Event: event=MessageManager/SendMessageResult, event-id=4098, maximum-segment-length=0, transport-protocol=UDP
      someip field deployment BootReason_Field: field=BootReason
        get getter: maximum-segment-length-request=0, maximum-segment-length-response=0, method-id=8193, transport-protocol=UDP
        notifier notifier: event-id=8193, maximum-segment-length=0, transport-protocol=UDP
      someip method deployment GetReceiveMessage_Method: method=MessageManager/GetReceiveMessage, maximum-segment-length-request=0, maximum-segment-length-response=0, method-id=4097, transport-protocol=UDP
      someip method deployment RemoveReceivedMessages_Method: method=RemoveReceivedMessages, maximum-segment-length-request=0, maximum-segment-length-response=0, method-id=4098, transport-protocol=UDP
      someip method deployment SendSMS_Method: method=SendSMS, maximum-segment-length-request=0, maximum-segment-length-response=0, method-id=4099, transport-protocol=UDP
      someip event group NewEventGroup: event-group-id=1, event=BootReason_Field/notifier
      someip event group NewEventGroup1: event-group-id=2, event=OnNotifyReceiveMessage_Event
      someip event group NewEventGroup2: event-group-id=3, event=MessageManager_Someip/SendMessageResult_Event
    MobileMessage_Someip: service-interface=MobileMessage, service-interface-id=3107, service-interface-version={major-version=1, minor-version=0}
      someip event deployment SendSMSMessageCompletion_Event: event=SendSMSMessageCompletion, event-id=4098, maximum-segment-length=0, transport-protocol=UDP
      someip field deployment SMSValidity_Field: field=SMSValidity
        get getter: maximum-segment-length-request=0, maximum-segment-length-response=0, method-id=8193, transport-protocol=UDP
        notifier notifier: event-id=8193, maximum-segment-length=0, transport-protocol=UDP
      someip method deployment SendSMSMessage_Method: method=SendSMSMessage, maximum-segment-length-request=0, maximum-segment-length-response=0, method-id=4098, transport-protocol=UDP
      someip event group NewEventGroup: event-group-id=1, event=SMSValidity_Field/notifier
      someip event group NewEventGroup1: event-group-id=2, event=SendSMSMessageCompletion_Event
    Mode_Someip: service-interface=Mode, service-interface-id=4056, service-interface-version={major-version=1, minor-version=0}
      someip field deployment ModeStatusField_Field: field=ModeStatusField
        get getter: maximum-segment-length-request=0, maximum-segment-length-response=0, method-id=8193, transport-protocol=UDP
        notifier notifier: event-id=8193, maximum-segment-length=0, transport-protocol=UDP
      someip method deployment IsApplied_Method: method=IsApplied, maximum-segment-length-request=0, maximum-segment-length-response=0, method-id=4097, transport-protocol=UDP
      someip method deployment SetExternalContext_Method: method=SetExternalContext, maximum-segment-length-request=0, maximum-segment-length-response=0, method-id=4098, transport-protocol=UDP
      someip event group NewEventGroup: event-group-id=1, event=ModeStatusField_Field/notifier
    ModemManager_Someip: service-interface=Service/ModemManager, service-interface-id=3088, service-interface-version={major-version=1, minor-version=0}
      someip field deployment IMEI_Field: field=ModemManager/IMEI
        get getter: maximum-segment-length-request=0, maximum-segment-length-response=0, method-id=8193, transport-protocol=UDP
        notifier notifier: event-id=8193, maximum-segment-length=0, transport-protocol=UDP
      5 x someip method deployment, all with transport-protocol=UDP:
        DcuReset_Method: method=DcuReset, maximum-segment-length-request=0, method-id=4100
        GetRemoteControlWaitingTime_Method: method=ModemManager/GetRemoteControlWaitingTime, maximum-segment-length-response=0, method-id=4101
        GetVoLTEMode_Method: method=GetVoLTEMode, maximum-segment-length-response=0, method-id=4098
        SetAirplaneMode_Method: method=ModemManager/SetAirplaneMode, maximum-segment-length-request=0, maximum-segment-length-response=0, method-id=4102
        SetVoLTEMode_Method: method=ModemManager/SetVoLTEMode, maximum-segment-length-request=0, maximum-segment-length-response=0, method-id=4099
      someip event group NewEventGroup: event-group-id=1, event=IMEI_Field/notifier
    ModemManager_Someip: service-interface=Service/ModemManager, service-interface-id=6337, service-interface-version={major-version=2, minor-version=1}
      12 x someip field deployment:
        AirplaneMode_Field: field=AirplaneMode
          get getter: maximum-segment-length-request=0, maximum-segment-length-response=0, method-id=8203, transport-protocol=TCP
          notifier notifier: event-id=8203, maximum-segment-length=0, transport-protocol=TCP
        ECallStatus_Field: field=ECallStatus
          get getter: maximum-segment-length-request=0, maximum-segment-length-response=0, method-id=8205, transport-protocol=TCP
          notifier notifier: event-id=8205, maximum-segment-length=0, transport-protocol=TCP
        IMEI_Field: field=ModemManager/IMEI
          get getter: maximum-segment-length-request=0, maximum-segment-length-response=0, method-id=8199, transport-protocol=TCP
          notifier notifier: event-id=8199, maximum-segment-length=0, transport-protocol=TCP
        Manufacturer_Field: field=Manufacturer
          get getter: maximum-segment-length-request=0, maximum-segment-length-response=0, method-id=8196, transport-protocol=TCP
          notifier notifier: event-id=8196, maximum-segment-length=0, transport-protocol=TCP
        MobileCommProtoType_Field: field=MobileCommProtoType
          get getter: maximum-segment-length-request=0, maximum-segment-length-response=0, method-id=8207, transport-protocol=TCP
          notifier notifier: event-id=8207, maximum-segment-length=0, transport-protocol=TCP
        Model_Field: field=Model
          get getter: maximum-segment-length-request=0, maximum-segment-length-response=0, method-id=8197, transport-protocol=TCP
          notifier notifier: event-id=8197, maximum-segment-length=0, transport-protocol=TCP
        ModemAvailability_Field: field=ModemAvailability
          get getter: maximum-segment-length-request=0, maximum-segment-length-response=0, method-id=8194, transport-protocol=TCP
          notifier notifier: event-id=8194, maximum-segment-length=0, transport-protocol=TCP
        ModemFOTAStatus_Field: field=ModemFOTAStatus
          get getter: maximum-segment-length-request=0, maximum-segment-length-response=0, method-id=8204, transport-protocol=TCP
          notifier notifier: event-id=8204, maximum-segment-length=0, transport-protocol=TCP
        Powered_Field: field=Powered
          get getter: maximum-segment-length-request=0, maximum-segment-length-response=0, method-id=8195, transport-protocol=TCP
          notifier notifier: event-id=8195, maximum-segment-length=0, transport-protocol=TCP
        Revision_Field: field=Revision
          get getter: maximum-segment-length-request=0, maximum-segment-length-response=0, method-id=8198, transport-protocol=TCP
          notifier notifier: event-id=8198, maximum-segment-length=0, transport-protocol=TCP
        SoftwareVersionNumber_Field: field=SoftwareVersionNumber
          get getter: maximum-segment-length-request=0, maximum-segment-length-response=0, method-id=8202, transport-protocol=TCP
          notifier notifier: event-id=8202, maximum-segment-length=0, transport-protocol=TCP
        VoLTEMode_Field: field=ModemManager/VoLTEMode
          get getter: maximum-segment-length-request=0, maximum-segment-length-response=0, method-id=8206, transport-protocol=TCP
          notifier notifier: event-id=8206, maximum-segment-length=0, transport-protocol=TCP
      5 x someip method deployment, all with transport-protocol=TCP:
        GetAntennaConnectionStatus_Method: method=GetAntennaConnectionStatus, maximum-segment-length-response=0, method-id=4101
        RequestModemFOTA_Method: method=RequestModemFOTA, maximum-segment-length-request=0, maximum-segment-length-response=0, method-id=4104
        ResetModem_Method: method=ResetModem, method-id=4097
        SetAirplaneMode_Method: method=ModemManager/SetAirplaneMode, maximum-segment-length-request=0, method-id=4103
        SetVoLTEMode_Method: method=ModemManager/SetVoLTEMode, maximum-segment-length-request=0, maximum-segment-length-response=0, method-id=4105
      someip event group SomeIpEventGroups: event-group-id=8193, event=[AirplaneMode_Field/notifier, ECallStatus_Field/notifier, IMEI_Field/notifier, Manufacturer_Field/notifier, MobileCommProtoType_Field/notifier, Model_Field/notifier, ModemAvailability_Field/notifier, ModemFOTAStatus_Field/notifier, Powered_Field/notifier, Revision_Field/notifier, SoftwareVersionNumber_Field/notifier, VoLTEMode_Field/notifier]
    Monitoring_Someip: service-interface=Monitoring, service-interface-id=4059, service-interface-version={major-version=1, minor-version=0}
      someip method deployment EventTrigger_Method: method=EventTrigger, maximum-segment-length-request=0, maximum-segment-length-response=0, method-id=4098, transport-protocol=UDP
      someip method deployment InternalData_Method: method=InternalData, maximum-segment-length-request=0, maximum-segment-length-response=0, method-id=4097, transport-protocol=UDP
    MultiMedia_Someip: service-interface=MultiMedia, service-interface-id=3101, service-interface-version={major-version=2, minor-version=1}
      someip event deployment GNSS_07_100ms_Event: event=GNSS_07_100ms, event-id=4097, maximum-segment-length=0, transport-protocol=UDP
      10 x someip field deployment:
        AverageFuelConsumptionUnit_Field: field=AverageFuelConsumptionUnit
          get getter: maximum-segment-length-request=0, maximum-segment-length-response=0, method-id=8194, transport-protocol=UDP
          notifier notifier: event-id=8194, maximum-segment-length=0, transport-protocol=UDP
        AverageFuelConsumptionValue_Field: field=AverageFuelConsumptionValue
          get getter: maximum-segment-length-request=0, maximum-segment-length-response=0, method-id=8195, transport-protocol=UDP
          notifier notifier: event-id=8195, maximum-segment-length=0, transport-protocol=UDP
        DrivingModeState_Field: field=MultiMedia/DrivingModeState
          get getter: maximum-segment-length-request=0, maximum-segment-length-response=0, method-id=8196, transport-protocol=UDP
          notifier notifier: event-id=8196, maximum-segment-length=0, transport-protocol=UDP
        EVDteInfo_Field: field=EVDteInfo
          get getter: maximum-segment-length-request=0, maximum-segment-length-response=0, method-id=8197, transport-protocol=UDP
          notifier notifier: event-id=8197, maximum-segment-length=0, transport-protocol=UDP
        HULanguageInfo_Field: field=HULanguageInfo
          get getter: maximum-segment-length-request=0, maximum-segment-length-response=0, method-id=8198, transport-protocol=UDP
          notifier notifier: event-id=8198, maximum-segment-length=0, transport-protocol=UDP
        OTAUIStatus_Field: field=OTAUIStatus
          get getter: maximum-segment-length-request=0, maximum-segment-length-response=0, method-id=8199, transport-protocol=UDP
          notifier notifier: event-id=8199, maximum-segment-length=0, transport-protocol=UDP
        PetModeReq_Field: field=PetModeReq
          get getter: maximum-segment-length-request=0, maximum-segment-length-response=0, method-id=8202, transport-protocol=UDP
          notifier notifier: event-id=8202, maximum-segment-length=0, transport-protocol=UDP
        PetTempSetVal_Field: field=PetTempSetVal
          get getter: maximum-segment-length-request=0, maximum-segment-length-response=0, method-id=8203, transport-protocol=UDP
          notifier notifier: event-id=8203, maximum-segment-length=0, transport-protocol=UDP
        PetTempUnit_Field: field=PetTempUnit
          get getter: maximum-segment-length-request=0, maximum-segment-length-response=0, method-id=8204, transport-protocol=UDP
          notifier notifier: event-id=8204, maximum-segment-length=0, transport-protocol=UDP
        UserApproval_Field: field=UserApproval
          get getter: maximum-segment-length-request=0, maximum-segment-length-response=0, method-id=8193, transport-protocol=UDP
          notifier notifier: event-id=8193, maximum-segment-length=0, transport-protocol=UDP
      11 x someip event group:
        NewEventGroup: event-group-id=1, event=AverageFuelConsumptionUnit_Field/notifier
        NewEventGroup1: event-group-id=2, event=AverageFuelConsumptionValue_Field/notifier
        NewEventGroup10: event-group-id=11, event=PetTempSetVal_Field/notifier
        NewEventGroup11: event-group-id=12, event=PetTempUnit_Field/notifier
        NewEventGroup12: event-group-id=13, event=GNSS_07_100ms_Event
        NewEventGroup2: event-group-id=3, event=DrivingModeState_Field/notifier
        NewEventGroup3: event-group-id=4, event=EVDteInfo_Field/notifier
        NewEventGroup4: event-group-id=5, event=HULanguageInfo_Field/notifier
        NewEventGroup5: event-group-id=6, event=OTAUIStatus_Field/notifier
        NewEventGroup8: event-group-id=9, event=UserApproval_Field/notifier
        NewEventGroup9: event-group-id=10, event=PetModeReq_Field/notifier
    NM_Someip: service-interface=NM, service-interface-id=3084, service-interface-version={major-version=1, minor-version=0}
      someip field deployment NetworkStatusInfo_Field: field=NetworkStatusInfo
        get getter: maximum-segment-length-request=0, maximum-segment-length-response=0, method-id=8196, transport-protocol=UDP
        notifier notifier: event-id=8196, maximum-segment-length=0, transport-protocol=UDP
      someip field deployment UpdateExternalPncInfo_Field: field=UpdateExternalPncInfo
        get getter: maximum-segment-length-request=0, maximum-segment-length-response=0, method-id=8195, transport-protocol=UDP
        notifier notifier: event-id=8195, maximum-segment-length=0, transport-protocol=UDP
      someip field deployment UpdatePncInfo_Field: field=UpdatePncInfo
        get getter: maximum-segment-length-request=0, maximum-segment-length-response=0, method-id=8194, transport-protocol=UDP
        notifier notifier: event-id=8194, maximum-segment-length=0, transport-protocol=UDP
        set setter: maximum-segment-length-request=0, maximum-segment-length-response=0, method-id=12289, transport-protocol=UDP
      4 x someip method deployment, all with maximum-segment-length-response=0, transport-protocol=UDP:
        AcquireWakeLock_Method: method=AcquireWakeLock, method-id=4097
        GetActiveEcuList_Method: method=GetActiveEcuList, method-id=4100
        ReleaseWakeLock_Method: method=ReleaseWakeLock, method-id=4102
        TriggerNodeDetection_Method: method=TriggerNodeDetection, method-id=4103
      someip event group NewEventGroup: event-group-id=1, event=NetworkStatusInfo_Field/notifier
      someip event group NewEventGroup1: event-group-id=2, event=UpdateExternalPncInfo_Field/notifier
      someip event group NewEventGroup2: event-group-id=3, event=UpdatePncInfo_Field/notifier
    NetManager_Someip: service-interface=Service/NetManager, service-interface-id=3073, service-interface-version={major-version=2, minor-version=0}
      someip event deployment ChangePartialNetworkInfo_Event: event=ChangePartialNetworkInfo, event-id=4097, maximum-segment-length=0, transport-protocol=UDP
      5 x someip field deployment:
        AppMode_Field: field=AppMode
          get getter: maximum-segment-length-request=0, maximum-segment-length-response=0, method-id=8197, transport-protocol=UDP
          notifier notifier: event-id=8197, maximum-segment-length=0, transport-protocol=UDP
        ExternalPnCluster_Field: field=ExternalPnCluster
          get getter: maximum-segment-length-request=0, maximum-segment-length-response=0, method-id=8193, transport-protocol=UDP
          notifier notifier: event-id=8193, maximum-segment-length=0, transport-protocol=UDP
        InternalPnCluster_Field: field=InternalPnCluster
          get getter: maximum-segment-length-request=0, maximum-segment-length-response=0, method-id=8194, transport-protocol=UDP
          notifier notifier: event-id=8194, maximum-segment-length=0, transport-protocol=UDP
        NetLoad_Field: field=NetLoad
          get getter: maximum-segment-length-request=0, maximum-segment-length-response=0, method-id=8195, transport-protocol=UDP
          notifier notifier: event-id=8195, maximum-segment-length=0, transport-protocol=UDP
        NetStatus_Field: field=NetStatus
          get getter: maximum-segment-length-request=0, maximum-segment-length-response=0, method-id=8196, transport-protocol=UDP
          notifier notifier: event-id=8196, maximum-segment-length=0, transport-protocol=UDP
      6 x someip method deployment, all with maximum-segment-length-request=0, transport-protocol=UDP:
        ClearPnCluster_Method: method=ClearPnCluster, method-id=4097
        SetCrankInhibit_Method: method=SetCrankInhibit, method-id=4098
        SetFodMode_Method: method=SetFodMode, method-id=4101
        SetNetRequestInfo_Method: method=SetNetRequestInfo, method-id=4102
        SetOtaMode_Method: method=SetOtaMode, method-id=4100
        SetPnCluster_Method: method=SetPnCluster, method-id=4099
      6 x someip event group:
        NewEventGroup: event-group-id=1, event=AppMode_Field/notifier
        NewEventGroup1: event-group-id=2, event=ChangePartialNetworkInfo_Event
        NewEventGroup2: event-group-id=3, event=ExternalPnCluster_Field/notifier
        NewEventGroup3: event-group-id=4, event=InternalPnCluster_Field/notifier
        NewEventGroup4: event-group-id=5, event=NetLoad_Field/notifier
        NewEventGroup5: event-group-id=6, event=NetStatus_Field/notifier
    NetManager_Someip: service-interface=Service/NetManager, service-interface-id=3134, service-interface-version={major-version=1, minor-version=0}
      someip method deployment GetTADStatus_Method: method=GetTADStatus, maximum-segment-length-response=0, method-id=4097, transport-protocol=UDP
    NetworkInformation_Someip: service-interface=NetworkInformation, service-interface-id=6338, service-interface-version={major-version=3, minor-version=0}
      9 x someip field deployment:
        DataNetRegStatus_Field: field=DataNetRegStatus
          get getter: maximum-segment-length-request=0, maximum-segment-length-response=0, method-id=8193, transport-protocol=TCP
          notifier notifier: event-id=8193, maximum-segment-length=0, transport-protocol=TCP
        MCC_Field: field=NetworkInformation/MCC
          get getter: maximum-segment-length-request=0, maximum-segment-length-response=0, method-id=8195, transport-protocol=TCP
          notifier notifier: event-id=8195, maximum-segment-length=0, transport-protocol=TCP
        MNC_Field: field=NetworkInformation/MNC
          get getter: maximum-segment-length-request=0, maximum-segment-length-response=0, method-id=8196, transport-protocol=TCP
          notifier notifier: event-id=8196, maximum-segment-length=0, transport-protocol=TCP
        Name_Field: field=NetworkInformation/Name
          get getter: maximum-segment-length-request=0, maximum-segment-length-response=0, method-id=8197, transport-protocol=TCP
          notifier notifier: event-id=8197, maximum-segment-length=0, transport-protocol=TCP
        SignalStrengthGSM_Field: field=SignalStrengthGSM
          get getter: maximum-segment-length-request=0, maximum-segment-length-response=0, method-id=8201, transport-protocol=TCP
          notifier notifier: event-id=8201, maximum-segment-length=0, transport-protocol=TCP
        SignalStrengthLTE_Field: field=SignalStrengthLTE
          get getter: maximum-segment-length-request=0, maximum-segment-length-response=0, method-id=8199, transport-protocol=TCP
          notifier notifier: event-id=8199, maximum-segment-length=0, transport-protocol=TCP
        SignalStrengthType_Field: field=SignalStrengthType
          get getter: maximum-segment-length-request=0, maximum-segment-length-response=0, method-id=8198, transport-protocol=TCP
          notifier notifier: event-id=8198, maximum-segment-length=0, transport-protocol=TCP
        SignalStrengthWCDMA_Field: field=SignalStrengthWCDMA
          get getter: maximum-segment-length-request=0, maximum-segment-length-response=0, method-id=8200, transport-protocol=TCP
          notifier notifier: event-id=8200, maximum-segment-length=0, transport-protocol=TCP
        VoiceNetRegStatus_Field: field=VoiceNetRegStatus
          get getter: maximum-segment-length-request=0, maximum-segment-length-response=0, method-id=8194, transport-protocol=TCP
          notifier notifier: event-id=8194, maximum-segment-length=0, transport-protocol=TCP
      someip event group SomeIpEventGroups: event-group-id=8193, event=[DataNetRegStatus_Field/notifier, MCC_Field/notifier, MNC_Field/notifier, Name_Field/notifier, SignalStrengthGSM_Field/notifier, SignalStrengthLTE_Field/notifier, SignalStrengthType_Field/notifier, SignalStrengthWCDMA_Field/notifier, VoiceNetRegStatus_Field/notifier]
    NetworkManager_Someip: service-interface=NetworkManager, service-interface-id=3089, service-interface-version={major-version=1, minor-version=1}
      someip event deployment OnDataRegistrationChanged_Event: event=OnDataRegistrationChanged, event-id=4097, maximum-segment-length=0, transport-protocol=UDP
      someip method deployment GetDataRegistrationStatus_Method: method=GetDataRegistrationStatus, maximum-segment-length-response=0, method-id=4097, transport-protocol=UDP
      someip method deployment GetSignalStrength_Method: method=GetSignalStrength, maximum-segment-length-response=0, method-id=4098, transport-protocol=UDP
      someip event group NewEventGroup: event-group-id=1, event=OnDataRegistrationChanged_Event
    NetworkStatistics_Someip: service-interface=NetworkStatistics, service-interface-id=3114, service-interface-version={major-version=1, minor-version=0}
      someip method deployment GetNetworkStatisticsAll_Method: method=GetNetworkStatisticsAll, maximum-segment-length-response=0, method-id=4098, transport-protocol=UDP
      someip method deployment GetNetworkStatistics_Method: method=GetNetworkStatistics, maximum-segment-length-request=0, maximum-segment-length-response=0, method-id=4097, transport-protocol=UDP
    NonSleep_Someip: service-interface=NonSleep, service-interface-id=3130, service-interface-version={major-version=1, minor-version=1}
      someip event deployment NonSleepEvent_Event: event=NonSleepEvent, event-id=4097, maximum-segment-length=0, transport-protocol=UDP
      someip method deployment GetNonSleepData_Method: method=GetNonSleepData, maximum-segment-length-request=0, maximum-segment-length-response=0, method-id=4097, transport-protocol=UDP
      someip method deployment GetNonSleepInfo_Method: method=GetNonSleepInfo, maximum-segment-length-response=0, method-id=4098, transport-protocol=UDP
      someip event group NewEventGroup: event-group-id=1, event=NonSleepEvent_Event
    OEUK_Someip: service-interface=OEUK, service-interface-id=3129, service-interface-version={major-version=1, minor-version=0}
      someip method deployment Check_OEUK_Key_Method: method=Check_OEUK_Key, maximum-segment-length-response=0, method-id=4098, transport-protocol=UDP
      someip method deployment Get_OEUK_Sign256_Method: method=Get_OEUK_Sign256, maximum-segment-length-request=0, maximum-segment-length-response=0, method-id=4097, transport-protocol=UDP
    OTA_Someip: service-interface=OTA, service-interface-id=3118, service-interface-version={major-version=1, minor-version=0}
      9 x someip method deployment, all with maximum-segment-length-response=0, transport-protocol=UDP:
        ActivateNewImage_Method: method=ActivateNewImage, method-id=4099
        BuildContainerImage_Method: method=BuildContainerImage, maximum-segment-length-request=0, method-id=4098
        FinishUpdate_Method: method=OTA/FinishUpdate, method-id=4101
        GetContainers_Method: method=GetContainers, method-id=4105
        GetImages_Method: method=GetImages, method-id=4104
        GetVersion_Method: method=OTA/GetVersion, method-id=4097
        InitUpdate_Method: method=OTA/InitUpdate, method-id=4103
        RevertBack_Method: method=RevertBack, method-id=4102
        RollingBack_Method: method=RollingBack, method-id=4100
