[part 2 of 9: package /DataType/Implementation/CPP]
AUTOSAR XML (schema 00049)
package /DataType/Implementation/CPP  (continued)
  968 x std cpp implementation data type:  (continued)
    EventSysInfo: category=STRUCTURE, type-emitter=TYPE_EMITTER_ARA
      namespaces:
        symbol props Vehicle
        symbol props IPCHandler
        symbol props RoutingIPC
      12 x cpp implementation data type element:
        timeMode: type-reference={inplace=false, type-reference=CPP/TimeMode}
        utcOffset: type-reference={inplace=false, type-reference=int16_t}
        accCnt: type-reference={inplace=false, type-reference=uint16_t}
        ign1Cnt: type-reference={inplace=false, type-reference=uint16_t}
        ign3Cnt: type-reference={inplace=false, type-reference=uint16_t}
        accOnTime: type-reference={inplace=false, type-reference=uint64_t}
        ign1OnTime: type-reference={inplace=false, type-reference=uint64_t}
        ign3OnTime: type-reference={inplace=false, type-reference=uint64_t}
        bootCnt: type-reference={inplace=false, type-reference=uint16_t}
        ethWakeupMsgReceviedEvent: type-reference={inplace=false, type-reference=bool}
        systemTickOffset: type-reference={inplace=false, type-reference=uint64_t}
        bootReasonMCU: type-reference={inplace=false, type-reference=ByteArray}
    EventTrigger: compu {texttable}, range raw 0..3, type-emitter=TYPE_EMITTER_ARA, type-reference=uint32_t
      namespaces:
        symbol props Vehicle
        symbol props NSD
        symbol props NonSleep
    ExtWireInput: category=STRUCTURE, type-emitter=TYPE_EMITTER_ARA
      namespaces:
        symbol props Vehicle
        symbol props ApSysMgr
        symbol props IOManager
      5 x cpp implementation data type element, all with type-reference={inplace=false, type-reference=bool}:
        ertAct
        wakeDCU
        wakeHU
        intr_B_ESW
        sm_FLT_IND_ESW
    ExtWireInput: category=STRUCTURE, type-emitter=TYPE_EMITTER_ARA
      namespaces:
        symbol props Vehicle
        symbol props IPCHandler
        symbol props RoutingIPC
      5 x cpp implementation data type element, all with type-reference={inplace=false, type-reference=bool}:
        ertAct
        wakeDCU
        wakeHU
        intr_B_ESW
        sm_FLT_IND_ESW
    ExtWireOutput: category=STRUCTURE, type-emitter=TYPE_EMITTER_ARA
      namespaces:
        symbol props Vehicle
        symbol props IPCHandler
        symbol props RoutingIPC
      16 x cpp implementation data type element, all with type-reference={inplace=false, type-reference=bool}:
        RESET_DCU
        WAKE_PDC
        RESET_ESW
        RESET_SWITCH1_PORT1_PHY
        RESET_SWITCH1_PORT2_PHY
        WAKE_ESW
        WAKE_SWITCH1_PORT1_PHY
        WAKE_SWITCH1_PORT2_PHY
        FWDN_ESW
        RESET_OUT_B_ESW
        WAKE_SWITCH2_PORT15_PHY
        WAKE_SWITCH2_PORT12_PHY
        WAKE_SWITCH2_PORT13_PHY
        RESET_SWITCH2_PORT15_PHY
        RESET_SWITCH2_PORT12_PHY
        RESET_SWITCH2_PORT13_PHY
    ExternalContext: category=STRUCTURE, type-emitter=TYPE_EMITTER_ARA
      namespaces:
        symbol props Vehicle
        symbol props VAM
        symbol props Mode
      cpp implementation data type element modeName: type-reference={inplace=false, type-reference=String}
      cpp implementation data type element contextName: type-reference={inplace=false, type-reference=String}
      cpp implementation data type element contextValue: type-reference={inplace=false, type-reference=String}
    ExternalPnCluster_VECTOR: category=VECTOR, cpp-template-argument=bool, type-emitter=TYPE_EMITTER_ARA
      namespaces:
        symbol props Vehicle
        symbol props ApSysMgr
        symbol props NetManager
    FGNameType: category=STRING, type-emitter=TYPE_EMITTER_ARA
      namespaces:
        symbol props ara
        symbol props sm
    FR_CMR_FRSD_01_00ms_EventData: category=STRUCTURE, type-emitter=TYPE_EMITTER_ARA
      namespaces:
        symbol props Vehicle
        symbol props SOAAdaptor
        symbol props Extended
      cpp implementation data type element pdu: type-reference={inplace=false, type-reference=FR_CMR_FRSD_01_00ms_pdu_VECTOR}  # FR_CMR_FRSD_01_00ms
    FR_CMR_FRSD_01_00ms_pdu_VECTOR: category=VECTOR, cpp-template-argument=uint8_t, type-emitter=TYPE_EMITTER_ARA
      namespaces:
        symbol props Vehicle
        symbol props SOAAdaptor
        symbol props Extended
    FR_CMR_FRSD_02_00ms_EventData: category=STRUCTURE, type-emitter=TYPE_EMITTER_ARA
      namespaces:
        symbol props Vehicle
        symbol props SOAAdaptor
        symbol props Extended
      cpp implementation data type element pdu: type-reference={inplace=false, type-reference=FR_CMR_FRSD_02_00ms_pdu_VECTOR}  # FR_CMR_FRSD_02_00ms
    FR_CMR_FRSD_02_00ms_pdu_VECTOR: category=VECTOR, cpp-template-argument=uint8_t, type-emitter=TYPE_EMITTER_ARA
      namespaces:
        symbol props Vehicle
        symbol props SOAAdaptor
        symbol props Extended
    FR_CMR_FRSD_03_00ms_EventData: category=STRUCTURE, type-emitter=TYPE_EMITTER_ARA
      namespaces:
        symbol props Vehicle
        symbol props SOAAdaptor
        symbol props Extended
      cpp implementation data type element pdu: type-reference={inplace=false, type-reference=FR_CMR_FRSD_03_00ms_pdu_VECTOR}  # FR_CMR_FRSD_03_00ms
    FR_CMR_FRSD_03_00ms_pdu_VECTOR: category=VECTOR, cpp-template-argument=uint8_t, type-emitter=TYPE_EMITTER_ARA
      namespaces:
        symbol props Vehicle
        symbol props SOAAdaptor
        symbol props Extended
    FR_CMR_FRSD_04_00ms_EventData: category=STRUCTURE, type-emitter=TYPE_EMITTER_ARA
      namespaces:
        symbol props Vehicle
        symbol props SOAAdaptor
        symbol props Extended
      cpp implementation data type element pdu: type-reference={inplace=false, type-reference=FR_CMR_FRSD_04_00ms_pdu_VECTOR}  # FR_CMR_FRSD_04_00ms
    FR_CMR_FRSD_04_00ms_pdu_VECTOR: category=VECTOR, cpp-template-argument=uint8_t, type-emitter=TYPE_EMITTER_ARA
      namespaces:
        symbol props Vehicle
        symbol props SOAAdaptor
        symbol props Extended
    FR_CMR_FRSD_05_00ms_EventData: category=STRUCTURE, type-emitter=TYPE_EMITTER_ARA
      namespaces:
        symbol props Vehicle
        symbol props SOAAdaptor
        symbol props Extended
      cpp implementation data type element pdu: type-reference={inplace=false, type-reference=FR_CMR_FRSD_05_00ms_pdu_VECTOR}  # FR_CMR_FRSD_05_00ms
    FR_CMR_FRSD_05_00ms_pdu_VECTOR: category=VECTOR, cpp-template-argument=uint8_t, type-emitter=TYPE_EMITTER_ARA
      namespaces:
        symbol props Vehicle
        symbol props SOAAdaptor
        symbol props Extended
    FR_CMR_RSD_01_00ms_EventData: category=STRUCTURE, type-emitter=TYPE_EMITTER_ARA
      namespaces:
        symbol props Vehicle
        symbol props SOAAdaptor
        symbol props Extended
      cpp implementation data type element pdu: type-reference={inplace=false, type-reference=FR_CMR_RSD_01_00ms_pdu_VECTOR}  # FR_CMR_RSD_01_00ms
    FR_CMR_RSD_01_00ms_pdu_VECTOR: category=VECTOR, cpp-template-argument=uint8_t, type-emitter=TYPE_EMITTER_ARA
      namespaces:
        symbol props Vehicle
        symbol props SOAAdaptor
        symbol props Extended
    FR_CMR_RSD_02_00ms_EventData: category=STRUCTURE, type-emitter=TYPE_EMITTER_ARA
      namespaces:
        symbol props Vehicle
        symbol props SOAAdaptor
        symbol props Extended
      cpp implementation data type element pdu: type-reference={inplace=false, type-reference=FR_CMR_RSD_02_00ms_pdu_VECTOR}  # FR_CMR_RSD_02_00ms
    FR_CMR_RSD_02_00ms_pdu_VECTOR: category=VECTOR, cpp-template-argument=uint8_t, type-emitter=TYPE_EMITTER_ARA
      namespaces:
        symbol props Vehicle
        symbol props SOAAdaptor
        symbol props Extended
    FR_CMR_RSD_03_00ms_EventData: category=STRUCTURE, type-emitter=TYPE_EMITTER_ARA
      namespaces:
        symbol props Vehicle
        symbol props SOAAdaptor
        symbol props Extended
      cpp implementation data type element pdu: type-reference={inplace=false, type-reference=FR_CMR_RSD_03_00ms_pdu_VECTOR}  # FR_CMR_RSD_03_00ms
    FR_CMR_RSD_03_00ms_pdu_VECTOR: category=VECTOR, cpp-template-argument=uint8_t, type-emitter=TYPE_EMITTER_ARA
      namespaces:
        symbol props Vehicle
        symbol props SOAAdaptor
        symbol props Extended
    FR_CMR_RSD_04_00ms_EventData: category=STRUCTURE, type-emitter=TYPE_EMITTER_ARA
      namespaces:
        symbol props Vehicle
        symbol props SOAAdaptor
        symbol props Extended
      cpp implementation data type element pdu: type-reference={inplace=false, type-reference=FR_CMR_RSD_04_00ms_pdu_VECTOR}  # FR_CMR_RSD_04_00ms
    FR_CMR_RSD_04_00ms_pdu_VECTOR: category=VECTOR, cpp-template-argument=uint8_t, type-emitter=TYPE_EMITTER_ARA
      namespaces:
        symbol props Vehicle
        symbol props SOAAdaptor
        symbol props Extended
    FR_CMR_RSD_05_00ms_EventData: category=STRUCTURE, type-emitter=TYPE_EMITTER_ARA
      namespaces:
        symbol props Vehicle
        symbol props SOAAdaptor
        symbol props Extended
      cpp implementation data type element pdu: type-reference={inplace=false, type-reference=FR_CMR_RSD_05_00ms_pdu_VECTOR}  # FR_CMR_RSD_05_00ms
    FR_CMR_RSD_05_00ms_pdu_VECTOR: category=VECTOR, cpp-template-argument=uint8_t, type-emitter=TYPE_EMITTER_ARA
      namespaces:
        symbol props Vehicle
        symbol props SOAAdaptor
        symbol props Extended
    FR_CMR_RSD_06_00ms_EventData: category=STRUCTURE, type-emitter=TYPE_EMITTER_ARA
      namespaces:
        symbol props Vehicle
        symbol props SOAAdaptor
        symbol props Extended
      cpp implementation data type element pdu: type-reference={inplace=false, type-reference=FR_CMR_RSD_06_00ms_pdu_VECTOR}  # FR_CMR_RSD_06_00ms
    FR_CMR_RSD_06_00ms_pdu_VECTOR: category=VECTOR, cpp-template-argument=uint8_t, type-emitter=TYPE_EMITTER_ARA
      namespaces:
        symbol props Vehicle
        symbol props SOAAdaptor
        symbol props Extended
    FR_CMR_RSD_07_00ms_EventData: category=STRUCTURE, type-emitter=TYPE_EMITTER_ARA
      namespaces:
        symbol props Vehicle
        symbol props SOAAdaptor
        symbol props Extended
      cpp implementation data type element pdu: type-reference={inplace=false, type-reference=FR_CMR_RSD_07_00ms_pdu_VECTOR}  # FR_CMR_RSD_07_00ms
    FR_CMR_RSD_07_00ms_pdu_VECTOR: category=VECTOR, cpp-template-argument=uint8_t, type-emitter=TYPE_EMITTER_ARA
      namespaces:
        symbol props Vehicle
        symbol props SOAAdaptor
        symbol props Extended
    FR_CMR_RSD_08_00ms_EventData: category=STRUCTURE, type-emitter=TYPE_EMITTER_ARA
      namespaces:
        symbol props Vehicle
        symbol props SOAAdaptor
        symbol props Extended
      cpp implementation data type element pdu: type-reference={inplace=false, type-reference=FR_CMR_RSD_08_00ms_pdu_VECTOR}  # FR_CMR_RSD_08_00ms
    FR_CMR_RSD_08_00ms_pdu_VECTOR: category=VECTOR, cpp-template-argument=uint8_t, type-emitter=TYPE_EMITTER_ARA
      namespaces:
        symbol props Vehicle
        symbol props SOAAdaptor
        symbol props Extended
    FieldStatus: compu {texttable}, range raw 0..1, type-emitter=TYPE_EMITTER_ARA, type-reference=uint32_t
      namespaces:
        symbol props Vehicle
        symbol props VAM
        symbol props Mode
    FileInfo: category=STRUCTURE, type-emitter=TYPE_EMITTER_ARA
      namespaces:
        symbol props BltnCam
        symbol props DrivingEvent
        symbol props Manager
      cpp implementation data type element fileIndex: type-reference={inplace=false, type-reference=CPP/Video_Thumbnail_Index}
      cpp implementation data type element filename: type-reference={inplace=false, type-reference=String}
      cpp implementation data type element size: type-reference={inplace=false, type-reference=uint32_t}
    FileInfo: category=STRUCTURE, type-emitter=TYPE_EMITTER_ARA
      namespaces:
        symbol props BltnCam
        symbol props ParkingEvent
        symbol props Manager
      cpp implementation data type element fileIndex: type-reference={inplace=false, type-reference=CPP/Video_Thumbnail_Index}
      cpp implementation data type element filename: type-reference={inplace=false, type-reference=String}
      cpp implementation data type element size: type-reference={inplace=false, type-reference=uint32_t}
    Fix2dIndicator: compu {texttable}, range raw 0..1, type-emitter=TYPE_EMITTER_ARA, type-reference=uint32_t
      namespaces:
        symbol props Vehicle
        symbol props IPCHandler
        symbol props RoutingIPC
    FixSource: compu {texttable}, range raw 0..17, type-emitter=TYPE_EMITTER_ARA, type-reference=uint32_t
      namespaces:
        symbol props Vehicle
        symbol props IPCHandler
        symbol props RoutingIPC
    FoDMenu_VECTOR: category=VECTOR, cpp-template-argument=CPP/KeyValue, type-emitter=TYPE_EMITTER_ARA
      namespaces:
        symbol props CCU
        symbol props FoD
        symbol props Screen
    FoDPackage_VECTOR: category=VECTOR, cpp-template-argument=CPP/KeyValue, type-emitter=TYPE_EMITTER_ARA
      namespaces:
        symbol props CCU
        symbol props FoD
        symbol props Screen
    FodModeType: compu {texttable}, range raw 0..4, type-emitter=TYPE_EMITTER_ARA, type-reference=uint32_t
      namespaces:
        symbol props Vehicle
        symbol props ApSysMgr
        symbol props NetManager
    FodResponse: compu {texttable}, range raw 0..114, type-emitter=TYPE_EMITTER_ARA, type-reference=uint32_t
      namespaces:
        symbol props Vehicle
        symbol props FoDClient
        symbol props ActivationManager
    FodVinMsg: category=STRUCTURE, type-emitter=TYPE_EMITTER_ARA
      namespaces:
        symbol props Vehicle
        symbol props FoDMaster
        symbol props Support
      cpp implementation data type element status: type-reference={inplace=false, type-reference=FodVinStatus}
      cpp implementation data type element fodVin: type-reference={inplace=false, type-reference=String}
    FodVinStatus: compu {texttable}, range raw 0..2, type-emitter=TYPE_EMITTER_ARA, type-reference=uint32_t
      namespaces:
        symbol props Vehicle
        symbol props FoDMaster
        symbol props Support
    FuelEconomyUnit: compu {texttable}, range raw 0..10, type-emitter=TYPE_EMITTER_ARA, type-reference=uint32_t
      namespaces:
        symbol props Info
        symbol props Cluster
        symbol props InformationProvider
    FuelStatusInfo: category=STRUCTURE, type-emitter=TYPE_EMITTER_ARA
      namespaces:
        symbol props Info
        symbol props Cluster
        symbol props InformationProvider
      cpp implementation data type element LowFuelStatus: type-reference={inplace=false, type-reference=String}
      cpp implementation data type element FuelLevel: type-reference={inplace=false, type-reference=float}
    FunctionGroupList: category=VECTOR, cpp-template-argument=FGNameType, type-emitter=TYPE_EMITTER_ARA
      namespaces:
        symbol props ara
        symbol props sm
    FunctionGroupStateInfo: category=STRUCTURE, type-emitter=TYPE_EMITTER_ARA
      namespaces:
        symbol props ara
        symbol props sm
      cpp implementation data type element functionGroup: type-reference={inplace=false, type-reference=String}
      cpp implementation data type element state: type-reference={inplace=false, type-reference=String}
    FunctionGroupStates: category=STRING, type-emitter=TYPE_EMITTER_ARA
      namespaces:
        symbol props ara
        symbol props sm
    GNSS_07_100ms_EventData: category=STRUCTURE, type-emitter=TYPE_EMITTER_ARA
      namespaces:
        symbol props Vehicle
        symbol props SOAAdaptor
        symbol props MultiMedia
      cpp implementation data type element pdu: type-reference={inplace=false, type-reference=GNSS_07_100ms_pdu_VECTOR}
    GNSS_07_100ms_pdu_VECTOR: category=VECTOR, cpp-template-argument=uint8_t, type-emitter=TYPE_EMITTER_ARA
      namespaces:
        symbol props Vehicle
        symbol props SOAAdaptor
        symbol props MultiMedia
    GPSAntenaStatusType: compu {texttable}, range raw 0..1, type-emitter=TYPE_EMITTER_ARA, type-reference=uint32_t
      namespaces:
        symbol props Vehicle
        symbol props SOAAdaptor
        symbol props Location
    GPSStatus: compu {texttable}, range raw 0..2, type-emitter=TYPE_EMITTER_ARA, type-reference=uint32_t
      namespaces:
        symbol props Vehicle
        symbol props SOAAdaptor
        symbol props Location
    GetACNSignallist_dataList_VECTOR: category=VECTOR, cpp-template-argument=ACNSignal, type-emitter=TYPE_EMITTER_ARA
      namespaces:
        symbol props CCU
        symbol props Vehicle
        symbol props S2S
    GetAllReceiveMessages_item_VECTOR: category=VECTOR, cpp-template-argument=MessageItem, type-emitter=TYPE_EMITTER_ARA
      namespaces:
        symbol props DCU
        symbol props Telephony
        symbol props MessageManager
    GetBattNumInfo_dataList_VECTOR: category=VECTOR, cpp-template-argument=NemsBattNumInfo, type-emitter=TYPE_EMITTER_ARA
      namespaces:
        symbol props CCU
        symbol props Vehicle
        symbol props S2S
    GetContextError: compu {texttable}, range raw 0..3, type-emitter=TYPE_EMITTER_ARA, type-reference=uint32_t
      namespaces:
        symbol props DCU
        symbol props Telephony
        symbol props MessageManager
    GetContextError: compu {texttable}, range raw 0..3, type-emitter=TYPE_EMITTER_ARA, type-reference=uint32_t
      namespaces:
        symbol props DCU
        symbol props Telephony
        symbol props EngineeringMode
    GetContextError: compu {texttable}, range raw 0..3, type-emitter=TYPE_EMITTER_ARA, type-reference=uint32_t
      namespaces:
        symbol props DCU
        symbol props Telephony
        symbol props VoiceCallManager
    GetContextError: compu {texttable}, range raw 0..3, type-emitter=TYPE_EMITTER_ARA, type-reference=uint32_t
      namespaces:
        symbol props DCU
        symbol props Telephony
        symbol props SimManager
    GetContextError: compu {texttable}, range raw 0..3, type-emitter=TYPE_EMITTER_ARA, type-reference=uint32_t
      namespaces:
        symbol props DCU
        symbol props Telephony
        symbol props ConnectionContext
    GetContextError: compu {texttable}, range raw 0..3, type-emitter=TYPE_EMITTER_ARA, type-reference=uint32_t
      namespaces:
        symbol props DCU
        symbol props Telephony
        symbol props ConnectionManager
    GetContextError: compu {texttable}, range raw 0..3, type-emitter=TYPE_EMITTER_ARA, type-reference=uint32_t
      namespaces:
        symbol props DCU
        symbol props Telephony
        symbol props NetworkInformation
    GetContextError: compu {texttable}, range raw 0..3, type-emitter=TYPE_EMITTER_ARA, type-reference=uint32_t
      namespaces:
        symbol props DCU
        symbol props Telephony
        symbol props ModemManager
    GetContexts_items_VECTOR: category=VECTOR, cpp-template-argument=CPP/ConnectionContextItem, type-emitter=TYPE_EMITTER_ARA
      namespaces:
        symbol props DCU
        symbol props Telephony
        symbol props ConnectionManager
    GetHistoryType: category=STRUCTURE, type-emitter=TYPE_EMITTER_ARA
      namespaces:
        symbol props Vehicle
        symbol props CM
        symbol props PackageManagement
      5 x cpp implementation data type element:
        Time: type-reference={inplace=false, type-reference=uint64_t}
        Name: type-reference={inplace=false, type-reference=CPP/SwNameType}
        Version: type-reference={inplace=false, type-reference=CPP/StrongRevisionLabelString}
        Action: type-reference={inplace=false, type-reference=CPP/ActionType}
        Resolution: type-reference={inplace=false, type-reference=CPP/ResultType}
    GetHistoryType: category=STRUCTURE, type-emitter=TYPE_EMITTER_ARA
      namespaces:
        symbol props ara
        symbol props ucm
        symbol props pkgmgr
      5 x cpp implementation data type element:
        Time: type-reference={inplace=false, type-reference=uint64_t}
        Name: type-reference={inplace=false, type-reference=CPP/SwNameType}
        Version: type-reference={inplace=false, type-reference=CPP/StrongRevisionLabelString}
        Action: type-reference={inplace=false, type-reference=CPP/ActionType}
        Resolution: type-reference={inplace=false, type-reference=CPP/ResultType}
    GetHistoryVectorType: category=VECTOR, cpp-template-argument=CPP/GetHistoryType, type-emitter=TYPE_EMITTER_ARA
      namespaces:
        symbol props Vehicle
        symbol props CM
        symbol props PackageManagement
    GetHistoryVectorType: category=VECTOR, cpp-template-argument=CPP/GetHistoryType, type-emitter=TYPE_EMITTER_ARA
      namespaces:
        symbol props ara
        symbol props ucm
        symbol props pkgmgr
    GetLinkStatus_ports_VECTOR: category=VECTOR, cpp-template-argument=PortID, type-emitter=TYPE_EMITTER_ARA
      namespaces:
        symbol props Vehicle
        symbol props EthHandler
        symbol props EthernetSwitchMgr
    GetMOFKeyListByTable_values_VECTOR: category=VECTOR, cpp-template-argument=String, type-emitter=TYPE_EMITTER_ARA
      namespaces:
        symbol props Vehicle
        symbol props Telemanager
        symbol props Provisioning
    GetMOFTableList_values_VECTOR: category=VECTOR, cpp-template-argument=String, type-emitter=TYPE_EMITTER_ARA
      namespaces:
        symbol props Vehicle
        symbol props Telemanager
        symbol props Provisioning
    GetNetworkStatisticsAll_stat_VECTOR: category=VECTOR, cpp-template-argument=NetworkVccStatistics, type-emitter=TYPE_EMITTER_ARA
      namespaces:
        symbol props Vehicle
        symbol props Vcc
        symbol props NetworkStatistics
    GetNfsClientStatus_nfsClientStatuses_VECTOR: category=VECTOR, cpp-template-argument=NfsClientStatus, type-emitter=TYPE_EMITTER_ARA
      namespaces:
        symbol props Vehicle
        symbol props SharedStorage
        symbol props Status
    GetNonSleepData_data_VECTOR: category=VECTOR, cpp-template-argument=uint8_t, type-emitter=TYPE_EMITTER_ARA
      namespaces:
        symbol props Vehicle
        symbol props NSD
        symbol props NonSleep
    GetPDUlist_busAndMessageIds_VECTOR: category=VECTOR, cpp-template-argument=BusAndMessageId_DR, type-emitter=TYPE_EMITTER_ARA
      namespaces:
        symbol props Vehicle
        symbol props SOAAdaptor
        symbol props DynamicRouting
    GetPDUlist_messageInfo_VECTOR: category=VECTOR, cpp-template-argument=MessageInfo_DR, type-emitter=TYPE_EMITTER_ARA
      namespaces:
        symbol props Vehicle
        symbol props SOAAdaptor
        symbol props DynamicRouting
    GetProperty_valueinfo_VECTOR: category=VECTOR, cpp-template-argument=String, type-emitter=TYPE_EMITTER_ARA
      namespaces:
        symbol props CCU
        symbol props System
        symbol props EngineeringMode
    GetPropulsionStorage_bms_VECTOR: category=VECTOR, cpp-template-argument=uint64_t, type-emitter=TYPE_EMITTER_ARA
      namespaces:
        symbol props CCU
        symbol props Vehicle
        symbol props S2S
    GetPropulsionStorage_fcu_VECTOR: category=VECTOR, cpp-template-argument=uint64_t, type-emitter=TYPE_EMITTER_ARA
      namespaces:
        symbol props CCU
        symbol props Vehicle
        symbol props S2S
    GetPropulsionStorage_hcu_VECTOR: category=VECTOR, cpp-template-argument=uint64_t, type-emitter=TYPE_EMITTER_ARA
      namespaces:
        symbol props CCU
        symbol props Vehicle
        symbol props S2S
    GetPropulsionStorage_vcu_VECTOR: category=VECTOR, cpp-template-argument=uint64_t, type-emitter=TYPE_EMITTER_ARA
      namespaces:
        symbol props CCU
        symbol props Vehicle
        symbol props S2S
    GetReceiveMessage_msgID_VECTOR: category=VECTOR, cpp-template-argument=String, type-emitter=TYPE_EMITTER_ARA
      namespaces:
        symbol props Vehicle
        symbol props MSM
        symbol props MessageManager
    GetReceiveMessage_smsinfo_VECTOR: category=VECTOR, cpp-template-argument=SMSInformation, type-emitter=TYPE_EMITTER_ARA
      namespaces:
        symbol props Vehicle
        symbol props MSM
        symbol props MessageManager
    GetSQI_ports_VECTOR: category=VECTOR, cpp-template-argument=PortID, type-emitter=TYPE_EMITTER_ARA
      namespaces:
        symbol props Vehicle
        symbol props EthHandler
        symbol props EthernetSwitchMgr
    GetSwitchIVD_switchIVD_VECTOR: category=VECTOR, cpp-template-argument=uint8_t, type-emitter=TYPE_EMITTER_ARA
      namespaces:
        symbol props Vehicle
        symbol props EthHandler
        symbol props EthernetSwitchMgr
    GetTopicInformation_topics_VECTOR: category=VECTOR, cpp-template-argument=CCMQTTTopicInformation, type-emitter=TYPE_EMITTER_ARA
      namespaces:
        symbol props Vehicle
        symbol props Telemanager
        symbol props MQTT
    GetVersion_swNameVersion_VECTOR: category=VECTOR, cpp-template-argument=CPP/SwNameVersionType, type-emitter=TYPE_EMITTER_ARA
      namespaces:
        symbol props Vehicle
        symbol props SelfUpdateEngine
        symbol props DeltaUpdate
    GetWireStatus_ports_VECTOR: category=VECTOR, cpp-template-argument=PortID, type-emitter=TYPE_EMITTER_ARA
      namespaces:
        symbol props Vehicle
        symbol props EthHandler
        symbol props EthernetSwitchMgr
    GetWorstSQI_ports_VECTOR: category=VECTOR, cpp-template-argument=PortID, type-emitter=TYPE_EMITTER_ARA
      namespaces:
        symbol props Vehicle
        symbol props EthHandler
        symbol props EthernetSwitchMgr
    GnssFixStatus: compu {texttable}, range raw 0..8, type-emitter=TYPE_EMITTER_ARA, type-reference=uint32_t
      namespaces:
        symbol props Vehicle
        symbol props IPCHandler
        symbol props RoutingIPC
    GroupTypes: compu {texttable}, range raw 0..11, type-emitter=TYPE_EMITTER_ARA, type-reference=uint32_t
      namespaces:
        symbol props Vehicle
        symbol props Vcc
        symbol props Policy
    GroupTypes: compu {texttable}, range raw 0..11, type-emitter=TYPE_EMITTER_ARA, type-reference=uint32_t
      namespaces:
        symbol props Vehicle
        symbol props Vcc
        symbol props Manager
    GroupTypes: compu {texttable}, range raw 0..11, type-emitter=TYPE_EMITTER_ARA, type-reference=uint32_t
      namespaces:
        symbol props Vehicle
        symbol props Vcc
        symbol props ServiceGroup
    HigherPriorityDiagnosisServiceStarted_EventData: category=STRUCTURE, type-emitter=TYPE_EMITTER_ARA
      namespaces:
        symbol props CCU
        symbol props Vehicle
        symbol props DiagnosticRouting
      cpp implementation data type element currentPriority: type-reference={inplace=false, type-reference=uint32_t}
    HistoryVectorType: category=STRUCTURE, type-emitter=TYPE_EMITTER_ARA
      namespaces:
        symbol props Vehicle
        symbol props CM
        symbol props PackageManagement
      cpp implementation data type element id: type-reference={inplace=false, type-reference=CPP/UCMIdentifierType}
      cpp implementation data type element HistoryVector: type-reference={inplace=false, type-reference=CPP/GetHistoryVectorType}
    HistoryVectorType: category=STRUCTURE, type-emitter=TYPE_EMITTER_ARA
      namespaces:
        symbol props ara
        symbol props ucm
        symbol props pkgmgr
      cpp implementation data type element id: type-reference={inplace=false, type-reference=CPP/UCMIdentifierType}
      cpp implementation data type element HistoryVector: type-reference={inplace=false, type-reference=CPP/GetHistoryVectorType}
    IMU_01_10ms_EventData: category=STRUCTURE, type-emitter=TYPE_EMITTER_ARA
      namespaces:
        symbol props Vehicle
        symbol props SOAAdaptor
        symbol props Extended
      cpp implementation data type element pdu: type-reference={inplace=false, type-reference=IMU_01_10ms_pdu_VECTOR}  # IMU_01_10ms
    IMU_01_10ms_pdu_VECTOR: category=VECTOR, cpp-template-argument=uint8_t, type-emitter=TYPE_EMITTER_ARA
      namespaces:
        symbol props Vehicle
        symbol props SOAAdaptor
        symbol props Extended
    IPV6_Settings_DomainNameServers_VECTOR: category=VECTOR, cpp-template-argument=String, type-emitter=TYPE_EMITTER_ARA
      namespaces:
        symbol props DCU
        symbol props Telephony
        symbol props ConnectionContext
    IVPErrorType: compu {texttable}, range raw 0..3, type-emitter=TYPE_EMITTER_ARA, type-reference=uint32_t
      namespaces:
        symbol props Vehicle
        symbol props IPCHandler
        symbol props RoutingIPC
    IVPInfoType: compu {texttable}, range raw 0..2, type-emitter=TYPE_EMITTER_ARA, type-reference=uint32_t
      namespaces:
        symbol props Vehicle
        symbol props IPCHandler
        symbol props RoutingIPC
    IfaceState: category=ASSOCIATIVE_MAP, type-emitter=TYPE_EMITTER_ARA
      namespaces:
        symbol props DCU
        symbol props System
        symbol props Variation
      template-arguments:
        category=ASSOC_MAP_KEY, template-type=String
        category=ASSOC_MAP_VALUE, template-type=CPP/OperState
    IfaceState: category=ASSOCIATIVE_MAP, type-emitter=TYPE_EMITTER_ARA
      namespaces:
        symbol props DCU
        symbol props System
        symbol props Time
      template-arguments:
        category=ASSOC_MAP_KEY, template-type=String
        category=ASSOC_MAP_VALUE, template-type=CPP/OperState
    IfaceState: category=ASSOCIATIVE_MAP, type-emitter=TYPE_EMITTER_ARA
      namespaces:
        symbol props DCU
        symbol props System
        symbol props PowerManagement
      template-arguments:
        category=ASSOC_MAP_KEY, template-type=String
        category=ASSOC_MAP_VALUE, template-type=CPP/OperState
    IfaceState: category=ASSOCIATIVE_MAP, type-emitter=TYPE_EMITTER_ARA
      namespaces:
        symbol props CCU
        symbol props System
        symbol props EngineeringMode
      template-arguments:
        category=ASSOC_MAP_KEY, template-type=String
        category=ASSOC_MAP_VALUE, template-type=CPP/OperState
    InfoSystemTime: category=STRUCTURE, type-emitter=TYPE_EMITTER_ARA
      namespaces:
        symbol props Vehicle
        symbol props IPCHandler
        symbol props RoutingIPC
      7 x cpp implementation data type element, all with type-reference={inplace=false, type-reference=int16_t}:
        sec
        min
        hour
        mday
        mon
        year
        utcOffset
    InfoSystemTimeStatus: category=STRUCTURE, type-emitter=TYPE_EMITTER_ARA
      namespaces:
        symbol props Vehicle
        symbol props IPCHandler
        symbol props RoutingIPC
      4 x cpp implementation data type element:
        infoSystemTime: type-reference={inplace=false, type-reference=InfoSystemTime}
        gnssFixStatus: type-reference={inplace=false, type-reference=GnssFixStatus}
        locationFixStatus: type-reference={inplace=false, type-reference=LocationFixStatus}
        timeSource: type-reference={inplace=false, type-reference=CPP/TimeSource}
    InfrastructureEnvironments: compu {texttable}, range raw 0..3, type-emitter=TYPE_EMITTER_ARA, type-reference=uint32_t
      namespaces:
        symbol props Info
        symbol props Cloud
        symbol props EngineeringMode
    InfrastructureEnvironments: compu {texttable}, range raw 0..3, type-emitter=TYPE_EMITTER_ARA, type-reference=uint32_t
      namespaces:
        symbol props Info
        symbol props Cloud
        symbol props ProvisioningTable
    InternalPnCluster_VECTOR: category=VECTOR, cpp-template-argument=bool, type-emitter=TYPE_EMITTER_ARA
      namespaces:
        symbol props Vehicle
        symbol props ApSysMgr
        symbol props NetManager
    IoStats: category=STRUCTURE, type-emitter=TYPE_EMITTER_ARA
      namespaces:
        symbol props Vehicle
        symbol props SharedStorage
        symbol props Status
      cpp implementation data type element read: type-reference={inplace=false, type-reference=uint64_t}
      cpp implementation data type element write: type-reference={inplace=false, type-reference=uint64_t}
    IsCompleteDebugSnapshot_EventData: category=STRUCTURE, type-emitter=TYPE_EMITTER_ARA
      namespaces:
        symbol props Vehicle
        symbol props LogCollection
        symbol props DebugSnapshot
      cpp implementation data type element appId: type-reference={inplace=false, type-reference=String}
      cpp implementation data type element folder_name: type-reference={inplace=false, type-reference=String}
    ItemContentsMap: category=ASSOCIATIVE_MAP, template-arguments=[{category=ASSOC_MAP_KEY, template-type=String}, {category=ASSOC_MAP_VALUE, template-type=String}], type-emitter=TYPE_EMITTER_ARA  # "contents":"title1 \n title2 \n title3 \n＂
      namespaces:
        symbol props CCU
        symbol props Update
        symbol props Screen
    JourneyDistanceStr_VECTOR: category=VECTOR, cpp-template-argument=DistanceStrInfo, type-emitter=TYPE_EMITTER_ARA
      namespaces:
        symbol props Info
        symbol props Cluster
        symbol props InformationProvider
    JourneyDistance_VECTOR: category=VECTOR, cpp-template-argument=DistanceInfo, type-emitter=TYPE_EMITTER_ARA
      namespaces:
        symbol props Info
        symbol props Cluster
        symbol props InformationProvider
    JourneyTime_VECTOR: category=VECTOR, cpp-template-argument=CPP/TimeInfo, type-emitter=TYPE_EMITTER_ARA
      namespaces:
        symbol props Info
        symbol props Cluster
        symbol props InformationProvider
    KeyValue: category=ASSOCIATIVE_MAP, template-arguments=[{category=ASSOC_MAP_KEY, template-type=String}, {category=ASSOC_MAP_VALUE, template-type=String}], type-emitter=TYPE_EMITTER_ARA
      namespaces:
        symbol props Info
        symbol props System
        symbol props Variant
    KeyValue: category=ASSOCIATIVE_MAP, template-arguments=[{category=ASSOC_MAP_KEY, template-type=String}, {category=ASSOC_MAP_VALUE, template-type=String}], type-emitter=TYPE_EMITTER_ARA
      namespaces:
        symbol props Info
        symbol props Cluster
        symbol props InformationProvider
    KeyValue: category=ASSOCIATIVE_MAP, template-arguments=[{category=ASSOC_MAP_KEY, template-type=String}, {category=ASSOC_MAP_VALUE, template-type=String}], type-emitter=TYPE_EMITTER_ARA
      namespaces:
        symbol props CCU
        symbol props FoD
        symbol props Screen
    KeyValue: category=ASSOCIATIVE_MAP, template-arguments=[{category=ASSOC_MAP_KEY, template-type=String}, {category=ASSOC_MAP_VALUE, template-type=String}], type-emitter=TYPE_EMITTER_ARA
      namespaces:
        symbol props CCU
        symbol props Cloud
        symbol props ProvisioningTable
    KeyValue: category=ASSOCIATIVE_MAP, template-arguments=[{category=ASSOC_MAP_KEY, template-type=String}, {category=ASSOC_MAP_VALUE, template-type=String}], type-emitter=TYPE_EMITTER_ARA
      namespaces:
        symbol props Info
        symbol props Cloud
        symbol props EngineeringMode
    KeyValue: category=ASSOCIATIVE_MAP, template-arguments=[{category=ASSOC_MAP_KEY, template-type=String}, {category=ASSOC_MAP_VALUE, template-type=int32_t}], type-emitter=TYPE_EMITTER_ARA
      namespaces:
        symbol props Info
        symbol props Setup
        symbol props GeneralSettings
    KeyValue: category=ASSOCIATIVE_MAP, template-arguments=[{category=ASSOC_MAP_KEY, template-type=String}, {category=ASSOC_MAP_VALUE, template-type=String}], type-emitter=TYPE_EMITTER_ARA
      namespaces:
        symbol props Info
        symbol props Cloud
        symbol props ProvisioningTable
    KeyValueFloat: category=ASSOCIATIVE_MAP, template-arguments=[{category=ASSOC_MAP_KEY, template-type=String}, {category=ASSOC_MAP_VALUE, template-type=float}], type-emitter=TYPE_EMITTER_ARA
      namespaces:
        symbol props Info
        symbol props Cluster
        symbol props InformationProvider
    KeyValueMap: category=ASSOCIATIVE_MAP, template-arguments=[{category=ASSOC_MAP_KEY, template-type=String}, {category=ASSOC_MAP_VALUE, template-type=String}], type-emitter=TYPE_EMITTER_ARA
      namespaces:
        symbol props Info
        symbol props Update
        symbol props RFSManager
    KeyValueMap: category=ASSOCIATIVE_MAP, template-arguments=[{category=ASSOC_MAP_KEY, template-type=String}, {category=ASSOC_MAP_VALUE, template-type=String}], type-emitter=TYPE_EMITTER_ARA
      namespaces:
        symbol props Info
        symbol props Update
        symbol props InteractionManager
    KeyValueMap: category=ASSOCIATIVE_MAP, template-arguments=[{category=ASSOC_MAP_KEY, template-type=String}, {category=ASSOC_MAP_VALUE, template-type=String}], type-emitter=TYPE_EMITTER_ARA
      namespaces:
        symbol props CCU
        symbol props Mode
        symbol props Routines
    KeyValueString: category=ASSOCIATIVE_MAP, template-arguments=[{category=ASSOC_MAP_KEY, template-type=String}, {category=ASSOC_MAP_VALUE, template-type=String}], type-emitter=TYPE_EMITTER_ARA
      namespaces:
        symbol props Info
        symbol props Setup
        symbol props GeneralSettings
    KvsPolicyDownloaded_EventData: category=STRUCTURE, type-emitter=TYPE_EMITTER_ARA
      namespaces:
        symbol props Vehicle
        symbol props DPM
        symbol props Policy
      cpp implementation data type element newVersion: type-reference={inplace=false, type-reference=uint32_t}
    LanguageStatusInfo: category=STRUCTURE, type-emitter=TYPE_EMITTER_ARA
      namespaces:
        symbol props Info
        symbol props Cluster
        symbol props InformationProvider
      cpp implementation data type element currentlanguage: type-reference={inplace=false, type-reference=String}
      cpp implementation data type element status: type-reference={inplace=false, type-reference=uint8_t}
    LocationAccuracyData: category=STRUCTURE, type-emitter=TYPE_EMITTER_ARA
      namespaces:
        symbol props Info
        symbol props Location
        symbol props GNSS
      4 x cpp implementation data type element, all with type-reference={inplace=false, type-reference=uint16_t}:
        position_accuracy  # Unit : 1 m
        altitude_accuracy  # Unit : 1 m
        heading_accuracy  # Unit : 2^(-15) sc, Range : [0, 2) sc
        speed_accuracy  # Unit : 1 cm/s
    LocationData: category=STRUCTURE, type-emitter=TYPE_EMITTER_ARA
      namespaces:
        symbol props Info
        symbol props Location
        symbol props GNSS
      5 x cpp implementation data type element:
        longitude: type-reference={inplace=false, type-reference=int32_t}  # Unit : 2^(-31) sc
        latitude: type-reference={inplace=false, type-reference=int32_t}  # Unit : 2^(-31) sc
        altitude: type-reference={inplace=false, type-reference=int32_t}  # Unit : 1 m
        speed: type-reference={inplace=false, type-reference=int16_t}  # Unit : 1 cm/s
        heading: type-reference={inplace=false, type-reference=int16_t}  # Unit : 2^(-15) sc
    LocationFixData: category=STRUCTURE, type-emitter=TYPE_EMITTER_ARA
      namespaces:
        symbol props Info
        symbol props Location
        symbol props GNSS
      cpp implementation data type element fix_source: type-reference={inplace=false, type-reference=bool}  # 0 = No Fix, 17 = Fix Valid
      cpp implementation data type element fix_2D_indicator: type-reference={inplace=false, type-reference=bool}  # Field valid only if Fix Source is 17, 0 = 3D Fix, 1 = 2D Fix
    LocationFixStatus: category=STRUCTURE, type-emitter=TYPE_EMITTER_ARA
      namespaces:
        symbol props Vehicle
        symbol props IPCHandler
        symbol props RoutingIPC
      cpp implementation data type element fixStatus: type-reference={inplace=false, type-reference=FixSource}
      cpp implementation data type element fix2dIndicator: type-reference={inplace=false, type-reference=Fix2dIndicator}
    LocationInfo: category=STRUCTURE, type-emitter=TYPE_EMITTER_ARA
      namespaces:
        symbol props Vehicle
        symbol props SOAAdaptor
        symbol props Location
      10 x cpp implementation data type element:
        latitude: type-reference={inplace=false, type-reference=int32_t}
        longitude: type-reference={inplace=false, type-reference=int32_t}
        altitude: type-reference={inplace=false, type-reference=int32_t}
        speed: type-reference={inplace=false, type-reference=uint16_t}
        heading: type-reference={inplace=false, type-reference=uint32_t}
        status: type-reference={inplace=false, type-reference=GPSStatus}
        numberOfStatllite: type-reference={inplace=false, type-reference=uint8_t}
        pdop: type-reference={inplace=false, type-reference=uint16_t}
        hdop: type-reference={inplace=false, type-reference=uint16_t}
        vdop: type-reference={inplace=false, type-reference=uint16_t}
    LocationStatusData: category=STRUCTURE, type-emitter=TYPE_EMITTER_ARA
      namespaces:
        symbol props Info
        symbol props Location
        symbol props GNSS
      5 x cpp implementation data type element, all with type-reference={inplace=false, type-reference=bool}:
        dgps_status  # The state of DGPS, 1 : DGPS-corrected
        position_status  # The state of position, 1 : valid
        altitude_status  # The state of altitude, 1 : valid
        heading_status  # The state of heading, 1 : valid
        speed_status  # The state value of speedState, 1 : valid
    LocationTime: category=STRUCTURE, type-emitter=TYPE_EMITTER_ARA
      namespaces:
        symbol props Info
        symbol props Location
        symbol props Time
      6 x cpp implementation data type element:
        year: type-reference={inplace=false, type-reference=int16_t}  # Year
        mon: type-reference={inplace=false, type-reference=int8_t}  # Month(1,,12)
        mday: type-reference={inplace=false, type-reference=int8_t}  # Day of Month(1,,31)
        hour: type-reference={inplace=false, type-reference=int8_t}  # Hours(0,,23)
        min: type-reference={inplace=false, type-reference=int8_t}  # Minutes(0,,59)
        sec: type-reference={inplace=false, type-reference=int8_t}  # Seconds(0,,59)
    LogAction: category=STRUCTURE, type-emitter=TYPE_EMITTER_ARA
      namespaces:
        symbol props Info
        symbol props System
        symbol props Variant
      4 x cpp implementation data type element:
        transactionID: type-reference={inplace=false, type-reference=String}
        logtype: type-reference={inplace=false, type-reference=CPP/LogType}
        endpoint: type-reference={inplace=false, type-reference=CPP/EndpointType}
        status: type-reference={inplace=false, type-reference=CPP/LogStatus}
    LogAction: category=STRUCTURE, type-emitter=TYPE_EMITTER_ARA
      namespaces:
        symbol props Info
        symbol props System
        symbol props EngineeringMode
      4 x cpp implementation data type element:
        transactionID: type-reference={inplace=false, type-reference=String}
        logtype: type-reference={inplace=false, type-reference=CPP/LogType}
        endpoint: type-reference={inplace=false, type-reference=CPP/EndpointType}
        status: type-reference={inplace=false, type-reference=CPP/LogStatus}
    LogAction: category=STRUCTURE, type-emitter=TYPE_EMITTER_ARA
      namespaces:
        symbol props Info
        symbol props System
        symbol props Time
      4 x cpp implementation data type element:
        transactionID: type-reference={inplace=false, type-reference=String}
        logtype: type-reference={inplace=false, type-reference=CPP/LogType}
        endpoint: type-reference={inplace=false, type-reference=CPP/EndpointType}
        status: type-reference={inplace=false, type-reference=CPP/LogStatus}
    LogServerError: compu {texttable}, range raw 0..2, type-emitter=TYPE_EMITTER_ARA, type-reference=uint32_t
      namespaces:
        symbol props DCU
        symbol props System
        symbol props Variation
    LogServerError: compu {texttable}, range raw 0..2, type-emitter=TYPE_EMITTER_ARA, type-reference=uint32_t
      namespaces:
        symbol props DCU
        symbol props System
        symbol props Time
    LogServerError: compu {texttable}, range raw 0..2, type-emitter=TYPE_EMITTER_ARA, type-reference=uint32_t
      namespaces:
        symbol props DCU
        symbol props System
        symbol props PowerManagement
    LogServerStatus: compu {texttable}, range raw 0..3, type-emitter=TYPE_EMITTER_ARA, type-reference=uint32_t
      namespaces:
        symbol props DCU
        symbol props System
        symbol props Variation
    LogServerStatus: compu {texttable}, range raw 0..3, type-emitter=TYPE_EMITTER_ARA, type-reference=uint32_t
      namespaces:
        symbol props DCU
        symbol props System
        symbol props Time
    LogServerStatus: compu {texttable}, range raw 0..3, type-emitter=TYPE_EMITTER_ARA, type-reference=uint32_t
      namespaces:
        symbol props DCU
        symbol props System
        symbol props PowerManagement
    LogStatus: compu {texttable}, range raw 0..5, type-emitter=TYPE_EMITTER_ARA, type-reference=uint32_t
      namespaces:
        symbol props Info
        symbol props System
        symbol props Variant
    LogStatus: compu {texttable}, range raw 0..5, type-emitter=TYPE_EMITTER_ARA, type-reference=uint32_t
      namespaces:
        symbol props Info
        symbol props System
        symbol props EngineeringMode
    LogStatus: compu {texttable}, range raw 0..5, type-emitter=TYPE_EMITTER_ARA, type-reference=uint32_t
      namespaces:
        symbol props Info
        symbol props System
        symbol props Time
    LogStatuss: compu {texttable}, range raw 0..5, type-emitter=TYPE_EMITTER_ARA, type-reference=uint32_t
      namespaces:
        symbol props Info
        symbol props System
        symbol props Variant
    LogStatuss: compu {texttable}, range raw 0..5, type-emitter=TYPE_EMITTER_ARA, type-reference=uint32_t
      namespaces:
        symbol props Info
        symbol props System
        symbol props EngineeringMode
    LogStatuss: compu {texttable}, range raw 0..5, type-emitter=TYPE_EMITTER_ARA, type-reference=uint32_t
      namespaces:
        symbol props Info
        symbol props System
        symbol props Time
    LogTransferError: compu {texttable}, range raw 0..1, type-emitter=TYPE_EMITTER_ARA, type-reference=uint32_t
      namespaces:
        symbol props Info
        symbol props System
        symbol props Variant
    LogTransferError: compu {texttable}, range raw 0..1, type-emitter=TYPE_EMITTER_ARA, type-reference=uint32_t
      namespaces:
        symbol props Info
        symbol props System
        symbol props EngineeringMode
    LogTransferError: compu {texttable}, range raw 0..1, type-emitter=TYPE_EMITTER_ARA, type-reference=uint32_t
      namespaces:
        symbol props Info
        symbol props System
        symbol props Time
    LogType: compu {texttable}, range raw 0..2, type-emitter=TYPE_EMITTER_ARA, type-reference=uint32_t
      namespaces:
        symbol props Info
        symbol props System
        symbol props Variant
    LogType: compu {texttable}, range raw 0..2, type-emitter=TYPE_EMITTER_ARA, type-reference=uint32_t
      namespaces:
        symbol props Info
        symbol props System
        symbol props EngineeringMode
    LogType: compu {texttable}, range raw 0..2, type-emitter=TYPE_EMITTER_ARA, type-reference=uint32_t
      namespaces:
        symbol props Info
        symbol props System
        symbol props Time
    MDPS_01_10ms_EventData: category=STRUCTURE, type-emitter=TYPE_EMITTER_ARA
      namespaces:
        symbol props Vehicle
        symbol props SOAAdaptor
        symbol props Chassis
      cpp implementation data type element pdu: type-reference={inplace=false, type-reference=MDPS_01_10ms_pdu_VECTOR}
    MDPS_01_10ms_pdu_VECTOR: category=VECTOR, cpp-template-argument=uint8_t, type-emitter=TYPE_EMITTER_ARA
      namespaces:
        symbol props Vehicle
        symbol props SOAAdaptor
        symbol props Chassis
    MOMessageStatus: compu {texttable}, range raw 0..2, type-emitter=TYPE_EMITTER_ARA, type-reference=uint32_t
      namespaces:
        symbol props CCU
        symbol props Cloud
        symbol props Communicator
    MORequestChanged_EventData: category=STRUCTURE, type-emitter=TYPE_EMITTER_ARA
      namespaces:
        symbol props CCU
        symbol props Cloud
        symbol props Communicator
      cpp implementation data type element msgID: type-reference={inplace=false, type-reference=String}
      cpp implementation data type element status: type-reference={inplace=false, type-reference=MOMessageStatus}
    MOResponseType: compu {texttable}, range raw 0..1, type-emitter=TYPE_EMITTER_ARA, type-reference=uint32_t
      namespaces:
        symbol props Vehicle
        symbol props UpdateMaster
        symbol props PackageManagement
    MTMessageStatus: compu {texttable}, range raw 0..1, type-emitter=TYPE_EMITTER_ARA, type-reference=uint32_t
      namespaces:
        symbol props CCU
        symbol props Cloud
        symbol props Communicator
    MTRequestAdded_EventData: category=STRUCTURE, type-emitter=TYPE_EMITTER_ARA
      namespaces:
        symbol props CCU
        symbol props Cloud
        symbol props Communicator
      cpp implementation data type element item: type-reference={inplace=false, type-reference=CCSRequest}
    MTRequestQueue_VECTOR: category=VECTOR, cpp-template-argument=CCSRequest, type-emitter=TYPE_EMITTER_ARA
      namespaces:
        symbol props CCU
        symbol props Cloud
        symbol props Communicator
    MTRequestRemoved_EventData: category=STRUCTURE, type-emitter=TYPE_EMITTER_ARA
      namespaces:
        symbol props CCU
        symbol props Cloud
        symbol props Communicator
      cpp implementation data type element transactionID: type-reference={inplace=false, type-reference=String}
    MapMatchingInfo: category=STRUCTURE, type-emitter=TYPE_EMITTER_ARA
      namespaces:
        symbol props Vehicle
        symbol props SOAAdaptor
        symbol props Location
      5 x cpp implementation data type element:
        longitude: type-reference={inplace=false, type-reference=int32_t}
        latitude: type-reference={inplace=false, type-reference=int32_t}
        altitude: type-reference={inplace=false, type-reference=int32_t}
        speed: type-reference={inplace=false, type-reference=uint16_t}
        heading: type-reference={inplace=false, type-reference=uint32_t}
    MapmatchingData: category=STRUCTURE, type-emitter=TYPE_EMITTER_ARA
      namespaces:
        symbol props Info
        symbol props Location
        symbol props MapMatching
      7 x cpp implementation data type element:
        longitude: type-reference={inplace=false, type-reference=int32_t}
        latitude: type-reference={inplace=false, type-reference=int32_t}
        altitude: type-reference={inplace=false, type-reference=int32_t}
        speed: type-reference={inplace=false, type-reference=uint32_t}
        heading: type-reference={inplace=false, type-reference=float}
        linkId: type-reference={inplace=false, type-reference=uint64_t}
        permanentId: type-reference={inplace=false, type-reference=uint64_t}
    MapmatchingType: compu {texttable}, range raw 0..2, type-emitter=TYPE_EMITTER_ARA, type-reference=uint32_t
      namespaces:
        symbol props BltnCam
        symbol props DrivingEvent
        symbol props Manager
    MapmatchingType: compu {texttable}, range raw 0..2, type-emitter=TYPE_EMITTER_ARA, type-reference=uint32_t
      namespaces:
        symbol props Info
        symbol props Location
        symbol props MapMatching
    MapmatchingType: compu {texttable}, range raw 0..2, type-emitter=TYPE_EMITTER_ARA, type-reference=uint32_t
      namespaces:
        symbol props BltnCam
        symbol props ParkingEvent
        symbol props Manager
    MemType: compu {texttable}, range raw 0..1, type-emitter=TYPE_EMITTER_ARA, type-reference=uint32_t
      namespaces:
        symbol props Vehicle
        symbol props Security
        symbol props MassProc
    MessageError: compu {texttable}, range raw 0..3, type-emitter=TYPE_EMITTER_ARA, type-reference=uint32_t
      namespaces:
        symbol props DCU
        symbol props Telephony
        symbol props MessageManager
    MessageError: compu {texttable}, range raw 0..3, type-emitter=TYPE_EMITTER_ARA, type-reference=uint32_t
      namespaces:
        symbol props CCU
        symbol props Cloud
        symbol props Communicator
    MessageInfo: category=STRUCTURE, type-emitter=TYPE_EMITTER_ARA
      namespaces:
        symbol props Vehicle
        symbol props SOAAdaptor
        symbol props DataCollection
      4 x cpp implementation data type element:
        timestamp: type-reference={inplace=false, type-reference=uint64_t}
        busId: type-reference={inplace=false, type-reference=uint8_t}
        messageId: type-reference={inplace=false, type-reference=uint32_t}
        pduValue: type-reference={inplace=false, type-reference=MessageInfo_pduValue_VECTOR}
    MessageInfo_DR: category=STRUCTURE, type-emitter=TYPE_EMITTER_ARA
      namespaces:
        symbol props Vehicle
        symbol props SOAAdaptor
        symbol props DynamicRouting
      4 x cpp implementation data type element:
        bus: type-reference={inplace=false, type-reference=CANBus}
        messageId: type-reference={inplace=false, type-reference=uint32_t}
        pduValue: type-reference={inplace=false, type-reference=MessageInfo_DR_pduValue_VECTOR}
        pduError: type-reference={inplace=false, type-reference=MessageSubscriptionError_DR}
    MessageInfo_DR_pduValue_VECTOR: category=VECTOR, cpp-template-argument=uint8_t, type-emitter=TYPE_EMITTER_ARA
      namespaces:
        symbol props Vehicle
        symbol props SOAAdaptor
        symbol props DynamicRouting
    MessageInfo_pduValue_VECTOR: category=VECTOR, cpp-template-argument=uint8_t, type-emitter=TYPE_EMITTER_ARA
      namespaces:
        symbol props Vehicle
        symbol props SOAAdaptor
        symbol props DataCollection
    MessageItem: category=STRUCTURE, type-emitter=TYPE_EMITTER_ARA
      namespaces:
        symbol props DCU
        symbol props Telephony
        symbol props MessageManager
      7 x cpp implementation data type element:
        msgID: type-reference={inplace=false, type-reference=String}  # Unique Message ID
        receivedTime: type-reference={inplace=false, type-reference=String}  # Message ReceivedTime
        dcs: type-reference={inplace=false, type-reference=uint32_t}
        pid: type-reference={inplace=false, type-reference=uint32_t}
        centerNumber: type-reference={inplace=false, type-reference=String}
        length: type-reference={inplace=false, type-reference=uint32_t}  # Message Payload length
        pdu: type-reference={inplace=false, type-reference=String}  # Message Payload
    MessageStatus: compu {texttable}, range raw 0..1, type-emitter=TYPE_EMITTER_ARA, type-reference=uint32_t
      namespaces:
        symbol props Vehicle
        symbol props Telemanager
        symbol props MobileMessage
    MessageStatus: compu {texttable}, range raw 0..1, type-emitter=TYPE_EMITTER_ARA, type-reference=uint32_t
      namespaces:
        symbol props DCU
        symbol props Telephony
        symbol props MessageManager
    MessageStatus: compu {texttable}, range raw 0..1, type-emitter=TYPE_EMITTER_ARA, type-reference=uint32_t
      namespaces:
        symbol props Vehicle
        symbol props MSM
        symbol props MessageManager
    MessageSubscriptionError: compu {texttable}, range raw 0..4, type-emitter=TYPE_EMITTER_ARA, type-reference=uint32_t
      namespaces:
        symbol props Vehicle
        symbol props SOAAdaptor
        symbol props DataCollection
    MessageSubscriptionError_DR: compu {texttable}, range raw 0..3, type-emitter=TYPE_EMITTER_ARA, type-reference=uint32_t
      namespaces:
        symbol props Vehicle
        symbol props SOAAdaptor
        symbol props DynamicRouting
    MobileCommProtoType: compu {texttable}, range raw 0..2, type-emitter=TYPE_EMITTER_ARA, type-reference=uint32_t
      namespaces:
        symbol props DCU
        symbol props Telephony
        symbol props ModemManager
    MobileOriginateRequested_EventData: category=STRUCTURE, type-emitter=TYPE_EMITTER_ARA
      namespaces:
        symbol props Vehicle
        symbol props UpdateMaster
        symbol props PackageManagement
      cpp implementation data type element ev1: type-reference={inplace=false, type-reference=MobileTransferReportType}
    MobileServerInfoReportRequested_EventData: category=STRUCTURE, type-emitter=TYPE_EMITTER_ARA
      namespaces:
        symbol props Vehicle
        symbol props UpdateMaster
        symbol props PackageManagement
      cpp implementation data type element ev1: type-reference={inplace=false, type-reference=MobileServerInfoReportType}
    MobileServerInfoReportType: category=STRUCTURE, type-emitter=TYPE_EMITTER_ARA
      namespaces:
        symbol props Vehicle
        symbol props UpdateMaster
        symbol props PackageManagement
      4 x cpp implementation data type element:
        swReleaseId: type-reference={inplace=false, type-reference=String}
        sourceVersion: type-reference={inplace=false, type-reference=String}
        targetVersion: type-reference={inplace=false, type-reference=String}
        needUpdate: type-reference={inplace=false, type-reference=uint8_t}
    MobileServerResultReportRequested_EventData: category=STRUCTURE, type-emitter=TYPE_EMITTER_ARA
      namespaces:
        symbol props Vehicle
        symbol props UpdateMaster
        symbol props PackageManagement
      cpp implementation data type element ev1: type-reference={inplace=false, type-reference=MobileServerResultReportType}
    MobileServerResultReportType: category=STRUCTURE, type-emitter=TYPE_EMITTER_ARA
      namespaces:
        symbol props Vehicle
        symbol props UpdateMaster
        symbol props PackageManagement
      cpp implementation data type element swReleaseId: type-reference={inplace=false, type-reference=String}
      cpp implementation data type element result: type-reference={inplace=false, type-reference=uint8_t}
      cpp implementation data type element cancelReason: type-reference={inplace=false, type-reference=uint8_t}
    MobileTransferReportType: category=STRUCTURE, type-emitter=TYPE_EMITTER_ARA
      namespaces:
        symbol props Vehicle
        symbol props UpdateMaster
        symbol props PackageManagement
      4 x cpp implementation data type element:
        protocolName: type-reference={inplace=false, type-reference=String}
        messageName: type-reference={inplace=false, type-reference=String}
        numberElements: type-reference={inplace=false, type-reference=NumberMap}
        stringElements: type-reference={inplace=false, type-reference=StringMap}
    ModeStatus: category=STRUCTURE, type-emitter=TYPE_EMITTER_ARA
      namespaces:
        symbol props Vehicle
        symbol props VAM
        symbol props Mode
      cpp implementation data type element modeName: type-reference={inplace=false, type-reference=String}
      cpp implementation data type element modeStatus: type-reference={inplace=false, type-reference=String}
      cpp implementation data type element fieldStatus: type-reference={inplace=false, type-reference=FieldStatus}
    ModemFOTAError: compu {texttable}, range raw 0..1, type-emitter=TYPE_EMITTER_ARA, type-reference=uint32_t
      namespaces:
        symbol props DCU
        symbol props Telephony
        symbol props ModemManager
    ModemFOTAStatus: compu {texttable}, range raw 0..6, type-emitter=TYPE_EMITTER_ARA, type-reference=uint32_t
      namespaces:
        symbol props DCU
        symbol props Telephony
        symbol props ModemManager
    ModemPowerStatus: compu {texttable}, range raw 0..2, type-emitter=TYPE_EMITTER_ARA, type-reference=uint32_t
      namespaces:
        symbol props DCU
        symbol props System
        symbol props Variation
    ModemPowerStatus: compu {texttable}, range raw 0..2, type-emitter=TYPE_EMITTER_ARA, type-reference=uint32_t
      namespaces:
        symbol props DCU
        symbol props System
        symbol props Time
    ModemPowerStatus: compu {texttable}, range raw 0..2, type-emitter=TYPE_EMITTER_ARA, type-reference=uint32_t
      namespaces:
        symbol props DCU
        symbol props System
        symbol props PowerManagement
    ModuleState: compu {texttable}, range raw 0..2, type-emitter=TYPE_EMITTER_ARA, type-reference=uint32_t
      namespaces:
        symbol props Vehicle
        symbol props CIDS
        symbol props CIDSInfo
    ModuleState: compu {texttable}, range raw 0..2, type-emitter=TYPE_EMITTER_ARA, type-reference=uint32_t
      namespaces:
        symbol props Vehicle
        symbol props EIDS
        symbol props EIDSInfo
    ModuleUpdateData: category=STRUCTURE, type-emitter=TYPE_EMITTER_ARA
      namespaces:
        symbol props Vehicle
        symbol props DPM
        symbol props Policy
      9 x cpp implementation data type element:
        target: type-reference={inplace=false, type-reference=String}
        policyType: type-reference={inplace=false, type-reference=String}
        appliedName: type-reference={inplace=false, type-reference=String}
        appliedVersion: type-reference={inplace=false, type-reference=uint32_t}
        installedName: type-reference={inplace=false, type-reference=String}
        installedVersion: type-reference={inplace=false, type-reference=uint32_t}
        checksum: type-reference={inplace=false, type-reference=String}
        statusCode: type-reference={inplace=false, type-reference=uint32_t}
        errorMessage: type-reference={inplace=false, type-reference=String}
    MofMessage: category=STRUCTURE, type-emitter=TYPE_EMITTER_ARA
      namespaces:
        symbol props CCU
        symbol props Cloud
        symbol props Communicator
      4 x cpp implementation data type element:
        mofmethod: type-reference={inplace=false, type-reference=String}
        uri: type-reference={inplace=false, type-reference=String}
        header: type-reference={inplace=false, type-reference=CustomHeaderMap}
        body: type-reference={inplace=false, type-reference=ByteArray}
    MountPoint: category=STRUCTURE, type-emitter=TYPE_EMITTER_ARA
      namespaces:
        symbol props Vehicle
        symbol props SharedStorage
        symbol props Status
      18 x cpp implementation data type element:
        share: type-reference={inplace=false, type-reference=String}
        mountPoint: type-reference={inplace=false, type-reference=String}
        opsPerSec: type-reference={inplace=false, type-reference=float}
        rpcBklog: type-reference={inplace=false, type-reference=float}
        readOpsPerSec: type-reference={inplace=false, type-reference=float}
        readKbPerSec: type-reference={inplace=false, type-reference=float}
        readKbPerOp: type-reference={inplace=false, type-reference=float}
        readRetrans: type-reference={inplace=false, type-reference=uint64_t}
        readRetransRatio: type-reference={inplace=false, type-reference=float}
        readAvgRttInMs: type-reference={inplace=false, type-reference=float}
        readAvgExeInMs: type-reference={inplace=false, type-reference=float}
        writeOpsPerSec: type-reference={inplace=false, type-reference=float}
        writeKbPerSec: type-reference={inplace=false, type-reference=float}
        writeKbPerOp: type-reference={inplace=false, type-reference=float}
        writeRetrans: type-reference={inplace=false, type-reference=uint64_t}
        writeRetransRatio: type-reference={inplace=false, type-reference=float}
        writeAvgRttInMs: type-reference={inplace=false, type-reference=float}
        writeAvgExeInMs: type-reference={inplace=false, type-reference=float}
    MqttRequestStatus_EventData: category=STRUCTURE, type-emitter=TYPE_EMITTER_ARA
      namespaces:
        symbol props Vehicle
        symbol props Telemanager
        symbol props MQTT
      cpp implementation data type element mid: type-reference={inplace=false, type-reference=uint32_t}
      cpp implementation data type element error: type-reference={inplace=false, type-reference=CCMQTTError}
    NeedToAgree_EventData: category=STRUCTURE, type-emitter=TYPE_EMITTER_ARA
      namespaces:
        symbol props CCU
        symbol props Mode
        symbol props Routines
      cpp implementation data type element agreeInfo: type-reference={inplace=false, type-reference=AgreementInfo}
    NemsBattData: category=STRUCTURE, type-emitter=TYPE_EMITTER_ARA
      namespaces:
        symbol props CCU
        symbol props Vehicle
        symbol props S2S
      cpp implementation data type element signalItem: type-reference={inplace=false, type-reference=NemsBattInfo_toIP}
      cpp implementation data type element signalValue: type-reference={inplace=false, type-reference=uint32_t}
    NemsBattInfo: category=STRUCTURE, type-emitter=TYPE_EMITTER_ARA
      namespaces:
        symbol props CCU
        symbol props Vehicle
        symbol props S2S
      cpp implementation data type element startNo: type-reference={inplace=false, type-reference=uint32_t}  # NEV_BMS_StartNo
      cpp implementation data type element nemsCellInfo: type-reference={inplace=false, type-reference=uint32_t}  # NEV_BMS_GroupSel ,cellVolt :0x01, cellTemp:0x02
      cpp implementation data type element data: type-reference={inplace=false, type-reference=NemsBattInfo_data_VECTOR}
    NemsBattInfo_data_VECTOR: category=VECTOR, cpp-template-argument=NemsBattData, type-emitter=TYPE_EMITTER_ARA
      namespaces:
        symbol props CCU
        symbol props Vehicle
        symbol props S2S
    NemsBattInfo_toIP: compu {texttable}, range raw 0..25, type-emitter=TYPE_EMITTER_ARA, type-reference=uint32_t
      namespaces:
        symbol props CCU
        symbol props Vehicle
        symbol props S2S
    NemsBattNumData_toIP: compu {texttable}, range raw 0..1, type-emitter=TYPE_EMITTER_ARA, type-reference=uint32_t
      namespaces:
        symbol props CCU
        symbol props Vehicle
        symbol props S2S
    NemsBattNumInfo: category=STRUCTURE, type-emitter=TYPE_EMITTER_ARA
      namespaces:
        symbol props CCU
        symbol props Vehicle
        symbol props S2S
      cpp implementation data type element signalItem: type-reference={inplace=false, type-reference=NemsBattNumData_toIP}
      cpp implementation data type element signalValue: type-reference={inplace=false, type-reference=uint32_t}
    NemsFCSignal: category=STRUCTURE, type-emitter=TYPE_EMITTER_ARA
      namespaces:
        symbol props CCU
        symbol props Vehicle
        symbol props S2S
      cpp implementation data type element signalItem: type-reference={inplace=false, type-reference=NemsFCSignal_toIP}
      cpp implementation data type element signalValue: type-reference={inplace=false, type-reference=uint32_t}
    NemsFCSignal_toIP: compu {texttable}, range raw 0..12, type-emitter=TYPE_EMITTER_ARA, type-reference=uint32_t
      namespaces:
        symbol props CCU
        symbol props Vehicle
        symbol props S2S
    NemsIdcCurrent: category=STRUCTURE, type-emitter=TYPE_EMITTER_ARA
      namespaces:
        symbol props CCU
        symbol props Vehicle
        symbol props S2S
      cpp implementation data type element signalItem: type-reference={inplace=false, type-reference=NemsIdcCurrent_toIP}
      cpp implementation data type element signalValue: type-reference={inplace=false, type-reference=uint32_t}
    NemsIdcCurrent_toIP: compu {texttable}, range raw 0..1, type-emitter=TYPE_EMITTER_ARA, type-reference=uint32_t
      namespaces:
        symbol props CCU
        symbol props Vehicle
        symbol props S2S
    NemsSignal: category=STRUCTURE, type-emitter=TYPE_EMITTER_ARA
      namespaces:
        symbol props CCU
        symbol props Vehicle
        symbol props S2S
      cpp implementation data type element signalItem: type-reference={inplace=false, type-reference=NemsSignal_toIP}
      cpp implementation data type element signal_Value: type-reference={inplace=false, type-reference=uint32_t}
    NemsSignal_toIP: compu {texttable}, range raw 0..52, type-emitter=TYPE_EMITTER_ARA, type-reference=uint32_t
      namespaces:
        symbol props CCU
        symbol props Vehicle
        symbol props S2S
    NetRegStatus: compu {texttable}, range raw 0..5, type-emitter=TYPE_EMITTER_ARA, type-reference=uint32_t
      namespaces:
        symbol props DCU
        symbol props Telephony
        symbol props NetworkInformation
    NetState: compu {texttable}, range raw 0..7, type-emitter=TYPE_EMITTER_ARA, type-reference=uint32_t
      namespaces:
        symbol props Vehicle
        symbol props EthNM
        symbol props NM
    NetworkLoad: category=STRUCTURE, type-emitter=TYPE_EMITTER_ARA
      namespaces:
        symbol props Vehicle
        symbol props ApSysMgr
        symbol props NetManager
      8 x cpp implementation data type element, all with type-reference={inplace=false, type-reference=uint8_t}:
        loadFDB1
        loadFDB2
        loadFDM
        loadFDP1
        loadFDP2
        loadFDC
        loadFDE
        loadFDI
    NetworkOTAStatus: compu {texttable}, range raw 0..4, type-emitter=TYPE_EMITTER_ARA, type-reference=uint32_t
      namespaces:
        symbol props DCU
        symbol props Telephony
        symbol props SimManager
    NetworkRequest: compu {texttable}, range raw 0..2, type-emitter=TYPE_EMITTER_ARA, type-reference=uint32_t
      namespaces:
        symbol props Vehicle
        symbol props ApSysMgr
        symbol props NetManager
    NetworkRequest: compu {texttable}, range raw 0..2, type-emitter=TYPE_EMITTER_ARA, type-reference=uint32_t
      namespaces:
        symbol props Vehicle
        symbol props SM
        symbol props StateManager
    NetworkServiceProvider: compu {texttable}, range raw 0..23, type-emitter=TYPE_EMITTER_ARA, type-reference=uint32_t
      namespaces:
        symbol props Vehicle
        symbol props MSM
        symbol props SimManager
    NetworkStatus: category=STRUCTURE, type-emitter=TYPE_EMITTER_ARA
      namespaces:
        symbol props Vehicle
        symbol props IPCHandler
        symbol props RoutingIPC
      9 x cpp implementation data type element:
        canStatus_FDB1: type-reference={inplace=false, type-reference=CPP/CanNetStatus}
        canStatus_FDB2: type-reference={inplace=false, type-reference=CPP/CanNetStatus}
        canStatus_FDM: type-reference={inplace=false, type-reference=CPP/CanNetStatus}
        canStatus_FDP1: type-reference={inplace=false, type-reference=CPP/CanNetStatus}
        canStatus_FDP2: type-reference={inplace=false, type-reference=CPP/CanNetStatus}
        canStatus_FDC: type-reference={inplace=false, type-reference=CPP/CanNetStatus}
        canStatus_FDE: type-reference={inplace=false, type-reference=CPP/CanNetStatus}
        canStatus_HSD: type-reference={inplace=false, type-reference=CPP/DCanNetStatus}
        canStatus_FDI: type-reference={inplace=false, type-reference=CPP/CanNetStatus}
    NetworkStatus: category=STRUCTURE, type-emitter=TYPE_EMITTER_ARA
      namespaces:
        symbol props Vehicle
        symbol props ApSysMgr
        symbol props NetManager
      11 x cpp implementation data type element:
        canStatus_FDB1: type-reference={inplace=false, type-reference=CPP/CanNetStatus}
        canStatus_FDB2: type-reference={inplace=false, type-reference=CPP/CanNetStatus}
        canStatus_FDM: type-reference={inplace=false, type-reference=CPP/CanNetStatus}
        canStatus_FDP1: type-reference={inplace=false, type-reference=CPP/CanNetStatus}
        canStatus_FDP2: type-reference={inplace=false, type-reference=CPP/CanNetStatus}
        canStatus_FDC: type-reference={inplace=false, type-reference=CPP/CanNetStatus}
        canStatus_FDE: type-reference={inplace=false, type-reference=CPP/CanNetStatus}
        canStatus_HSD: type-reference={inplace=false, type-reference=CPP/DCanNetStatus}
        canStatus_ALL: type-reference={inplace=false, type-reference=AllCanNetStatus}
        ethStatus: type-reference={inplace=false, type-reference=EthNetStatus}
        canStatus_FDI: type-reference={inplace=false, type-reference=CPP/CanNetStatus}
    NetworkStatus: category=STRUCTURE, type-emitter=TYPE_EMITTER_ARA
      namespaces:
        symbol props Vehicle
        symbol props EthNM
        symbol props NM
      cpp implementation data type element netState: type-reference={inplace=false, type-reference=NetState}
      cpp implementation data type element error: type-reference={inplace=false, type-reference=CPP/Error}
    NetworkVccStatistics: category=STRUCTURE, type-emitter=TYPE_EMITTER_ARA
      namespaces:
        symbol props Vehicle
        symbol props Vcc
        symbol props NetworkStatistics
      7 x cpp implementation data type element:
        stat_type: type-reference={inplace=false, type-reference=NetworkVccStatisticsType}
        tx_packets: type-reference={inplace=false, type-reference=uint64_t}
        tx_bytes: type-reference={inplace=false, type-reference=uint64_t}
        rx_packets: type-reference={inplace=false, type-reference=uint64_t}
        rx_bytes: type-reference={inplace=false, type-reference=uint64_t}
        packets: type-reference={inplace=false, type-reference=uint64_t}
        bytes: type-reference={inplace=false, type-reference=uint64_t}
    NetworkVccStatisticsType: compu {texttable}, range raw 0..18, type-emitter=TYPE_EMITTER_ARA, type-reference=uint32_t
      namespaces:
        symbol props Vehicle
        symbol props Vcc
        symbol props NetworkStatistics
    NfsClientStatus: category=STRUCTURE, type-emitter=TYPE_EMITTER_ARA
      namespaces:
        symbol props Vehicle
        symbol props SharedStorage
        symbol props Status
      cpp implementation data type element clientIP: type-reference={inplace=false, type-reference=String}
      cpp implementation data type element mountPoints: type-reference={inplace=false, type-reference=NfsClientStatus_mountPoints_VECTOR}
    NfsClientStatus_mountPoints_VECTOR: category=VECTOR, cpp-template-argument=MountPoint, type-emitter=TYPE_EMITTER_ARA
      namespaces:
        symbol props Vehicle
        symbol props SharedStorage
        symbol props Status
    NfsServerStatus: category=STRUCTURE, type-emitter=TYPE_EMITTER_ARA
      namespaces:
        symbol props Vehicle
        symbol props SharedStorage
        symbol props Status
      cpp implementation data type element packetStats: type-reference={inplace=false, type-reference=PacketStats}
      cpp implementation data type element rpcStats: type-reference={inplace=false, type-reference=RpcStats}
      cpp implementation data type element ioStats: type-reference={inplace=false, type-reference=IoStats}
    NonSleepEcuIdx: category=STRUCTURE, type-emitter=TYPE_EMITTER_ARA
      namespaces:
        symbol props Vehicle
        symbol props IPCHandler
        symbol props RoutingIPC
      cpp implementation data type element canEcuIdx: type-reference={inplace=false, type-reference=NonSleepEcuIdx_canEcuIdx_VECTOR}
      cpp implementation data type element ethEcuIdx: type-reference={inplace=false, type-reference=NonSleepEcuIdx_ethEcuIdx_VECTOR}
    NonSleepEcuIdx_canEcuIdx_VECTOR: category=VECTOR, cpp-template-argument=uint8_t, type-emitter=TYPE_EMITTER_ARA
      namespaces:
        symbol props Vehicle
        symbol props IPCHandler
        symbol props RoutingIPC
    NonSleepEcuIdx_ethEcuIdx_VECTOR: category=VECTOR, cpp-template-argument=uint8_t, type-emitter=TYPE_EMITTER_ARA
      namespaces:
        symbol props Vehicle
        symbol props IPCHandler
        symbol props RoutingIPC
    NonSleepEvent_EventData: category=STRUCTURE, type-emitter=TYPE_EMITTER_ARA
      namespaces:
        symbol props Vehicle
        symbol props NSD
        symbol props NonSleep
      cpp implementation data type element EventTrigger: type-reference={inplace=false, type-reference=EventTrigger}
    NsdEventInfo: category=STRUCTURE, type-emitter=TYPE_EMITTER_ARA
      namespaces:
        symbol props Vehicle
        symbol props IPCHandler
        symbol props RoutingIPC
      cpp implementation data type element nsdDiagComplete: type-reference={inplace=false, type-reference=bool}
      cpp implementation data type element nsdLogCollectionComplete: type-reference={inplace=false, type-reference=bool}
    NssPolicyDownloaded_EventData: category=STRUCTURE, type-emitter=TYPE_EMITTER_ARA
      namespaces:
        symbol props Vehicle
        symbol props DPM
        symbol props Policy
      cpp implementation data type element newVersion: type-reference={inplace=false, type-reference=uint32_t}
    NssSystemStatus: category=STRUCTURE, type-emitter=TYPE_EMITTER_ARA
      namespaces:
        symbol props Vehicle
        symbol props SharedStorage
        symbol props Status
      cpp implementation data type element nfsRunning: type-reference={inplace=false, type-reference=bool}
      cpp implementation data type element mainVolumeOperational: type-reference={inplace=false, type-reference=bool}
      cpp implementation data type element shares: type-reference={inplace=false, type-reference=NssSystemStatus_shares_VECTOR}
    NssSystemStatus_shares_VECTOR: category=VECTOR, cpp-template-argument=ShareStatus, type-emitter=TYPE_EMITTER_ARA
      namespaces:
        symbol props Vehicle
        symbol props SharedStorage
        symbol props Status
    NumValueInfo: category=ASSOCIATIVE_MAP, type-emitter=TYPE_EMITTER_ARA
      namespaces:
        symbol props Vehicle
        symbol props ApSysMgr
        symbol props SysInfoManager
      template-arguments:
        category=ASSOC_MAP_KEY, template-type=NumValueKey
        category=ASSOC_MAP_VALUE, template-type=uint64_t
    NumValueKey: compu {texttable}, range raw 0..20, type-emitter=TYPE_EMITTER_ARA, type-reference=uint32_t
      namespaces:
        symbol props Vehicle
        symbol props ApSysMgr
        symbol props SysInfoManager
    NumberMap: category=ASSOCIATIVE_MAP, template-arguments=[{category=ASSOC_MAP_KEY, template-type=String}, {category=ASSOC_MAP_VALUE, template-type=int64_t}], type-emitter=TYPE_EMITTER_ARA
      namespaces:
        symbol props Vehicle
        symbol props UpdateMaster
        symbol props PackageManagement
    NvmeStatus: category=STRUCTURE, type-emitter=TYPE_EMITTER_ARA
      namespaces:
        symbol props Vehicle
        symbol props SharedStorage
        symbol props Status
      17 x cpp implementation data type element:
        availableSpareRatio: type-reference={inplace=false, type-reference=float}
        availableSpareThresholdRatio: type-reference={inplace=false, type-reference=float}
        controllerBusyTime: type-reference={inplace=false, type-reference=uint64_t}
        criticalCompositeTemperatureTime: type-reference={inplace=false, type-reference=uint64_t}
        criticalWarning: type-reference={inplace=false, type-reference=uint64_t}
        dataUnitsRead: type-reference={inplace=false, type-reference=uint64_t}
        dataUnitsWritten: type-reference={inplace=false, type-reference=uint64_t}
        firmwareRev: type-reference={inplace=false, type-reference=String}
        mediaErrors: type-reference={inplace=false, type-reference=uint64_t}
        model: type-reference={inplace=false, type-reference=String}
        usedRatio: type-reference={inplace=false, type-reference=float}
        powerCycles: type-reference={inplace=false, type-reference=uint64_t}
        powerOnHours: type-reference={inplace=false, type-reference=uint64_t}
        serialNumber: type-reference={inplace=false, type-reference=String}
        temperatureInCelsius: type-reference={inplace=false, type-reference=uint64_t}
        unsafeShutdowns: type-reference={inplace=false, type-reference=uint64_t}
        warningTemperatureTime: type-reference={inplace=false, type-reference=uint64_t}
    OEUKERR: compu {texttable}, range raw 0..3, type-emitter=TYPE_EMITTER_ARA, type-reference=uint32_t
      namespaces:
        symbol props Vehicle
        symbol props Security
        symbol props OEUK
    OEUKSTATUS: compu {texttable}, range raw 0..2, type-emitter=TYPE_EMITTER_ARA, type-reference=uint32_t
      namespaces:
        symbol props Vehicle
        symbol props Security
        symbol props OEUK
    OTAInfo: category=STRUCTURE, type-emitter=TYPE_EMITTER_ARA
      namespaces:
        symbol props Vehicle
        symbol props IPCHandler
        symbol props RoutingIPC
      cpp implementation data type element crankInhibit: type-reference={inplace=false, type-reference=CPP/CrankInhibitStatus}
      cpp implementation data type element otaMode: type-reference={inplace=false, type-reference=uint8_t}
    OTAResource: category=STRUCTURE, type-emitter=TYPE_EMITTER_ARA
      namespaces:
        symbol props CCU
        symbol props Update
        symbol props Screen
      cpp implementation data type element allWhatsNewContents: type-reference={inplace=false, type-reference=OTAResource_allWhatsNewContents_VECTOR}
      cpp implementation data type element updatedEventVersion: type-reference={inplace=false, type-reference=String}  # Recently updated event version
    OTAResource_allWhatsNewContents_VECTOR: category=VECTOR, cpp-template-argument=WhatsNewContents, type-emitter=TYPE_EMITTER_ARA
      namespaces:
        symbol props CCU
        symbol props Update
        symbol props Screen
    OTAStatus: category=STRUCTURE, type-emitter=TYPE_EMITTER_ARA
      namespaces:
        symbol props CCU
        symbol props Update
        symbol props Screen
      4 x cpp implementation data type element:
        expectedUpdateTime: type-reference={inplace=false, type-reference=uint16_t}
        countDownTime: type-reference={inplace=false, type-reference=uint16_t}  # The CCU sends once at the start of the update. When H/U receives this message, it counts down for 60sec.
        progressRate: type-reference={inplace=false, type-reference=uint16_t}
        failedECUName: type-reference={inplace=false, type-reference=OTAStatus_failedECUName_VECTOR}  # ECUs that failed to OTA
    OTAStatus_failedECUName_VECTOR: category=VECTOR, cpp-template-argument=String, type-emitter=TYPE_EMITTER_ARA
      namespaces:
        symbol props CCU
        symbol props Update
        symbol props Screen
    OnDataRegistrationChanged_EventData: category=STRUCTURE, type-emitter=TYPE_EMITTER_ARA
      namespaces:
        symbol props Vehicle
        symbol props MSM
        symbol props NetworkManager
      cpp implementation data type element status: type-reference={inplace=false, type-reference=RegistrationStatus}
    OnNotifyReceiveMessage_EventData: category=STRUCTURE, type-emitter=TYPE_EMITTER_ARA
      namespaces:
        symbol props Vehicle
        symbol props MSM
        symbol props MessageManager
      cpp implementation data type element msgId: type-reference={inplace=false, type-reference=OnNotifyReceiveMessage_msgId_VECTOR}
    OnNotifyReceiveMessage_msgId_VECTOR: category=VECTOR, cpp-template-argument=String, type-emitter=TYPE_EMITTER_ARA
      namespaces:
        symbol props Vehicle
        symbol props MSM
        symbol props MessageManager
    OnShutdown_EventData: category=STRUCTURE, type-emitter=TYPE_EMITTER_ARA
      namespaces:
        symbol props Vehicle
        symbol props SharedStorage
        symbol props Share
      cpp implementation data type element shutdownParams: type-reference={inplace=false, type-reference=String}
    OnShutdown_EventData: category=STRUCTURE, type-emitter=TYPE_EMITTER_ARA
      namespaces:
        symbol props CCU
        symbol props SharedStorage
        symbol props Share
      cpp implementation data type element shutdownParams: type-reference={inplace=false, type-reference=String}
    OneTimeSysInfo: category=STRUCTURE, type-emitter=TYPE_EMITTER_ARA
      namespaces:
        symbol props Vehicle
        symbol props IPCHandler
        symbol props RoutingIPC
      21 x cpp implementation data type element:
        versions: type-reference={inplace=false, type-reference=VersionInfo}
        brand: type-reference={inplace=false, type-reference=String}
        vehicleModel: type-reference={inplace=false, type-reference=String}
        vehicleVariant: type-reference={inplace=false, type-reference=String}
        parNo: type-reference={inplace=false, type-reference=String}
        supplierCode: type-reference={inplace=false, type-reference=String}
        manufactDate: type-reference={inplace=false, type-reference=String}
        serialNo: type-reference={inplace=false, type-reference=String}
        testRegion: type-reference={inplace=false, type-reference=String}
        region: type-reference={inplace=false, type-reference=uint8_t}
        ecotype: type-reference={inplace=false, type-reference=uint8_t}
        driverside: type-reference={inplace=false, type-reference=uint8_t}
        mild48V: type-reference={inplace=false, type-reference=uint8_t}
        connectivity: type-reference={inplace=false, type-reference=uint8_t}
        epb: type-reference={inplace=false, type-reference=uint8_t}
        transmission: type-reference={inplace=false, type-reference=uint8_t}
        factoryLocation: type-reference={inplace=false, type-reference=uint8_t}
        ecotypeVariant: type-reference={inplace=false, type-reference=uint8_t}
        serverInfo: type-reference={inplace=false, type-reference=uint8_t}
        ccuGen: type-reference={inplace=false, type-reference=uint8_t}
        pbv: type-reference={inplace=false, type-reference=uint8_t}
    OpeningDateInfo: category=STRUCTURE, type-emitter=TYPE_EMITTER_ARA
      namespaces:
        symbol props DCU
        symbol props Telephony
        symbol props SimManager
      cpp implementation data type element timeStamp: type-reference={inplace=false, type-reference=String}  # "YYYY/MM/DD HH:MM:SS"
      cpp implementation data type element count: type-reference={inplace=false, type-reference=uint32_t}  # Perform Count
    OperState: compu {texttable}, range raw 0..6, type-emitter=TYPE_EMITTER_ARA, type-reference=uint32_t
      namespaces:
        symbol props DCU
        symbol props System
        symbol props Variation
    OperState: compu {texttable}, range raw 0..6, type-emitter=TYPE_EMITTER_ARA, type-reference=uint32_t
      namespaces:
        symbol props DCU
        symbol props System
        symbol props Time
    OperState: compu {texttable}, range raw 0..6, type-emitter=TYPE_EMITTER_ARA, type-reference=uint32_t
      namespaces:
        symbol props DCU
        symbol props System
        symbol props PowerManagement
    OperState: compu {texttable}, range raw 0..6, type-emitter=TYPE_EMITTER_ARA, type-reference=uint32_t
      namespaces:
        symbol props CCU
        symbol props System
        symbol props EngineeringMode
    OtaModeType: compu {texttable}, range raw 0..255, type-emitter=TYPE_EMITTER_ARA, type-reference=uint32_t
      namespaces:
        symbol props Vehicle
        symbol props ApSysMgr
        symbol props NetManager
    PEVInfo_VECTOR: category=VECTOR, cpp-template-argument=CPP/EventInfo, type-emitter=TYPE_EMITTER_ARA
      namespaces:
        symbol props BltnCam
        symbol props ParkingEvent
        symbol props Manager
    PNISetter: compu {texttable}, range raw 0..2, type-emitter=TYPE_EMITTER_ARA, type-reference=uint32_t
      namespaces:
        symbol props Vehicle
        symbol props ApSysMgr
        symbol props NetManager
    PackageManagerStatusType: compu {texttable}, range raw 0..8, type-emitter=TYPE_EMITTER_ARA, type-reference=uint32_t
      namespaces:
        symbol props Vehicle
        symbol props CM
        symbol props PackageManagement
    PackageManagerStatusType: compu {texttable}, range raw 0..8, type-emitter=TYPE_EMITTER_ARA, type-reference=uint32_t
      namespaces:
        symbol props ara
        symbol props ucm
        symbol props pkgmgr
    PacketStats: category=STRUCTURE, type-emitter=TYPE_EMITTER_ARA
      namespaces:
        symbol props Vehicle
        symbol props SharedStorage
        symbol props Status
      4 x cpp implementation data type element:
        packets: type-reference={inplace=false, type-reference=uint64_t}
        tcp: type-reference={inplace=false, type-reference=uint64_t}
        tcpconn: type-reference={inplace=false, type-reference=uint32_t}
        udp: type-reference={inplace=false, type-reference=uint64_t}
    PartInfoServerReportType: category=STRUCTURE, type-emitter=TYPE_EMITTER_ARA
      namespaces:
        symbol props Vehicle
        symbol props UpdateMaster
        symbol props PackageManagement
      cpp implementation data type element partId: type-reference={inplace=false, type-reference=String}
      cpp implementation data type element swUnitServerReport: type-reference={inplace=false, type-reference=SwUnitServerReportVectorType}
    PartInfoServerReportVectorType: category=VECTOR, cpp-template-argument=PartInfoServerReportType, type-emitter=TYPE_EMITTER_ARA
      namespaces:
        symbol props Vehicle
        symbol props UpdateMaster
        symbol props PackageManagement
    PartialNetworkStatus: category=STRUCTURE, type-emitter=TYPE_EMITTER_ARA
      namespaces:
        symbol props Vehicle
        symbol props EthNM
        symbol props NM
      cpp implementation data type element pnMap: type-reference={inplace=false, type-reference=PartialNetworkStatus_pnMap_VECTOR}
      cpp implementation data type element error: type-reference={inplace=false, type-reference=CPP/Error}
    PartialNetworkStatus_pnMap_VECTOR: category=VECTOR, cpp-template-argument=bool, type-emitter=TYPE_EMITTER_ARA
      namespaces:
        symbol props Vehicle
        symbol props EthNM
        symbol props NM
    PartitionType: category=STRUCTURE, type-emitter=TYPE_EMITTER_ARA
      namespaces:
        symbol props Vehicle
        symbol props BSM
        symbol props BootSyncManager
      cpp implementation data type element bootPartition: type-reference={inplace=false, type-reference=bool}
      cpp implementation data type element primaryPartition: type-reference={inplace=false, type-reference=bool}
    PayloadType: compu {texttable}, range raw 0..3, type-emitter=TYPE_EMITTER_ARA, type-reference=uint32_t
      namespaces:
        symbol props Vehicle
        symbol props DiagMgr
        symbol props RoutingDiag
    PeriodicSysInfo: category=STRUCTURE, type-emitter=TYPE_EMITTER_ARA
      namespaces:
        symbol props Vehicle
        symbol props IPCHandler
        symbol props RoutingIPC
      5 x cpp implementation data type element:
        powerState: type-reference={inplace=false, type-reference=CPP/PowerState}
        netState: type-reference={inplace=false, type-reference=CPP/NetworkStatus}
        hwireInputState: type-reference={inplace=false, type-reference=CPP/ExtWireInput}
        hwireOutputState: type-reference={inplace=false, type-reference=ExtWireOutput}
        busLoad: type-reference={inplace=false, type-reference=BusLoad}
    PeriodicSystemInfoAdditional_EventData: category=STRUCTURE, type-emitter=TYPE_EMITTER_ARA
      namespaces:
        symbol props Vehicle
        symbol props IPCHandler
        symbol props RoutingIPC
      cpp implementation data type element sysInfo: type-reference={inplace=false, type-reference=ByteArray}
    PeriodicSystemInfo_EventData: category=STRUCTURE, type-emitter=TYPE_EMITTER_ARA
      namespaces:
        symbol props Vehicle
        symbol props IPCHandler
        symbol props RoutingIPC
      cpp implementation data type element info: type-reference={inplace=false, type-reference=PeriodicSysInfo}
    PolicyInfo: category=STRUCTURE, type-emitter=TYPE_EMITTER_ARA
      namespaces:
        symbol props Vehicle
        symbol props SharedStorage
        symbol props Share
      4 x cpp implementation data type element:
        statusCode: type-reference={inplace=false, type-reference=uint32_t}
        errorMessage: type-reference={inplace=false, type-reference=String}
        policyVersion: type-reference={inplace=false, type-reference=uint32_t}
        name: type-reference={inplace=false, type-reference=String}
    PolicyInfo: category=STRUCTURE, type-emitter=TYPE_EMITTER_ARA
      namespaces:
        symbol props CCU
        symbol props SharedStorage
        symbol props Share
      4 x cpp implementation data type element:
        statusCode: type-reference={inplace=false, type-reference=uint32_t}
        errorMessage: type-reference={inplace=false, type-reference=String}
        policyVersion: type-reference={inplace=false, type-reference=uint32_t}
        policyName: type-reference={inplace=false, type-reference=String}
    PolicyStatus: compu {texttable}, range raw 0..3, type-emitter=TYPE_EMITTER_ARA, type-reference=uint32_t
      namespaces:
        symbol props Vehicle
        symbol props Vcc
        symbol props Policy
    PolicyStatus: category=STRUCTURE, type-emitter=TYPE_EMITTER_ARA
      namespaces:
        symbol props Vehicle
        symbol props SharedStorage
        symbol props Status
      5 x cpp implementation data type element:
        policyVersion: type-reference={inplace=false, type-reference=uint32_t}
        policyName: type-reference={inplace=false, type-reference=String}
        serverPolicyStatus: type-reference={inplace=false, type-reference=String}
        errorCode: type-reference={inplace=false, type-reference=uint32_t}
        progressPercentage: type-reference={inplace=false, type-reference=uint8_t}  # Value Range : 0~100
    PortID: compu {texttable}, range raw 0..22, type-emitter=TYPE_EMITTER_ARA, type-reference=uint32_t
      namespaces:
        symbol props Vehicle
        symbol props EthHandler
        symbol props EthernetSwitchMgr
    PortLinkStatus: category=ASSOCIATIVE_MAP, type-emitter=TYPE_EMITTER_ARA
      namespaces:
        symbol props Vehicle
        symbol props EthHandler
        symbol props EthernetSwitchMgr
      template-arguments:
        category=ASSOC_MAP_KEY, template-type=PortID
        category=ASSOC_MAP_VALUE, template-type=EthLinkStatus
    PortSqi: category=ASSOCIATIVE_MAP, template-arguments=[{category=ASSOC_MAP_KEY, template-type=PortID}, {category=ASSOC_MAP_VALUE, template-type=int8_t}], type-emitter=TYPE_EMITTER_ARA
      namespaces:
        symbol props Vehicle
        symbol props EthHandler
        symbol props EthernetSwitchMgr
    PortWireConnectionStatus: category=ASSOCIATIVE_MAP, type-emitter=TYPE_EMITTER_ARA
      namespaces:
        symbol props Vehicle
        symbol props EthHandler
        symbol props EthernetSwitchMgr
      template-arguments:
        category=ASSOC_MAP_KEY, template-type=PortID
        category=ASSOC_MAP_VALUE, template-type=EthWireConnectionStatus
    PowerState: category=STRUCTURE, type-emitter=TYPE_EMITTER_ARA
      namespaces:
        symbol props Vehicle
        symbol props ApSysMgr
        symbol props IOManager
      11 x cpp implementation data type element:
        accState: type-reference={inplace=false, type-reference=bool}
        ign1State: type-reference={inplace=false, type-reference=bool}
        ign3State: type-reference={inplace=false, type-reference=bool}
        batLevel: type-reference={inplace=false, type-reference=uint16_t}
        accCnt: type-reference={inplace=false, type-reference=uint16_t}
        ign1Cnt: type-reference={inplace=false, type-reference=uint16_t}
        ign3Cnt: type-reference={inplace=false, type-reference=uint16_t}
        accOnTime: type-reference={inplace=false, type-reference=uint64_t}
        ign1OnTime: type-reference={inplace=false, type-reference=uint64_t}
        ign3OnTime: type-reference={inplace=false, type-reference=uint64_t}
        bootCnt: type-reference={inplace=false, type-reference=uint16_t}
    PowerState: category=STRUCTURE, type-emitter=TYPE_EMITTER_ARA
      namespaces:
        symbol props Vehicle
        symbol props IPCHandler
        symbol props RoutingIPC
      4 x cpp implementation data type element:
        accState: type-reference={inplace=false, type-reference=bool}
        ign1State: type-reference={inplace=false, type-reference=bool}
        ign3State: type-reference={inplace=false, type-reference=bool}
        batLevel: type-reference={inplace=false, type-reference=uint16_t}
    PowerStatus: compu {texttable}, range raw 0..5, type-emitter=TYPE_EMITTER_ARA, type-reference=uint32_t
      namespaces:
        symbol props Info
        symbol props System
        symbol props Variant
    PowerStatus: compu {texttable}, range raw 0..5, type-emitter=TYPE_EMITTER_ARA, type-reference=uint32_t
      namespaces:
        symbol props Info
        symbol props System
        symbol props EngineeringMode
    PowerStatus: compu {texttable}, range raw 0..5, type-emitter=TYPE_EMITTER_ARA, type-reference=uint32_t
      namespaces:
        symbol props CCU
        symbol props System
        symbol props EngineeringMode
    PowerStatus: compu {texttable}, range raw 0..5, type-emitter=TYPE_EMITTER_ARA, type-reference=uint32_t
      namespaces:
        symbol props Info
        symbol props System
        symbol props Time
    PreInstallAppInfoType: category=STRUCTURE, type-emitter=TYPE_EMITTER_ARA
      namespaces:
        symbol props ara
        symbol props ucm
        symbol props pkgmgr
      5 x cpp implementation data type element:
        swUnitName: type-reference={inplace=false, type-reference=String}
        swUnitVersion: type-reference={inplace=false, type-reference=String}
        filePath: type-reference={inplace=false, type-reference=String}
        size: type-reference={inplace=false, type-reference=uint64_t}
        id: type-reference={inplace=false, type-reference=CPP/TransferIdType}
    PreInstallAppInfoVectorType: category=VECTOR, cpp-template-argument=PreInstallAppInfoType, type-emitter=TYPE_EMITTER_ARA
      namespaces:
        symbol props ara
        symbol props ucm
        symbol props pkgmgr
    PreviousTripInfo: category=STRUCTURE, type-emitter=TYPE_EMITTER_ARA
      namespaces:
        symbol props Info
        symbol props Cluster
        symbol props InformationProvider
      5 x cpp implementation data type element:
        averagefuel: type-reference={inplace=false, type-reference=float}
        distance: type-reference={inplace=false, type-reference=float}
        fuelunit: type-reference={inplace=false, type-reference=FuelEconomyUnit}
        distunit: type-reference={inplace=false, type-reference=DistanceUnit}
        reset: type-reference={inplace=false, type-reference=bool}
    PrkOprableTime: category=STRUCTURE, type-emitter=TYPE_EMITTER_ARA
      namespaces:
        symbol props BltnCam
        symbol props ParkingEvent
        symbol props Manager
      cpp implementation data type element prk_Oprable_Time: type-reference={inplace=false, type-reference=uint32_t}  # Built-in cam user settings available time
      cpp implementation data type element prk_Oprable_Time_Max: type-reference={inplace=false, type-reference=uint32_t}  # Maximum usable time for built-in cam
    ProcessMTRequestError: compu {texttable}, range raw 0..5, type-emitter=TYPE_EMITTER_ARA, type-reference=uint32_t
      namespaces:
        symbol props CCU
        symbol props Cloud
        symbol props Communicator
    ProcessingRulePreparationResultType: compu {texttable}, range raw 0..2, type-emitter=TYPE_EMITTER_ARA, type-reference=uint32_t
      namespaces:
        symbol props Vehicle
        symbol props UpdateMaster
        symbol props PackageManagement
    ProductItem: category=STRUCTURE, type-emitter=TYPE_EMITTER_ARA
      namespaces:
        symbol props Info
        symbol props Cloud
        symbol props ProvisioningTable
      6 x cpp implementation data type element:
        subscribed: type-reference={inplace=false, type-reference=String}
        purchaseDate: type-reference={inplace=false, type-reference=String}
        serviceCode: type-reference={inplace=false, type-reference=String}
        serviceFeatures: type-reference={inplace=false, type-reference=CPP/KeyValue}
        productNames: type-reference={inplace=false, type-reference=CPP/KeyValue}
        optionInfos: type-reference={inplace=false, type-reference=CPP/KeyValue}
    PropertyError: compu {texttable}, range raw 0..5, type-emitter=TYPE_EMITTER_ARA, type-reference=uint32_t
      namespaces:
        symbol props CCU
        symbol props System
        symbol props EngineeringMode
    ProtocolType: compu {texttable}, range raw 0..1, type-emitter=TYPE_EMITTER_ARA, type-reference=uint32_t
      namespaces:
        symbol props CCU
        symbol props Cloud
        symbol props Communicator
    ProtocolTypes: compu {texttable}, range raw 0..2, type-emitter=TYPE_EMITTER_ARA, type-reference=uint32_t
      namespaces:
        symbol props Vehicle
        symbol props Vcc
        symbol props Manager
    ProtocolTypes: compu {texttable}, range raw 0..2, type-emitter=TYPE_EMITTER_ARA, type-reference=uint32_t
      namespaces:
        symbol props CCU
        symbol props ExternalNetwork
        symbol props Manager2
    ProvisioningItem: category=STRUCTURE, type-emitter=TYPE_EMITTER_ARA
      namespaces:
        symbol props Info
        symbol props Cloud
        symbol props EngineeringMode
      cpp implementation data type element category: type-reference={inplace=false, type-reference=String}
      cpp implementation data type element keyinfo: type-reference={inplace=false, type-reference=String}
      cpp implementation data type element valueinfo: type-reference={inplace=false, type-reference=String}
    ProvisioningItem: category=STRUCTURE, type-emitter=TYPE_EMITTER_ARA
      namespaces:
        symbol props Info
        symbol props Cloud
        symbol props ProvisioningTable
      cpp implementation data type element category: type-reference={inplace=false, type-reference=String}
      cpp implementation data type element keyinfo: type-reference={inplace=false, type-reference=String}
      cpp implementation data type element valueinfo: type-reference={inplace=false, type-reference=String}
    ProvisioningItems_VECTOR: category=VECTOR, cpp-template-argument=CPP/ProvisioningItem, type-emitter=TYPE_EMITTER_ARA
      namespaces:
        symbol props Info
        symbol props Cloud
        symbol props ProvisioningTable
    ProvisioningStatus: compu {texttable}, range raw 0..8, type-emitter=TYPE_EMITTER_ARA, type-reference=uint32_t
      namespaces:
        symbol props CCU
        symbol props Cloud
        symbol props ProvisioningTable
    ProvisioningStatus: compu {texttable}, range raw 0..8, type-emitter=TYPE_EMITTER_ARA, type-reference=uint32_t
      namespaces:
        symbol props Info
        symbol props Cloud
        symbol props EngineeringMode
    ProvisioningStatus: compu {texttable}, range raw 0..8, type-emitter=TYPE_EMITTER_ARA, type-reference=uint32_t
      namespaces:
        symbol props Info
        symbol props Cloud
        symbol props ProvisioningTable
    ProvisioningTableChanged_EventData: category=STRUCTURE, type-emitter=TYPE_EMITTER_ARA
      namespaces:
        symbol props Vehicle
        symbol props Telemanager
        symbol props Provisioning
      cpp implementation data type element changed: type-reference={inplace=false, type-reference=bool}
    RatType: compu {texttable}, range raw 0..9, type-emitter=TYPE_EMITTER_ARA, type-reference=uint32_t
      namespaces:
        symbol props DCU
        symbol props Telephony
        symbol props NetworkInformation
    Ready: compu {texttable}, range raw 0..1, type-emitter=TYPE_EMITTER_ARA, type-reference=uint32_t
      namespaces:
        symbol props Info
        symbol props System
        symbol props Variant
    Ready: compu {texttable}, range raw 0..1, type-emitter=TYPE_EMITTER_ARA, type-reference=uint32_t
      namespaces:
        symbol props Info
        symbol props System
        symbol props EngineeringMode
    Ready: compu {texttable}, range raw 0..1, type-emitter=TYPE_EMITTER_ARA, type-reference=uint32_t
      namespaces:
        symbol props Info
        symbol props System
        symbol props Time
    ReceiveMessageAdded_EventData: category=STRUCTURE, type-emitter=TYPE_EMITTER_ARA
      namespaces:
        symbol props DCU
        symbol props Telephony
        symbol props MessageManager
      cpp implementation data type element msgID: type-reference={inplace=false, type-reference=String}
    ReceiveMessageRemoved_EventData: category=STRUCTURE, type-emitter=TYPE_EMITTER_ARA
      namespaces:
        symbol props DCU
        symbol props Telephony
        symbol props MessageManager
      cpp implementation data type element msgID: type-reference={inplace=false, type-reference=String}
    RecvTones_EventData: category=STRUCTURE, type-emitter=TYPE_EMITTER_ARA
      namespaces:
        symbol props DCU
        symbol props Telephony
        symbol props VoiceCallManager
      cpp implementation data type element tones: type-reference={inplace=false, type-reference=String}
    RegionInfo: compu {texttable}, range raw 0..23, type-emitter=TYPE_EMITTER_ARA, type-reference=uint32_t
      namespaces:
        symbol props Vehicle
        symbol props Vcc
        symbol props Policy
    RegisterationStatus: category=STRUCTURE, type-emitter=TYPE_EMITTER_ARA
      namespaces:
        symbol props DCU
        symbol props Telephony
        symbol props NetworkInformation
      6 x cpp implementation data type element:
        status: type-reference={inplace=false, type-reference=NetRegStatus}
        rat: type-reference={inplace=false, type-reference=RatType}
        rejectCause: type-reference={inplace=false, type-reference=uint32_t}
        emergencyEnabled: type-reference={inplace=false, type-reference=bool}
        lac: type-reference={inplace=false, type-reference=String}
        ci: type-reference={inplace=false, type-reference=String}
    RegistrationStatus: compu {texttable}, range raw 0..6, type-emitter=TYPE_EMITTER_ARA, type-reference=uint32_t
      namespaces:
        symbol props Vehicle
        symbol props MSM
        symbol props NetworkManager
    ReleaseInfo: category=STRUCTURE, type-emitter=TYPE_EMITTER_ARA
      namespaces:
        symbol props Info
        symbol props Update
        symbol props InteractionManager
      cpp implementation data type element ReleaseID: type-reference={inplace=false, type-reference=String}  # a unique identifier for the software release
      cpp implementation data type element props: type-reference={inplace=false, type-reference=CPP/KeyValueMap}  # The list of keys defined in the KeyValueMap props is as follows:1. "UpdateState": Indicates the status of a software releaseThe value of the "UpdateState" key is as follows:- "NewUpdate": The state of receiving new version information and description information from the server- "DownloadApprovalWaiting": Display of the download consent popup- "DownloadReady": Approval of downloading by agreeing- "Downloading": Download in progress- "DownloadDone": Download complete- "BackgroundTransferring": Background transfer in progress- "BackgroundTransferDone": Background transfer complete- "UpdateApprovalWaiting": Display of the update consent popup- "UpdateReady": Approval of update by agreeing- "Updating": Update in progress- "UpdateDone": Update complete (including rollback/failure)
    RemoveContextError: compu {texttable}, range raw 0..5, type-emitter=TYPE_EMITTER_ARA, type-reference=uint32_t
      namespaces:
        symbol props DCU
        symbol props Telephony
        symbol props MessageManager
    RemoveContextError: compu {texttable}, range raw 0..5, type-emitter=TYPE_EMITTER_ARA, type-reference=uint32_t
      namespaces:
        symbol props DCU
        symbol props Telephony
        symbol props EngineeringMode
    RemoveContextError: compu {texttable}, range raw 0..5, type-emitter=TYPE_EMITTER_ARA, type-reference=uint32_t
      namespaces:
        symbol props DCU
        symbol props Telephony
        symbol props VoiceCallManager
    RemoveContextError: compu {texttable}, range raw 0..5, type-emitter=TYPE_EMITTER_ARA, type-reference=uint32_t
      namespaces:
        symbol props DCU
        symbol props Telephony
        symbol props SimManager
    RemoveContextError: compu {texttable}, range raw 0..5, type-emitter=TYPE_EMITTER_ARA, type-reference=uint32_t
      namespaces:
        symbol props DCU
        symbol props Telephony
        symbol props ConnectionContext
    RemoveContextError: compu {texttable}, range raw 0..5, type-emitter=TYPE_EMITTER_ARA, type-reference=uint32_t
      namespaces:
        symbol props DCU
        symbol props Telephony
        symbol props ConnectionManager
    RemoveContextError: compu {texttable}, range raw 0..5, type-emitter=TYPE_EMITTER_ARA, type-reference=uint32_t
      namespaces:
        symbol props DCU
        symbol props Telephony
        symbol props NetworkInformation
    RemoveContextError: compu {texttable}, range raw 0..5, type-emitter=TYPE_EMITTER_ARA, type-reference=uint32_t
      namespaces:
        symbol props DCU
        symbol props Telephony
        symbol props ModemManager
    RemoveMTRequestError: compu {texttable}, range raw 0..3, type-emitter=TYPE_EMITTER_ARA, type-reference=uint32_t
      namespaces:
        symbol props CCU
        symbol props Cloud
        symbol props Communicator
    ReprogrammingResultType: category=STRUCTURE, type-emitter=TYPE_EMITTER_ARA
      namespaces:
        symbol props Vehicle
        symbol props FlashingAdaptor
        symbol props PackageManagement
      5 x cpp implementation data type element:
        transferID: type-reference={inplace=false, type-reference=CPP/TransferIdType}
        result: type-reference={inplace=false, type-reference=CPP/SwUnitResultType}
        reason: type-reference={inplace=false, type-reference=String}
        leadTime: type-reference={inplace=false, type-reference=uint32_t}
        needRollback: type-reference={inplace=false, type-reference=bool}
    ReprogrammingResultVectorType: category=VECTOR, cpp-template-argument=ReprogrammingResultType, type-emitter=TYPE_EMITTER_ARA
      namespaces:
        symbol props Vehicle
        symbol props FlashingAdaptor
        symbol props PackageManagement
    RequestAction_EventData: category=STRUCTURE, type-emitter=TYPE_EMITTER_ARA
      namespaces:
        symbol props CCU
        symbol props Mode
        symbol props Routines
      cpp implementation data type element actionInfo: type-reference={inplace=false, type-reference=CPP/KeyValueMap}
      cpp implementation data type element routineOwner: type-reference={inplace=false, type-reference=String}
    RequestAlertLog_alertLogs_VECTOR: category=VECTOR, cpp-template-argument=CIDSAlertLog, type-emitter=TYPE_EMITTER_ARA
      namespaces:
        symbol props Vehicle
        symbol props CIDS
        symbol props CIDSDiagInfo
    RequestBusOffLog_busOffLogs_VECTOR: category=VECTOR, cpp-template-argument=CIDSBusOffLog, type-emitter=TYPE_EMITTER_ARA
      namespaces:
        symbol props Vehicle
        symbol props CIDS
        symbol props CIDSDiagInfo
    RequestCompletion_EventData: category=STRUCTURE, type-emitter=TYPE_EMITTER_ARA
      namespaces:
        symbol props Vehicle
        symbol props Telemanager
        symbol props HTTP
      cpp implementation data type element result: type-reference={inplace=false, type-reference=CPP/CCResult}
      cpp implementation data type element requestID: type-reference={inplace=false, type-reference=String}
    RequestError: compu {texttable}, range raw 0..2, type-emitter=TYPE_EMITTER_ARA, type-reference=uint32_t
      namespaces:
        symbol props CCU
        symbol props Vehicle
        symbol props S2S
    RequestError: compu {texttable}, range raw 0..2, type-emitter=TYPE_EMITTER_ARA, type-reference=uint32_t
      namespaces:
        symbol props CCU
        symbol props Vehicle
        symbol props DiagnosticRouting
    RequestError: compu {texttable}, range raw 0..2, type-emitter=TYPE_EMITTER_ARA, type-reference=uint32_t
      namespaces:
        symbol props CCU
        symbol props Vehicle
        symbol props DiagnosticService
    RequestError: compu {texttable}, range raw 0..2, type-emitter=TYPE_EMITTER_ARA, type-reference=uint32_t
      namespaces:
        symbol props BltnCam
        symbol props DrivingEvent
        symbol props Manager
    RequestError: compu {texttable}, range raw 0..2, type-emitter=TYPE_EMITTER_ARA, type-reference=uint32_t
      namespaces:
        symbol props BltnCam
        symbol props ParkingEvent
        symbol props Manager
    RequestInteractionUI_ReleaseIDList_VECTOR: category=VECTOR, cpp-template-argument=String, type-emitter=TYPE_EMITTER_ARA
      namespaces:
        symbol props Info
        symbol props Update
        symbol props InteractionManager
    RequestModemFOTA: compu {texttable}, range raw 0..1, type-emitter=TYPE_EMITTER_ARA, type-reference=uint32_t
      namespaces:
        symbol props DCU
        symbol props Telephony
        symbol props ModemManager
    RequestTimeOutLog_timeOutLogs_VECTOR: category=VECTOR, cpp-template-argument=CIDSTimeOutLog, type-emitter=TYPE_EMITTER_ARA
      namespaces:
        symbol props Vehicle
        symbol props CIDS
        symbol props CIDSDiagInfo
    RequestedEcuType: category=STRUCTURE, type-emitter=TYPE_EMITTER_ARA
      namespaces:
        symbol props Vehicle
        symbol props RFSM
        symbol props RemoteFileSystemManager
      cpp implementation data type element swName: type-reference={inplace=false, type-reference=String}
      cpp implementation data type element availability: type-reference={inplace=false, type-reference=bool}
    RequestedEcuVectorType: category=VECTOR, cpp-template-argument=RequestedEcuType, type-emitter=TYPE_EMITTER_ARA
      namespaces:
        symbol props Vehicle
        symbol props RFSM
        symbol props RemoteFileSystemManager
    ResetPrepareRequested_EventData: category=STRUCTURE, type-emitter=TYPE_EMITTER_ARA
      namespaces:
        symbol props Vehicle
        symbol props UpdateMaster
        symbol props PackageManagement
      cpp implementation data type element ev1: type-reference={inplace=false, type-reference=bool}
    ResponseMessage_EventData: category=STRUCTURE, type-emitter=TYPE_EMITTER_ARA
      namespaces:
        symbol props Vehicle
        symbol props Telemanager
        symbol props HTTP
      cpp implementation data type element response: type-reference={inplace=false, type-reference=CPP/CCHTTPResponse}
      cpp implementation data type element error: type-reference={inplace=false, type-reference=CPP/CCHTTPError}
      cpp implementation data type element requestID: type-reference={inplace=false, type-reference=String}
    Result: compu {texttable}, range raw 0..3, type-emitter=TYPE_EMITTER_ARA, type-reference=uint32_t
      namespaces:
        symbol props Vehicle
        symbol props VAM
        symbol props Mode
    Result: compu {texttable}, range raw 0..3, type-emitter=TYPE_EMITTER_ARA, type-reference=uint32_t
      namespaces:
        symbol props Vehicle
        symbol props CCS
        symbol props Monitoring
    Result: compu {texttable}, range raw 0..3, type-emitter=TYPE_EMITTER_ARA, type-reference=uint32_t
      namespaces:
        symbol props Vehicle
        symbol props Telemanager
        symbol props Provisioning
    Result: compu {texttable}, range raw 0..3, type-emitter=TYPE_EMITTER_ARA, type-reference=uint32_t
      namespaces:
        symbol props Vehicle
        symbol props MSM
        symbol props ModemManager
    Result: compu {texttable}, range raw 0..3, type-emitter=TYPE_EMITTER_ARA, type-reference=uint32_t
      namespaces:
        symbol props Vehicle
        symbol props SM
        symbol props StateManager
    Result: compu {texttable}, range raw 0..3, type-emitter=TYPE_EMITTER_ARA, type-reference=uint32_t
      namespaces:
        symbol props Vehicle
        symbol props TraceEngine
        symbol props Log
    Result: compu {texttable}, range raw 0..3, type-emitter=TYPE_EMITTER_ARA, type-reference=uint32_t
      namespaces:
        symbol props Vehicle
        symbol props MSM
        symbol props MessageManager
    Result: compu {texttable}, range raw 0..3, type-emitter=TYPE_EMITTER_ARA, type-reference=uint32_t
      namespaces:
        symbol props Vehicle
        symbol props MSM
        symbol props APNManager
    ResultString: category=STRUCTURE, type-emitter=TYPE_EMITTER_ARA
      namespaces:
        symbol props Vehicle
        symbol props ApSysMgr
        symbol props SysInfoManager
      cpp implementation data type element val: type-reference={inplace=false, type-reference=String}
      cpp implementation data type element error: type-reference={inplace=false, type-reference=CPP/Error}
    ResultType: compu {texttable}, range raw 0..1, type-emitter=TYPE_EMITTER_ARA, type-reference=uint32_t
      namespaces:
        symbol props Vehicle
        symbol props CM
        symbol props PackageManagement
    ResultType: compu {texttable}, range raw 0..1, type-emitter=TYPE_EMITTER_ARA, type-reference=uint32_t
      namespaces:
        symbol props ara
        symbol props ucm
        symbol props pkgmgr
    ResultUint: category=STRUCTURE, type-emitter=TYPE_EMITTER_ARA
      namespaces:
        symbol props Vehicle
        symbol props ApSysMgr
        symbol props SysInfoManager
      cpp implementation data type element val: type-reference={inplace=false, type-reference=uint64_t}
      cpp implementation data type element error: type-reference={inplace=false, type-reference=CPP/Error}
    RfsmResponseType: compu {texttable}, range raw 1..10, type-emitter=TYPE_EMITTER_ARA, type-reference=uint32_t
      namespaces:
        symbol props Vehicle
        symbol props RFSM
        symbol props RemoteFileSystemManager
    RollbackResultType: compu {texttable}, range raw 0..3, type-emitter=TYPE_EMITTER_ARA, type-reference=uint32_t
      namespaces:
        symbol props Vehicle
        symbol props CM
        symbol props PackageManagement
    RollbackResultType: compu {texttable}, range raw 0..3, type-emitter=TYPE_EMITTER_ARA, type-reference=uint32_t
      namespaces:
        symbol props ara
        symbol props ucm
        symbol props pkgmgr
    Routine: category=STRUCTURE, type-emitter=TYPE_EMITTER_ARA
      namespaces:
        symbol props CCU
        symbol props Mode
        symbol props Routines
      cpp implementation data type element routineOwner: type-reference={inplace=false, type-reference=String}  # Routine Owner
      cpp implementation data type element routineConfiguration: type-reference={inplace=false, type-reference=String}  # Routine Configuration
    RoutineControlType: compu {texttable}, range raw 0..2, type-emitter=TYPE_EMITTER_ARA, type-reference=uint32_t
      namespaces:
        symbol props Update
        symbol props USS
        symbol props UpdateStandard
    RoutineError: compu {texttable}, range raw 0..2, type-emitter=TYPE_EMITTER_ARA, type-reference=uint32_t
      namespaces:
        symbol props CCU
        symbol props Mode
        symbol props Routines
    RoutineState: compu {texttable}, range raw 0..4, type-emitter=TYPE_EMITTER_ARA, type-reference=uint32_t
      namespaces:
        symbol props CCU
        symbol props Mode
        symbol props Routines
    RoutineStatus: category=STRUCTURE, type-emitter=TYPE_EMITTER_ARA
      namespaces:
        symbol props CCU
        symbol props Mode
        symbol props Routines
      4 x cpp implementation data type element:
        routineOwner: type-reference={inplace=false, type-reference=String}  # Current running Routine Owner Information(HU/CCRC)
        routineId: type-reference={inplace=false, type-reference=uint32_t}  # Running Routine ID
        routineState: type-reference={inplace=false, type-reference=RoutineState}  # Routine State
        remainingTime: type-reference={inplace=false, type-reference=int32_t}  # Routine Remaining Time
    RpcStats: category=STRUCTURE, type-emitter=TYPE_EMITTER_ARA
      namespaces:
        symbol props Vehicle
        symbol props SharedStorage
        symbol props Status
      4 x cpp implementation data type element, all with type-reference={inplace=false, type-reference=uint64_t}:
        calls
        badcalls
        badfmt
        badauth
    SAS_01_10ms_EventData: category=STRUCTURE, type-emitter=TYPE_EMITTER_ARA
      namespaces:
        symbol props Vehicle
        symbol props SOAAdaptor
        symbol props Chassis
      cpp implementation data type element pdu: type-reference={inplace=false, type-reference=SAS_01_10ms_pdu_VECTOR}
    SAS_01_10ms_pdu_VECTOR: category=VECTOR, cpp-template-argument=uint8_t, type-emitter=TYPE_EMITTER_ARA
      namespaces:
        symbol props Vehicle
        symbol props SOAAdaptor
        symbol props Chassis
    SF20ERR: compu {texttable}, range raw 0..19, type-emitter=TYPE_EMITTER_ARA, type-reference=uint32_t
      namespaces:
        symbol props Vehicle
        symbol props Security
        symbol props SecureFlash2
    SMSInformation: category=STRUCTURE, type-emitter=TYPE_EMITTER_ARA
      namespaces:
        symbol props Vehicle
        symbol props MSM
        symbol props MessageManager
      7 x cpp implementation data type element:
        msgID: type-reference={inplace=false, type-reference=String}
        receivedTime: type-reference={inplace=false, type-reference=String}
        dcs: type-reference={inplace=false, type-reference=int32_t}
        pid: type-reference={inplace=false, type-reference=int32_t}
        centerNum: type-reference={inplace=false, type-reference=String}
        length: type-reference={inplace=false, type-reference=int32_t}
        pdu: type-reference={inplace=false, type-reference=String}
    SMSValidityStatus: compu {texttable}, range raw 0..4, type-emitter=TYPE_EMITTER_ARA, type-reference=uint32_t
      namespaces:
        symbol props Vehicle
        symbol props Telemanager
        symbol props MobileMessage
    SMState: compu {texttable}, range raw 0..8, type-emitter=TYPE_EMITTER_ARA, type-reference=uint32_t
      namespaces:
        symbol props Vehicle
        symbol props SM
        symbol props StateManager
    SafetyPolicyType: category=ASSOCIATIVE_MAP, template-arguments=[{category=ASSOC_MAP_KEY, template-type=String}, {category=ASSOC_MAP_VALUE, template-type=String}], type-emitter=TYPE_EMITTER_ARA
      namespaces:
        symbol props Vehicle
        symbol props VSM
        symbol props SafeStatusManagement
    SafetyResultType: category=ASSOCIATIVE_MAP, template-arguments=[{category=ASSOC_MAP_KEY, template-type=String}, {category=ASSOC_MAP_VALUE, template-type=bool}], type-emitter=TYPE_EMITTER_ARA
      namespaces:
        symbol props Vehicle
        symbol props VSM
        symbol props SafeStatusManagement
    SecurityAccessDataType: category=STRUCTURE, type-emitter=TYPE_EMITTER_ARA
      namespaces:
        symbol props Update
        symbol props USS
        symbol props UpdateStandard
      cpp implementation data type element size: type-reference={inplace=false, type-reference=uint32_t}
      cpp implementation data type element data: type-reference={inplace=false, type-reference=ByteArray}
    SecurityAccessType: compu {texttable}, range raw 17..20, type-emitter=TYPE_EMITTER_ARA, type-reference=uint32_t
      namespaces:
        symbol props Update
        symbol props USS
        symbol props UpdateStandard
    SecurityLevelType: compu {texttable}, range raw 0..2, type-emitter=TYPE_EMITTER_ARA, type-reference=uint32_t
      namespaces:
        symbol props Update
        symbol props USS
        symbol props UpdateStandard
    SecurityLevelType: compu {texttable}, range raw 0..2, type-emitter=TYPE_EMITTER_ARA, type-reference=uint32_t
      namespaces:
        symbol props Vehicle
        symbol props SDE
        symbol props SelfDiagnosis
    SelfUpdateEngineStatusType: compu {texttable}, range raw 0..15, type-emitter=TYPE_EMITTER_ARA, type-reference=uint32_t
      namespaces:
        symbol props Vehicle
        symbol props SelfUpdateEngine
        symbol props DeltaUpdate
    SelfupdateEngineErrorDomain: compu {texttable}, range raw 0..113, type-emitter=TYPE_EMITTER_ARA, type-reference=uint32_t
      namespaces:
        symbol props Vehicle
        symbol props SelfUpdateEngine
        symbol props DeltaUpdate
    SendBatCellInfo_EventData: category=STRUCTURE, type-emitter=TYPE_EMITTER_ARA
      namespaces:
        symbol props CCU
        symbol props Vehicle
        symbol props S2S
      cpp implementation data type element datalist: type-reference={inplace=false, type-reference=SendBatCellInfo_datalist_VECTOR}
    SendBatCellInfo_datalist_VECTOR: category=VECTOR, cpp-template-argument=NemsBattInfo, type-emitter=TYPE_EMITTER_ARA
      namespaces:
        symbol props CCU
        symbol props Vehicle
        symbol props S2S
    SendBatWarnData_EventData: category=STRUCTURE, type-emitter=TYPE_EMITTER_ARA
      namespaces:
        symbol props CCU
        symbol props Vehicle
        symbol props S2S
      cpp implementation data type element data: type-reference={inplace=false, type-reference=BatWarnSignal}
    SendCommonData_EventData: category=STRUCTURE, type-emitter=TYPE_EMITTER_ARA
      namespaces:
        symbol props CCU
        symbol props Vehicle
        symbol props S2S
      cpp implementation data type element datalist: type-reference={inplace=false, type-reference=SendCommonData_datalist_VECTOR}
    SendCommonData_datalist_VECTOR: category=VECTOR, cpp-template-argument=CommonSignal, type-emitter=TYPE_EMITTER_ARA
      namespaces:
        symbol props CCU
        symbol props Vehicle
        symbol props S2S
    SendECallData_EventData: category=STRUCTURE, type-emitter=TYPE_EMITTER_ARA
      namespaces:
        symbol props CCU
        symbol props Vehicle
        symbol props S2S
      cpp implementation data type element seatbltValue: type-reference={inplace=false, type-reference=SendECallData_seatbltValue_VECTOR}
    SendECallData_RealTime_EventData: category=STRUCTURE, type-emitter=TYPE_EMITTER_ARA
      namespaces:
        symbol props CCU
        symbol props Vehicle
        symbol props S2S
      cpp implementation data type element datalist: type-reference={inplace=false, type-reference=SendECallData_RealTime_datalist_VECTOR}
    SendECallData_RealTime_datalist_VECTOR: category=VECTOR, cpp-template-argument=ECall_R, type-emitter=TYPE_EMITTER_ARA
      namespaces:
        symbol props CCU
        symbol props Vehicle
        symbol props S2S
    SendECallData_seatbltValue_VECTOR: category=VECTOR, cpp-template-argument=uint32_t, type-emitter=TYPE_EMITTER_ARA
      namespaces:
        symbol props CCU
        symbol props Vehicle
        symbol props S2S
    SendFCData_EventData: category=STRUCTURE, type-emitter=TYPE_EMITTER_ARA
      namespaces:
        symbol props CCU
        symbol props Vehicle
        symbol props S2S
      cpp implementation data type element dataList: type-reference={inplace=false, type-reference=SendFCData_dataList_VECTOR}
    SendFCData_dataList_VECTOR: category=VECTOR, cpp-template-argument=NemsFCSignal, type-emitter=TYPE_EMITTER_ARA
      namespaces:
        symbol props CCU
        symbol props Vehicle
        symbol props S2S
    SendIdcCurrentData_EventData: category=STRUCTURE, type-emitter=TYPE_EMITTER_ARA
      namespaces:
        symbol props CCU
        symbol props Vehicle
        symbol props S2S
      cpp implementation data type element datalist: type-reference={inplace=false, type-reference=SendIdcCurrentData_datalist_VECTOR}
    SendIdcCurrentData_datalist_VECTOR: category=VECTOR, cpp-template-argument=NemsIdcCurrent, type-emitter=TYPE_EMITTER_ARA
      namespaces:
        symbol props CCU
        symbol props Vehicle
        symbol props S2S
    SendMessageResult_EventData: category=STRUCTURE, type-emitter=TYPE_EMITTER_ARA
      namespaces:
        symbol props DCU
        symbol props Telephony
        symbol props MessageManager
      cpp implementation data type element msgID: type-reference={inplace=false, type-reference=String}
      cpp implementation data type element status: type-reference={inplace=false, type-reference=CPP/MessageStatus}
    SendMessageResult_EventData: category=STRUCTURE, type-emitter=TYPE_EMITTER_ARA
      namespaces:
        symbol props Vehicle
        symbol props MSM
        symbol props MessageManager
      cpp implementation data type element msgID: type-reference={inplace=false, type-reference=String}
      cpp implementation data type element status: type-reference={inplace=false, type-reference=CPP/MessageStatus}
    SendNemsData_EventData: category=STRUCTURE, type-emitter=TYPE_EMITTER_ARA
      namespaces:
        symbol props CCU
        symbol props Vehicle
        symbol props S2S
      cpp implementation data type element datalist: type-reference={inplace=false, type-reference=SendNemsData_datalist_VECTOR}
    SendNemsData_datalist_VECTOR: category=VECTOR, cpp-template-argument=NemsSignal, type-emitter=TYPE_EMITTER_ARA
      namespaces:
        symbol props CCU
        symbol props Vehicle
        symbol props S2S
    SendSMSMessageCompletion_EventData: category=STRUCTURE, type-emitter=TYPE_EMITTER_ARA
      namespaces:
        symbol props Vehicle
        symbol props Telemanager
        symbol props MobileMessage
      cpp implementation data type element msgID: type-reference={inplace=false, type-reference=String}
      cpp implementation data type element status: type-reference={inplace=false, type-reference=CPP/MessageStatus}
    ServerReportRequested_EventData: category=STRUCTURE, type-emitter=TYPE_EMITTER_ARA
      namespaces:
        symbol props Vehicle
        symbol props UpdateMaster
        symbol props PackageManagement
      cpp implementation data type element ev1: type-reference={inplace=false, type-reference=SwReleaseServerReportType}
    ServiceGroup: category=STRUCTURE, type-emitter=TYPE_EMITTER_ARA
      namespaces:
        symbol props CCU
        symbol props ExternalNetwork
        symbol props Manager2
      5 x cpp implementation data type element:
        grouptype: type-reference={inplace=false, type-reference=String}
        apn: type-reference={inplace=false, type-reference=String}
        iptype: type-reference={inplace=false, type-reference=CPP/ProtocolTypes}
        status: type-reference={inplace=false, type-reference=CPP/ConnectionStatus}
        ipconfig: type-reference={inplace=false, type-reference=ServiceGroup_ipconfig_VECTOR}
    ServiceGroup_ipconfig_VECTOR: category=VECTOR, cpp-template-argument=EndpointConfiguration, type-emitter=TYPE_EMITTER_ARA
      namespaces:
        symbol props CCU
        symbol props ExternalNetwork
        symbol props Manager2
    ServiceGroupsActivity: category=STRUCTURE, type-emitter=TYPE_EMITTER_ARA
      namespaces:
        symbol props CCU
        symbol props ExternalNetwork
        symbol props Manager2
      cpp implementation data type element grouptype: type-reference={inplace=false, type-reference=String}
      cpp implementation data type element rx_bytes: type-reference={inplace=false, type-reference=uint64_t}
      cpp implementation data type element tx_bytes: type-reference={inplace=false, type-reference=uint64_t}
    ServiceGroups_VECTOR: category=VECTOR, cpp-template-argument=ServiceGroup, type-emitter=TYPE_EMITTER_ARA
      namespaces:
        symbol props CCU
        symbol props ExternalNetwork
        symbol props Manager2
    SessionState: category=STRUCTURE, type-emitter=TYPE_EMITTER_ARA
      namespaces:
        symbol props Vehicle
        symbol props SM
        symbol props StateManager
      cpp implementation data type element appName: type-reference={inplace=false, type-reference=String}
      cpp implementation data type element isActive: type-reference={inplace=false, type-reference=bool}
    SessionStateField_VECTOR: category=VECTOR, cpp-template-argument=SessionState, type-emitter=TYPE_EMITTER_ARA
      namespaces:
        symbol props Vehicle
        symbol props SM
        symbol props StateManager
    SetContainerRules_rules_VECTOR: category=VECTOR, cpp-template-argument=String, type-emitter=TYPE_EMITTER_ARA
      namespaces:
        symbol props Vehicle
        symbol props Vcc
        symbol props Policy
    SetContextIndexError: compu {texttable}, range raw 0..6, type-emitter=TYPE_EMITTER_ARA, type-reference=uint32_t
      namespaces:
        symbol props DCU
        symbol props Telephony
        symbol props MessageManager
    SetContextIndexError: compu {texttable}, range raw 0..6, type-emitter=TYPE_EMITTER_ARA, type-reference=uint32_t
      namespaces:
        symbol props DCU
        symbol props Telephony
        symbol props EngineeringMode
    SetContextIndexError: compu {texttable}, range raw 0..6, type-emitter=TYPE_EMITTER_ARA, type-reference=uint32_t
      namespaces:
        symbol props DCU
        symbol props Telephony
        symbol props VoiceCallManager
    SetContextIndexError: compu {texttable}, range raw 0..6, type-emitter=TYPE_EMITTER_ARA, type-reference=uint32_t
      namespaces:
        symbol props DCU
        symbol props Telephony
        symbol props SimManager
    SetContextIndexError: compu {texttable}, range raw 0..6, type-emitter=TYPE_EMITTER_ARA, type-reference=uint32_t
      namespaces:
        symbol props DCU
        symbol props Telephony
        symbol props ConnectionContext
    SetContextIndexError: compu {texttable}, range raw 0..6, type-emitter=TYPE_EMITTER_ARA, type-reference=uint32_t
      namespaces:
        symbol props DCU
        symbol props Telephony
        symbol props ConnectionManager
    SetContextIndexError: compu {texttable}, range raw 0..6, type-emitter=TYPE_EMITTER_ARA, type-reference=uint32_t
      namespaces:
        symbol props DCU
        symbol props Telephony
        symbol props NetworkInformation
    SetContextIndexError: compu {texttable}, range raw 0..6, type-emitter=TYPE_EMITTER_ARA, type-reference=uint32_t
      namespaces:
        symbol props DCU
        symbol props Telephony
        symbol props ModemManager
    SetError: compu {texttable}, range raw 0..2, type-emitter=TYPE_EMITTER_ARA, type-reference=uint32_t
      namespaces:
        symbol props Info
        symbol props Cluster
        symbol props InformationProvider
    SetError: compu {texttable}, range raw 0..2, type-emitter=TYPE_EMITTER_ARA, type-reference=uint32_t
      namespaces:
        symbol props CCU
        symbol props FoD
        symbol props Screen
    SetError: compu {texttable}, range raw 0..2, type-emitter=TYPE_EMITTER_ARA, type-reference=uint32_t
      namespaces:
        symbol props Info
        symbol props Update
        symbol props RFSManager
    SetError: compu {texttable}, range raw 0..2, type-emitter=TYPE_EMITTER_ARA, type-reference=uint32_t
      namespaces:
        symbol props CCU
        symbol props Update
        symbol props Screen
    SetError: compu {texttable}, range raw 0..2, type-emitter=TYPE_EMITTER_ARA, type-reference=uint32_t
      namespaces:
        symbol props Info
        symbol props Setup
        symbol props GeneralSettings
    SetError: compu {texttable}, range raw 0..2, type-emitter=TYPE_EMITTER_ARA, type-reference=uint32_t
      namespaces:
        symbol props Info
        symbol props Update
        symbol props InteractionManager
    SetError: compu {texttable}, range raw 0..2, type-emitter=TYPE_EMITTER_ARA, type-reference=uint32_t
      namespaces:
        symbol props Info
        symbol props Cloud
        symbol props ProvisioningTable
    SetFoDPackage_FoDPackages_VECTOR: category=VECTOR, cpp-template-argument=CPP/KeyValue, type-emitter=TYPE_EMITTER_ARA
      namespaces:
        symbol props CCU
        symbol props FoD
        symbol props Screen
    SetFodVinStatus: compu {texttable}, range raw 0..49, type-emitter=TYPE_EMITTER_ARA, type-reference=uint32_t
      namespaces:
        symbol props Vehicle
        symbol props FoDMaster
        symbol props Support
    SetPartialNetworkInfo_pnMap_VECTOR: category=VECTOR, cpp-template-argument=bool, type-emitter=TYPE_EMITTER_ARA
      namespaces:
        symbol props Vehicle
        symbol props IPCHandler
        symbol props RoutingIPC
    SetPnCluster_pnMap_VECTOR: category=VECTOR, cpp-template-argument=bool, type-emitter=TYPE_EMITTER_ARA
      namespaces:
        symbol props Vehicle
        symbol props ApSysMgr
        symbol props NetManager
    SetPropertyError: compu {texttable}, range raw 0..5, type-emitter=TYPE_EMITTER_ARA, type-reference=uint32_t
      namespaces:
        symbol props DCU
        symbol props System
        symbol props Variation
    SetPropertyError: compu {texttable}, range raw 0..5, type-emitter=TYPE_EMITTER_ARA, type-reference=uint32_t
      namespaces:
        symbol props DCU
        symbol props Telephony
        symbol props MessageManager
    SetPropertyError: compu {texttable}, range raw 0..5, type-emitter=TYPE_EMITTER_ARA, type-reference=uint32_t
      namespaces:
        symbol props DCU
        symbol props Telephony
        symbol props EngineeringMode
    SetPropertyError: compu {texttable}, range raw 0..5, type-emitter=TYPE_EMITTER_ARA, type-reference=uint32_t
      namespaces:
        symbol props DCU
        symbol props Telephony
        symbol props VoiceCallManager
    SetPropertyError: compu {texttable}, range raw 0..5, type-emitter=TYPE_EMITTER_ARA, type-reference=uint32_t
      namespaces:
        symbol props DCU
        symbol props Telephony
        symbol props SimManager
    SetPropertyError: compu {texttable}, range raw 0..5, type-emitter=TYPE_EMITTER_ARA, type-reference=uint32_t
      namespaces:
        symbol props DCU
        symbol props System
        symbol props Time
    SetPropertyError: compu {texttable}, range raw 0..5, type-emitter=TYPE_EMITTER_ARA, type-reference=uint32_t
      namespaces:
        symbol props DCU
        symbol props Telephony
        symbol props ConnectionContext
    SetPropertyError: compu {texttable}, range raw 0..5, type-emitter=TYPE_EMITTER_ARA, type-reference=uint32_t
      namespaces:
        symbol props DCU
        symbol props System
        symbol props PowerManagement
    SetPropertyError: compu {texttable}, range raw 0..5, type-emitter=TYPE_EMITTER_ARA, type-reference=uint32_t
      namespaces:
        symbol props CCU
        symbol props System
        symbol props EngineeringMode
    SetPropertyError: compu {texttable}, range raw 0..5, type-emitter=TYPE_EMITTER_ARA, type-reference=uint32_t
      namespaces:
        symbol props DCU
        symbol props Telephony
        symbol props ConnectionManager
    SetPropertyError: compu {texttable}, range raw 0..5, type-emitter=TYPE_EMITTER_ARA, type-reference=uint32_t
      namespaces:
        symbol props DCU
        symbol props Telephony
        symbol props NetworkInformation
    SetPropertyError: compu {texttable}, range raw 0..5, type-emitter=TYPE_EMITTER_ARA, type-reference=uint32_t
      namespaces:
        symbol props DCU
        symbol props Telephony
        symbol props ModemManager
    Settings_DomainNameServers_VECTOR: category=VECTOR, cpp-template-argument=String, type-emitter=TYPE_EMITTER_ARA
      namespaces:
        symbol props DCU
        symbol props Telephony
        symbol props ConnectionContext
    ShareStatus: category=STRUCTURE, type-emitter=TYPE_EMITTER_ARA
      namespaces:
        symbol props Vehicle
        symbol props SharedStorage
        symbol props Status
      7 x cpp implementation data type element:
        sid: type-reference={inplace=false, type-reference=String}
        name: type-reference={inplace=false, type-reference=String}
        size: type-reference={inplace=false, type-reference=uint64_t}
        usedSpace: type-reference={inplace=false, type-reference=uint64_t}
        freeSpace: type-reference={inplace=false, type-reference=uint64_t}
        minimumShareSize: type-reference={inplace=false, type-reference=uint64_t}
        isMounted: type-reference={inplace=false, type-reference=bool}
    ShutdownNodeInfo: category=STRUCTURE, type-emitter=TYPE_EMITTER_ARA
      namespaces:
        symbol props Vehicle
        symbol props SM
        symbol props StateManager
      cpp implementation data type element appName: type-reference={inplace=false, type-reference=String}
      cpp implementation data type element timeout: type-reference={inplace=false, type-reference=uint8_t}
    SignalInfo_Float: category=STRUCTURE, type-emitter=TYPE_EMITTER_ARA
      namespaces:
        symbol props Vehicle
        symbol props SOAAdaptor
        symbol props Body1
      cpp implementation data type element canStatus: type-reference={inplace=false, type-reference=CPP/CANStatus}
      cpp implementation data type element signal_value: type-reference={inplace=false, type-reference=float}
    SignalInfo_Float: category=STRUCTURE, type-emitter=TYPE_EMITTER_ARA
      namespaces:
        symbol props Vehicle
        symbol props SOAAdaptor
        symbol props PowerTrain1
      cpp implementation data type element canStatus: type-reference={inplace=false, type-reference=CPP/CANStatus}
      cpp implementation data type element signal_value: type-reference={inplace=false, type-reference=float}
    SignalInfo_Float: category=STRUCTURE, type-emitter=TYPE_EMITTER_ARA
      namespaces:
        symbol props Vehicle
        symbol props SOAAdaptor
        symbol props Extended
      cpp implementation data type element canStatus: type-reference={inplace=false, type-reference=CPP/CANStatus}
      cpp implementation data type element signal_value: type-reference={inplace=false, type-reference=float}
    SignalInfo_Float: category=STRUCTURE, type-emitter=TYPE_EMITTER_ARA
      namespaces:
        symbol props Vehicle
        symbol props SOAAdaptor
        symbol props PowerTrain2
      cpp implementation data type element canStatus: type-reference={inplace=false, type-reference=CPP/CANStatus}
      cpp implementation data type element signal_value: type-reference={inplace=false, type-reference=float}
    SignalInfo_Float: category=STRUCTURE, type-emitter=TYPE_EMITTER_ARA
      namespaces:
        symbol props Vehicle
        symbol props SOAAdaptor
        symbol props MultiMedia
      cpp implementation data type element canStatus: type-reference={inplace=false, type-reference=CPP/CANStatus}
      cpp implementation data type element signal_value: type-reference={inplace=false, type-reference=float}
    SignalInfo_Float: category=STRUCTURE, type-emitter=TYPE_EMITTER_ARA
      namespaces:
        symbol props Vehicle
        symbol props SOAAdaptor
        symbol props Chassis
      cpp implementation data type element canStatus: type-reference={inplace=false, type-reference=CPP/CANStatus}
      cpp implementation data type element signal_value: type-reference={inplace=false, type-reference=float}
    SignalInfo_Int16: category=STRUCTURE, type-emitter=TYPE_EMITTER_ARA
      namespaces:
        symbol props Vehicle
        symbol props SOAAdaptor
        symbol props Extended
      cpp implementation data type element canStatus: type-reference={inplace=false, type-reference=CPP/CANStatus}
      cpp implementation data type element signal_value: type-reference={inplace=false, type-reference=int16_t}
    SignalInfo_Int32: category=STRUCTURE, type-emitter=TYPE_EMITTER_ARA
      namespaces:
        symbol props Vehicle
        symbol props SOAAdaptor
        symbol props Body1
      cpp implementation data type element canStatus: type-reference={inplace=false, type-reference=CPP/CANStatus}
      cpp implementation data type element signal_value: type-reference={inplace=false, type-reference=int32_t}
    SignalInfo_Int8: category=STRUCTURE, type-emitter=TYPE_EMITTER_ARA
      namespaces:
        symbol props Vehicle
        symbol props SOAAdaptor
        symbol props Body1
      cpp implementation data type element canStatus: type-reference={inplace=false, type-reference=CPP/CANStatus}
      cpp implementation data type element signal_value: type-reference={inplace=false, type-reference=int8_t}
    SignalInfo_Int8: category=STRUCTURE, type-emitter=TYPE_EMITTER_ARA
      namespaces:
        symbol props Vehicle
        symbol props SOAAdaptor
        symbol props PowerTrain2
      cpp implementation data type element canStatus: type-reference={inplace=false, type-reference=CPP/CANStatus}
      cpp implementation data type element signal_value: type-reference={inplace=false, type-reference=int8_t}
    SignalInfo_UInt16: category=STRUCTURE, type-emitter=TYPE_EMITTER_ARA
      namespaces:
        symbol props Vehicle
        symbol props SOAAdaptor
        symbol props Body1
      cpp implementation data type element canStatus: type-reference={inplace=false, type-reference=CPP/CANStatus}
      cpp implementation data type element signal_value: type-reference={inplace=false, type-reference=uint16_t}
    SignalInfo_UInt16: category=STRUCTURE, type-emitter=TYPE_EMITTER_ARA
      namespaces:
        symbol props Vehicle
        symbol props SOAAdaptor
        symbol props PowerTrain1
      cpp implementation data type element canStatus: type-reference={inplace=false, type-reference=CPP/CANStatus}
      cpp implementation data type element signal_value: type-reference={inplace=false, type-reference=uint16_t}
    SignalInfo_UInt16: category=STRUCTURE, type-emitter=TYPE_EMITTER_ARA
      namespaces:
        symbol props Vehicle
        symbol props SOAAdaptor
        symbol props Extended
      cpp implementation data type element canStatus: type-reference={inplace=false, type-reference=CPP/CANStatus}
      cpp implementation data type element signal_value: type-reference={inplace=false, type-reference=uint16_t}
    SignalInfo_UInt16: category=STRUCTURE, type-emitter=TYPE_EMITTER_ARA
      namespaces:
        symbol props Vehicle
        symbol props SOAAdaptor
        symbol props PowerTrain2
      cpp implementation data type element canStatus: type-reference={inplace=false, type-reference=CPP/CANStatus}
      cpp implementation data type element signal_value: type-reference={inplace=false, type-reference=uint16_t}
    SignalInfo_UInt16: category=STRUCTURE, type-emitter=TYPE_EMITTER_ARA
      namespaces:
        symbol props Vehicle
        symbol props SOAAdaptor
        symbol props MultiMedia
      cpp implementation data type element canStatus: type-reference={inplace=false, type-reference=CPP/CANStatus}
      cpp implementation data type element signal_value: type-reference={inplace=false, type-reference=uint16_t}
    SignalInfo_UInt32: category=STRUCTURE, type-emitter=TYPE_EMITTER_ARA
      namespaces:
        symbol props Vehicle
        symbol props SOAAdaptor
        symbol props Extended
      cpp implementation data type element canStatus: type-reference={inplace=false, type-reference=CPP/CANStatus}
      cpp implementation data type element signal_value: type-reference={inplace=false, type-reference=uint32_t}
    SignalInfo_UInt32: category=STRUCTURE, type-emitter=TYPE_EMITTER_ARA
      namespaces:
        symbol props Vehicle
        symbol props SOAAdaptor
        symbol props PowerTrain2
      cpp implementation data type element canStatus: type-reference={inplace=false, type-reference=CPP/CANStatus}
      cpp implementation data type element signal_value: type-reference={inplace=false, type-reference=uint32_t}
    SignalInfo_UInt64: category=STRUCTURE, type-emitter=TYPE_EMITTER_ARA
      namespaces:
        symbol props Vehicle
        symbol props SOAAdaptor
        symbol props Body1
      cpp implementation data type element canStatus: type-reference={inplace=false, type-reference=CPP/CANStatus}
      cpp implementation data type element signal_value: type-reference={inplace=false, type-reference=uint64_t}
    SignalInfo_UInt64: category=STRUCTURE, type-emitter=TYPE_EMITTER_ARA
      namespaces:
        symbol props Vehicle
        symbol props SOAAdaptor
        symbol props Extended
      cpp implementation data type element canStatus: type-reference={inplace=false, type-reference=CPP/CANStatus}
      cpp implementation data type element signal_value: type-reference={inplace=false, type-reference=uint64_t}
    SignalInfo_UInt64: category=STRUCTURE, type-emitter=TYPE_EMITTER_ARA
      namespaces:
        symbol props Vehicle
        symbol props SOAAdaptor
        symbol props PowerTrain2
      cpp implementation data type element canStatus: type-reference={inplace=false, type-reference=CPP/CANStatus}
      cpp implementation data type element signal_value: type-reference={inplace=false, type-reference=uint64_t}
    SignalInfo_UInt8: category=STRUCTURE, type-emitter=TYPE_EMITTER_ARA
      namespaces:
        symbol props Vehicle
        symbol props SOAAdaptor
        symbol props Body1
      cpp implementation data type element canStatus: type-reference={inplace=false, type-reference=CPP/CANStatus}
      cpp implementation data type element signal_value: type-reference={inplace=false, type-reference=uint8_t}
    SignalInfo_UInt8: category=STRUCTURE, type-emitter=TYPE_EMITTER_ARA
      namespaces:
        symbol props Vehicle
        symbol props SOAAdaptor
        symbol props PowerTrain1
      cpp implementation data type element canStatus: type-reference={inplace=false, type-reference=CPP/CANStatus}
      cpp implementation data type element signal_value: type-reference={inplace=false, type-reference=uint8_t}
    SignalInfo_UInt8: category=STRUCTURE, type-emitter=TYPE_EMITTER_ARA
      namespaces:
        symbol props Vehicle
        symbol props SOAAdaptor
        symbol props Body2
      cpp implementation data type element canStatus: type-reference={inplace=false, type-reference=CPP/CANStatus}
      cpp implementation data type element signal_value: type-reference={inplace=false, type-reference=uint8_t}
    SignalInfo_UInt8: category=STRUCTURE, type-emitter=TYPE_EMITTER_ARA
      namespaces:
        symbol props Vehicle
        symbol props SOAAdaptor
        symbol props Extended
      cpp implementation data type element canStatus: type-reference={inplace=false, type-reference=CPP/CANStatus}
      cpp implementation data type element signal_value: type-reference={inplace=false, type-reference=uint8_t}
    SignalInfo_UInt8: category=STRUCTURE, type-emitter=TYPE_EMITTER_ARA
      namespaces:
        symbol props Vehicle
        symbol props SOAAdaptor
        symbol props PowerTrain2
      cpp implementation data type element canStatus: type-reference={inplace=false, type-reference=CPP/CANStatus}
      cpp implementation data type element signal_value: type-reference={inplace=false, type-reference=uint8_t}
    SignalInfo_UInt8: category=STRUCTURE, type-emitter=TYPE_EMITTER_ARA
      namespaces:
        symbol props Vehicle
        symbol props SOAAdaptor
        symbol props MultiMedia
      cpp implementation data type element canStatus: type-reference={inplace=false, type-reference=CPP/CANStatus}
      cpp implementation data type element signal_value: type-reference={inplace=false, type-reference=uint8_t}
    SignalInfo_UInt8: category=STRUCTURE, type-emitter=TYPE_EMITTER_ARA
      namespaces:
        symbol props Vehicle
        symbol props SOAAdaptor
        symbol props Chassis
      cpp implementation data type element canStatus: type-reference={inplace=false, type-reference=CPP/CANStatus}
      cpp implementation data type element signal_value: type-reference={inplace=false, type-reference=uint8_t}
    SignalStrengthGSM: category=STRUCTURE, type-emitter=TYPE_EMITTER_ARA
      namespaces:
        symbol props DCU
        symbol props Telephony
        symbol props NetworkInformation
      cpp implementation data type element rxlev: type-reference={inplace=false, type-reference=int32_t}
      cpp implementation data type element rxqual: type-reference={inplace=false, type-reference=int32_t}
    SignalStrengthLTE: category=STRUCTURE, type-emitter=TYPE_EMITTER_ARA
      namespaces:
        symbol props DCU
        symbol props Telephony
        symbol props NetworkInformation
      4 x cpp implementation data type element, all with type-reference={inplace=false, type-reference=int32_t}:
        rssi
        rsrp
        snr
        rsrq
    SignalStrengthType: compu {texttable}, range raw 0..9, type-emitter=TYPE_EMITTER_ARA, type-reference=uint32_t
      namespaces:
        symbol props DCU
        symbol props Telephony
        symbol props NetworkInformation
    SignalStrengthType: compu {texttable}, range raw 0..9, type-emitter=TYPE_EMITTER_ARA, type-reference=uint32_t
      namespaces:
        symbol props Vehicle
        symbol props MSM
        symbol props NetworkManager
    SignalStrengthWCDMA: category=STRUCTURE, type-emitter=TYPE_EMITTER_ARA
      namespaces:
        symbol props DCU
        symbol props Telephony
        symbol props NetworkInformation
      cpp implementation data type element rssi: type-reference={inplace=false, type-reference=int32_t}
      cpp implementation data type element rscp: type-reference={inplace=false, type-reference=int32_t}
      cpp implementation data type element ecno: type-reference={inplace=false, type-reference=int32_t}
    Signal_toCAN: compu {texttable}, range raw 0..2, type-emitter=TYPE_EMITTER_ARA, type-reference=uint32_t
      namespaces:
        symbol props CCU
        symbol props Vehicle
        symbol props S2S
    SleepInformation: category=STRUCTURE, type-emitter=TYPE_EMITTER_ARA
      namespaces:
        symbol props DCU
        symbol props System
        symbol props Variation
      cpp implementation data type element elapsedTime: type-reference={inplace=false, type-reference=uint32_t}
      cpp implementation data type element remainedTime: type-reference={inplace=false, type-reference=uint32_t}
    SleepInformation: category=STRUCTURE, type-emitter=TYPE_EMITTER_ARA
      namespaces:
        symbol props DCU
        symbol props System
        symbol props Time
      cpp implementation data type element elapsedTime: type-reference={inplace=false, type-reference=uint32_t}
      cpp implementation data type element remainedTime: type-reference={inplace=false, type-reference=uint32_t}
    SleepInformation: category=STRUCTURE, type-emitter=TYPE_EMITTER_ARA
      namespaces:
        symbol props DCU
        symbol props System
        symbol props PowerManagement
      cpp implementation data type element elapsedTime: type-reference={inplace=false, type-reference=uint32_t}
      cpp implementation data type element remainedTime: type-reference={inplace=false, type-reference=uint32_t}
    SleepRemotePhys_ports_VECTOR: category=VECTOR, cpp-template-argument=PortID, type-emitter=TYPE_EMITTER_ARA
      namespaces:
        symbol props Vehicle
        symbol props EthHandler
        symbol props EthernetSwitchMgr
    SoftwareReleaseApprovals_VECTOR: category=VECTOR, cpp-template-argument=ApprovalInfo, type-emitter=TYPE_EMITTER_ARA
      namespaces:
        symbol props Info
        symbol props Update
        symbol props InteractionManager
    SoftwareReleaseLists_VECTOR: category=VECTOR, cpp-template-argument=ReleaseInfo, type-emitter=TYPE_EMITTER_ARA
      namespaces:
        symbol props Info
        symbol props Update
        symbol props InteractionManager
    StartETHMirroring_egressPort_VECTOR: category=VECTOR, cpp-template-argument=PortID, type-emitter=TYPE_EMITTER_ARA
      namespaces:
        symbol props Vehicle
        symbol props EthHandler
        symbol props EthernetSwitchMgr
    StartETHMirroring_ingressPort_VECTOR: category=VECTOR, cpp-template-argument=PortID, type-emitter=TYPE_EMITTER_ARA
      namespaces:
        symbol props Vehicle
        symbol props EthHandler
        symbol props EthernetSwitchMgr
    Statistics: category=STRUCTURE, type-emitter=TYPE_EMITTER_ARA
      namespaces:
        symbol props Vehicle
        symbol props CIDS
        symbol props CIDSInfo
      5 x cpp implementation data type element, all with type-reference={inplace=false, type-reference=uint64_t}:
        numTotalLoggedAlert
        numTotalAlertSent
        trafficUsageYearly
        numTotalVerifiedPackets
        trafficUsageMonthly
    Statistics: category=STRUCTURE, type-emitter=TYPE_EMITTER_ARA
      namespaces:
        symbol props Vehicle
        symbol props EIDS
        symbol props EIDSInfo
      5 x cpp implementation data type element, all with type-reference={inplace=false, type-reference=uint64_t}:
        numTotalLoggedAlert
        numTotalAlertSent
        trafficUsageYearly
        numTotalVerifiedPackets
        trafficUsageMonthly
    StatsIDTable: category=ASSOCIATIVE_MAP, template-arguments=[{category=ASSOC_MAP_KEY, template-type=uint8_t}, {category=ASSOC_MAP_VALUE, template-type=uint64_t}], type-emitter=TYPE_EMITTER_ARA
      namespaces:
        symbol props Vehicle
        symbol props EthHandler
        symbol props EthernetSwitchMgr
    String: category=STRING, type-emitter=TYPE_EMITTER_ARA
    StringMap: category=ASSOCIATIVE_MAP, template-arguments=[{category=ASSOC_MAP_KEY, template-type=String}, {category=ASSOC_MAP_VALUE, template-type=String}], type-emitter=TYPE_EMITTER_ARA
      namespaces:
        symbol props Vehicle
        symbol props UpdateMaster
        symbol props PackageManagement
    StringValueInfo: category=ASSOCIATIVE_MAP, type-emitter=TYPE_EMITTER_ARA
      namespaces:
        symbol props Vehicle
        symbol props ApSysMgr
        symbol props SysInfoManager
      template-arguments:
        category=ASSOC_MAP_KEY, template-type=StringValueKey
        category=ASSOC_MAP_VALUE, template-type=String
    StringValueKey: compu {texttable}, range raw 0..19, type-emitter=TYPE_EMITTER_ARA, type-reference=uint32_t
      namespaces:
        symbol props Vehicle
        symbol props ApSysMgr
        symbol props SysInfoManager
    StrongRevisionLabelString: category=STRING, type-emitter=TYPE_EMITTER_ARA
      namespaces:
        symbol props Vehicle
        symbol props CM
        symbol props PackageManagement
    StrongRevisionLabelString: category=STRING, type-emitter=TYPE_EMITTER_ARA
      namespaces:
        symbol props ara
        symbol props ucm
        symbol props pkgmgr
    StrongRevisionLabelString: category=STRING, type-emitter=TYPE_EMITTER_ARA
      namespaces:
        symbol props Vehicle
        symbol props FlashingAdaptor
        symbol props PackageManagement
    StrongRevisionLabelString: category=STRING, type-emitter=TYPE_EMITTER_ARA
      namespaces:
        symbol props Vehicle
        symbol props UpdateMaster
        symbol props PackageManagement
    SubscribeToMessages_busAndMessageIds_VECTOR: category=VECTOR, cpp-template-argument=BusAndMessageId, type-emitter=TYPE_EMITTER_ARA
      namespaces:
        symbol props Vehicle
        symbol props SOAAdaptor
        symbol props DataCollection
    Subscribe_1_pathsFilter_VECTOR: category=VECTOR, cpp-template-argument=String, type-emitter=TYPE_EMITTER_ARA
      namespaces:
        symbol props Vehicle
        symbol props VAS
        symbol props VehicleAPI
    Subscription_1_EventData: category=STRUCTURE, type-emitter=TYPE_EMITTER_ARA
      namespaces:
        symbol props Vehicle
        symbol props VAS
        symbol props VehicleAPI
      4 x cpp implementation data type element:
        subscriptionId: type-reference={inplace=false, type-reference=int64_t}
        path: type-reference={inplace=false, type-reference=String}
        value: type-reference={inplace=false, type-reference=String}
        statusCode: type-reference={inplace=false, type-reference=int16_t}
    SwClusterInfoType: category=STRUCTURE, type-emitter=TYPE_EMITTER_ARA
      namespaces:
        symbol props Vehicle
        symbol props CM
        symbol props PackageManagement
      cpp implementation data type element Name: type-reference={inplace=false, type-reference=CPP/SwNameType}
      cpp implementation data type element Version: type-reference={inplace=false, type-reference=CPP/StrongRevisionLabelString}
      cpp implementation data type element State: type-reference={inplace=false, type-reference=CPP/SwClusterStateType}
    SwClusterInfoType: category=STRUCTURE, type-emitter=TYPE_EMITTER_ARA
      namespaces:
        symbol props ara
        symbol props ucm
        symbol props pkgmgr
      cpp implementation data type element Name: type-reference={inplace=false, type-reference=CPP/SwNameType}
      cpp implementation data type element Version: type-reference={inplace=false, type-reference=CPP/StrongRevisionLabelString}
      cpp implementation data type element State: type-reference={inplace=false, type-reference=CPP/SwClusterStateType}
    SwClusterInfoType: category=STRUCTURE, type-emitter=TYPE_EMITTER_ARA
      namespaces:
        symbol props Vehicle
        symbol props FlashingAdaptor
        symbol props PackageManagement
      cpp implementation data type element Name: type-reference={inplace=false, type-reference=CPP/SwNameType}
      cpp implementation data type element Version: type-reference={inplace=false, type-reference=CPP/StrongRevisionLabelString}
      cpp implementation data type element State: type-reference={inplace=false, type-reference=CPP/SwClusterStateType}
    SwClusterInfoType: category=STRUCTURE, type-emitter=TYPE_EMITTER_ARA
      namespaces:
        symbol props Vehicle
        symbol props UpdateMaster
        symbol props PackageManagement
      cpp implementation data type element Name: type-reference={inplace=false, type-reference=CPP/SwNameType}
      cpp implementation data type element Version: type-reference={inplace=false, type-reference=CPP/StrongRevisionLabelString}
      cpp implementation data type element State: type-reference={inplace=false, type-reference=CPP/SwClusterStateType}
    SwClusterInfoVectorType: category=VECTOR, cpp-template-argument=CPP/SwClusterInfoType, type-emitter=TYPE_EMITTER_ARA
      namespaces:
        symbol props Vehicle
        symbol props CM
        symbol props PackageManagement
    SwClusterInfoVectorType: category=VECTOR, cpp-template-argument=CPP/SwClusterInfoType, type-emitter=TYPE_EMITTER_ARA
      namespaces:
        symbol props ara
        symbol props ucm
        symbol props pkgmgr
    SwClusterInfoVectorType: category=VECTOR, cpp-template-argument=CPP/SwClusterInfoType, type-emitter=TYPE_EMITTER_ARA
      namespaces:
        symbol props Vehicle
        symbol props FlashingAdaptor
        symbol props PackageManagement
    SwClusterInfoVectorType: category=VECTOR, cpp-template-argument=CPP/SwClusterInfoType, type-emitter=TYPE_EMITTER_ARA
      namespaces:
        symbol props Vehicle
        symbol props UpdateMaster
        symbol props PackageManagement
    SwClusterStateType: compu {texttable}, range raw 0..3, type-emitter=TYPE_EMITTER_ARA, type-reference=uint32_t
      namespaces:
        symbol props Vehicle
        symbol props CM
        symbol props PackageManagement
    SwClusterStateType: compu {texttable}, range raw 0..3, type-emitter=TYPE_EMITTER_ARA, type-reference=uint32_t
      namespaces:
        symbol props ara
        symbol props ucm
        symbol props pkgmgr
    SwClusterStateType: compu {texttable}, range raw 0..3, type-emitter=TYPE_EMITTER_ARA, type-reference=uint32_t
      namespaces:
        symbol props Vehicle
        symbol props FlashingAdaptor
        symbol props PackageManagement
    SwClusterStateType: compu {texttable}, range raw 0..3, type-emitter=TYPE_EMITTER_ARA, type-reference=uint32_t
      namespaces:
        symbol props Vehicle
        symbol props UpdateMaster
        symbol props PackageManagement
    SwDescType: category=STRUCTURE, type-emitter=TYPE_EMITTER_ARA
      namespaces:
        symbol props Vehicle
        symbol props CM
        symbol props PackageManagement
      6 x cpp implementation data type element:
        Name: type-reference={inplace=false, type-reference=CPP/SwNameType}
        Version: type-reference={inplace=false, type-reference=CPP/StrongRevisionLabelString}
        TypeApproval: type-reference={inplace=false, type-reference=String}
        License: type-reference={inplace=false, type-reference=String}
        ReleaseNotes: type-reference={inplace=false, type-reference=String}
        Size: type-reference={inplace=false, type-reference=uint64_t}
    SwDescType: category=STRUCTURE, type-emitter=TYPE_EMITTER_ARA
      namespaces:
        symbol props ara
        symbol props ucm
        symbol props pkgmgr
      6 x cpp implementation data type element:
        Name: type-reference={inplace=false, type-reference=CPP/SwNameType}
        Version: type-reference={inplace=false, type-reference=CPP/StrongRevisionLabelString}
        TypeApproval: type-reference={inplace=false, type-reference=String}
        License: type-reference={inplace=false, type-reference=String}
        ReleaseNotes: type-reference={inplace=false, type-reference=String}
        Size: type-reference={inplace=false, type-reference=uint64_t}
    SwDescVectorType: category=VECTOR, cpp-template-argument=CPP/SwDescType, type-emitter=TYPE_EMITTER_ARA
      namespaces:
        symbol props Vehicle
        symbol props CM
        symbol props PackageManagement
    SwDescVectorType: category=VECTOR, cpp-template-argument=CPP/SwDescType, type-emitter=TYPE_EMITTER_ARA
      namespaces:
        symbol props ara
        symbol props ucm
        symbol props pkgmgr
    SwNameType: category=STRING, type-emitter=TYPE_EMITTER_ARA
      namespaces:
        symbol props Vehicle
        symbol props CM
        symbol props PackageManagement
    SwNameType: category=STRING, type-emitter=TYPE_EMITTER_ARA
      namespaces:
        symbol props ara
        symbol props ucm
        symbol props pkgmgr
    SwNameType: category=STRING, type-emitter=TYPE_EMITTER_ARA
      namespaces:
        symbol props Vehicle
        symbol props FlashingAdaptor
        symbol props PackageManagement
    SwNameType: category=STRING, type-emitter=TYPE_EMITTER_ARA
      namespaces:
        symbol props Vehicle
        symbol props UpdateMaster
        symbol props PackageManagement
