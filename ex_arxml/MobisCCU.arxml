[part 5 of 9: packages /PortInterface/Service to /System/Service/Deployment]
AUTOSAR XML (schema 00049)
package /PortInterface/Service  (continued)
  114 x service interface:  (continued)
    Share: major-version=1, minor-version=0
      namespaces:
        symbol props Vehicle
        symbol props SharedStorage
        symbol props Share
      events:
        data OnShutdown: type=CPP/OnShutdown_EventData  # Event used to notify Client Managers to disconnect from NSS and NFS. "OTA_UPDATE" : This means that AppModeType.appModeOta is Update_preprocess(0x5)~Update_other(0x7). During OTA update process, DNMT is triggered and it can afftect to disable SOME/IP interface and nfs transmittion "CCU_SHUTDOWN" : This means that APState is NODE_SHUTDOWN
      field PolicyApplied: type=CPP/PolicyInfo, has-getter=true, has-notifier=true, has-setter=false  # Event used to notify Client Managers that current NSS policy was changed and that they should request an updated client policy. statusCode : status information for applying policy errorMessage : error message for applying policy policyVersion : This parameter indicates the policy version applied by NSS. name : The policy name applied by NSS.
      methods:
        operation IsShareAvailable  # Method used by internal client to determine if the share with provided path is ready to be used by client application.
          arg sharePath: type=String, direction=IN
          arg result: type=bool, direction=OUT
    Share: major-version=1, minor-version=1
      namespaces:
        symbol props CCU
        symbol props SharedStorage
        symbol props Share
      events:
        data OnShutdown: type=CPP/OnShutdown_EventData  # Event used to notify Client Managers to disconnect from NSS and NFS. "OTA_UPDATE" : This means that AppModeType.appModeOta is Update_preprocess(0x5)~Update_other(0x7). During OTA update process, DNMT is triggered and it can afftect to disable SOME/IP interface and nfs transmittion "CCU_SHUTDOWN" : This means that APState is NODE_SHUTDOWN
      field PolicyApplied: type=CPP/PolicyInfo, has-getter=true, has-notifier=true, has-setter=false  # Event used to notify Client Managers that current NSS policy was changed, and that they should request an updated client policy. - statusCode : status information for applying policy - errorMessage : error message for applying policy - policyVersion : This parameter indicates the policy version applied by NSS. - name : The policy name applied by NSS.
      methods:
        4 x operation:
          GetPolicyForClient  # Returns current client policy JSON string with current shares’ details to be mounted on the client (ECU) running Client Manager. - result : Returns current client policy JSON string with current shares’ details to be mounted on the client (ECU) running Client Manager. - checksum : Checksum of the policy JSON string
            arg clientIpAddress: type=String, direction=IN
            arg result: type=String, direction=OUT
            arg checksum: type=String, direction=OUT
          ReportPolicyApplicationStatus  # Method used to notify NSS about the Client Manager policy application status - policyApplicationStatus: "APPLIED" "NOT_CHANGED" "INVALID_JSON" "EMPTY" "SSH_TUNNEL_OPEN_FAILED" "MOUNT_FAILED"
            5 x arg:
              policyApplicationStatus: type=String, direction=IN
              clientIpAddress: type=String, direction=IN
              policyName: type=String, direction=IN
              policyVersion: type=uint32_t, direction=IN
              result: type=uint32_t, direction=OUT
          ReportStatistics  # Method used to periodically post clients statistics to the NSS.
            arg stats: type=String, direction=IN
            arg clientIpAddress: type=String, direction=IN
            arg result: type=uint32_t, direction=OUT
          SendClientShutdownStatus  # Method used to send the Client Manager disconnection status to the NSS. - clientShutdownStatus : "OK" "UNMOUNT_FAILED" "SSH_TUNNEL_CLOSE_FAILED"
            arg clientShutdownStatus: type=String, direction=IN
            arg clientIpAddress: type=String, direction=IN
            arg result: type=uint32_t, direction=OUT
    SimManager: major-version=1, minor-version=2
      namespaces:
        symbol props Vehicle
        symbol props MSM
        symbol props SimManager
      6 x field, all with has-getter=true, has-notifier=true, has-setter=false:
        EID: type=String
        IccID: type=String
        MCC: type=String
        MNC: type=String
        NetSerProv: type=NetworkServiceProvider
        PhoneNumber: type=String
    SimManager: major-version=2, minor-version=0
      namespaces:
        symbol props DCU
        symbol props Telephony
        symbol props SimManager
      10 x field, all with has-getter=true, has-notifier=true, has-setter=false:
        CardIdentifier: type=String  # Contains the Integrated Circuit Card Identifer (ICCID) which is read directly from the SIM. The CardIdentifier value is used for CCS service opening process. According to the HMC specification, If the actual SIM card's ICCID is 19 digits, the 'F' character is appended to the last character. If the ICCID is 20 digits, it is returned without additional characters.
        EID: type=String  # Contains the eUICC Indentifier (EID) EID is the eUICC identifier used in the context of Remote Provisioning and Management of the eUICC. Examplesof valid EIDs are: 8900 1012 0123 4123 4012 3456 7890 1224 8900 1567 0102 0304 0506 0708 0910 1152 8904 4011 1122 3344 1122 3344 1122 3321
        MCC: type=String  # Contains the Mobile Country Code (MCC) of the home network (HPLMN). When Remote SIM Provisioning has been performed, the MVNO information (MCC / MNC value) also changed.
        MNC: type=String  # Contains the Mobile Network Code (MNC) of the home network (HPLMN). When Remote SIM Provisioning has been performed, the MVNO information (MCC / MNC value) also changed.
        MSISDN: type=String  # Contains the MSISDN of the SIM.
        NetworkOTAStatus: type=NetworkOTAStatus  # Representing the network OTA status. CCS Provisiong can only be performed when in the Activated state.
        PhoneNumber: type=String  # Contains the subscriber's number of the SIM. The initial value of PhoneNumber is filled by many 0. If the Teleco OTA Status is changed to Activated, the PhoneNumber is changed to the actual phone number.
        ServiceProviderName: type=String  # Contains the service provider name fetched from the SIM card, if available.
        Status: type=bool  # SIM status.
        SubscriberIdentity: type=String  # Contains the IMSI of the SIM, if available.
      methods:
        operation OpeningDate  # Representing the device opening date of the modem device.
          arg open: type=OpeningDateInfo, direction=OUT
        operation RequestNetworkOTA  # Perform Network OTA Request to NAD. Temporarily allow the modem to be reattached to the carrier's network. When NetworkOTAStatus changes to Activated state, CCS provisioning can be performed.
    StateManager: major-version=1, minor-version=1
      namespaces:
        symbol props Vehicle
        symbol props SM
        symbol props StateManager
      field APState: type=SMState, has-getter=true, has-notifier=true, has-setter=false
      field NetRequest: type=CPP/NetworkRequest, has-getter=true, has-notifier=true, has-setter=false
      field SessionStateField: type=SessionStateField_VECTOR, has-getter=true, has-notifier=true, has-setter=false
      methods:
        8 x operation:
          PMStateInfo  # PM 상태 전달 api 0: Power Off 1: Power On Init 2: Normal Level 1 3: Pre-Normal Level 2 4: Normal Level 2 5 Prepare Shutdown 6: Network Shutdown 7: AP Shutdown 8: System Shutdown 9: Reset 10: Reset Pending 11: Update
            arg pmState: type=uint8_t, direction=IN
          RegisterShutdownNode
            arg nodeInfo: type=ShutdownNodeInfo, direction=IN
            arg result: type=CPP/Result, direction=OUT
          SetSessionState
            arg state: type=SessionState, direction=IN
            arg result: type=CPP/Result, direction=OUT
          ShutdownPendingRequest
            arg appName: type=String, direction=IN
          ShutdownRequestComplete
            arg appName: type=String, direction=IN
          SystemControlRequest
            arg request: type=CPP/SysCtrlReq, direction=IN
          TriggerSelfUpdateHeartbeat: fire-and-forget=true
          VpushReceived
            arg result: type=CPP/Result, direction=OUT
    Status: major-version=1, minor-version=0
      namespaces:
        symbol props Vehicle
        symbol props SharedStorage
        symbol props Status
      methods:
        12 x operation:
          GetAppliedPolicyStatus  # get the status of the currently applied NSS policy.
            arg policyStatus: type=CPP/PolicyStatus, direction=OUT
          GetClientSystemStatusByDiag
            arg did: type=uint16_t, direction=IN
            arg shareStatus: type=ShareStatus, direction=OUT
          GetDownloadedPolicyStatus  # get the status of the most recently downloaded NSS policy
            arg policyStatus: type=CPP/PolicyStatus, direction=OUT
          GetGeneralSystemStatusByDiag
            arg nfsRunning: type=bool, direction=OUT
            arg mainVolumeOperational: type=bool, direction=OUT
          GetInstalledPolicyStatus  # get the status of the installed NSS policy that will be applied on the next bootup.
            arg policyStatus: type=CPP/PolicyStatus, direction=OUT
          GetNfsClientStatus
            arg nfsClientStatuses: type=GetNfsClientStatus_nfsClientStatuses_VECTOR, direction=OUT  # Return NFS client status
          GetNfsTarget
            arg nfsServerStatus: type=NfsServerStatus, direction=OUT  # Return NFS server status
          GetNvmeStatus  # get NVMe information.
            arg nvmeStatus: type=NvmeStatus, direction=OUT
          GetSystemStatus  # get the status of the NFS server.
            arg nssSystemStatus: type=NssSystemStatus, direction=OUT
          ResetClientShareByDiag
            arg nssClientBitMap: type=uint32_t, direction=IN  # WDBI $12B0 대응 NSS Client Reset 진단기능 API
            arg result: type=bool, direction=OUT
          ResetClientShareStatusByDiag
            arg nssClientProgressByteMap: type=ByteArray, direction=OUT  # RDBI $0C90 대응 Read NSS Client Reset Progress 진단기능 API
          ResetToFactoryPolicy  # remove all shares and reset NSS to its factory settings. The factory policy will be applied on the next CCU reboot.
            arg reformat: type=bool, direction=IN
            arg applyOnNextBoot: type=bool, direction=IN
            arg policyStatus: type=CPP/PolicyStatus, direction=OUT
    Support: major-version=1, minor-version=1
      namespaces:
        symbol props Vehicle
        symbol props FoDMaster
        symbol props Support
      field FodVin: type=FodVinMsg, has-getter=true, has-notifier=true, has-setter=false  # FoDClient의 인증서 로컬 검증을 위한 VIN 제공
      methods:
        operation SetFodVin  # Routine Control 0x12A3. VIN을 FoDMaster로 주입하는 기능(공장 용도)
          arg inVin: type=String, direction=IN
          arg status: type=SetFodVinStatus, direction=OUT
          arg outVin: type=String, direction=OUT
    SysInfoManager: major-version=1, minor-version=4
      namespaces:
        symbol props Vehicle
        symbol props ApSysMgr
        symbol props SysInfoManager
      field DiagRoutingActiveInfo: type=uint8_t, has-getter=true, has-notifier=true, has-setter=true  # [NE1aW] SDS로 부터 수신한 SecOC 진단 라우팅 활성화 정보를 전달하는 api MCU -> IPCH(AP) -> ApSysMgr : Field Setter ApSysMgr -> DiagMgr : Field Notifier 1 Byte bitmask : Bit 0: On-Board active (SDS) Bit 1: Off-Board active (ERT) Bit 2: Diagnostics CAN (EDT)
      field SecureAccessActiveInfo: type=bool, has-getter=true, has-notifier=true, has-setter=true  # True : Active False : Inactive
      methods:
        7 x operation:
          ControlLogLevel  # WDBI DID $12b1과 매핑, App 별 log level control을 위한 api Log Level 값 0x00 : kOff, 0x01 : kFatal, 0x02 : kError, 0x03 : kWarn 0x04 : kInfo, 0x05 : kDebug, 0x06 : kVerbose, 0x07~0xFE : Reserved, 0xFF : 초기 상태 err mapping Busy : ASM 부하 상황 FAIL : Json 파일 open 실패 등 파일 Wrtie 실패 시
            arg appId: type=uint8_t, direction=IN
            arg logLevel: type=uint8_t, direction=IN
            arg err: type=CPP/Error, direction=OUT
          GetBootReasonMCU
            arg reason: type=ByteArray, direction=OUT
          GetNumValue
            arg key: type=NumValueKey, direction=IN
            arg resultUint: type=ResultUint, direction=OUT
          GetStringValue
            arg key: type=StringValueKey, direction=IN
            arg resultString: type=ResultString, direction=OUT
          SetNumValue
            arg numInfo: type=NumValueInfo, direction=IN
          SetStringValue
            arg stringInfo: type=StringValueInfo, direction=IN
          SetVIN
            arg vin: type=String, direction=IN
    TAD: major-version=1, minor-version=0
      namespaces:
        symbol props Vehicle
        symbol props ApSysMgr
        symbol props TAD
      methods:
        operation SetPwrStatus
          arg powerSate: type=T_PowerStateKey, direction=IN
          arg value: type=uint64_t, direction=IN
          arg result: type=bool, direction=OUT
        operation SetWireInput
          arg extWireInput: type=T_ExtWireInput, direction=IN
          arg value: type=bool, direction=IN
          arg result: type=bool, direction=OUT
    Time: major-version=1, minor-version=0
      namespaces:
        symbol props Info
        symbol props Location
        symbol props Time
      field LocationUTCTime: type=LocationTime, has-getter=true, has-notifier=true, has-setter=false  # [Periodic 1000ms] GNSS-based UTC time information is notified to subscribers in 1000ms periodic message.
      field TimeSource: type=CPP/TimeSource, has-getter=true, has-notifier=true, has-setter=false  # The TimeSource field is to determine the type of time source provided.
    Time: major-version=2, minor-version=2
      namespaces:
        symbol props DCU
        symbol props System
        symbol props Time
      field SystemTime: type=CPP/SystemTime, has-getter=true, has-notifier=true, has-setter=false  # Notify time information to subscribers with 30 sec periodic message. Remark. This SystemTime information is the System Time of DCU's Linux OS which is not guarantee that the network time calibrated. valid field indicates whether time information has been calibrated with Network Time Information (NITZ). Depending on the DCU hardware variation, System Time is calibarted by different options as follows: 1.CCS Only: System Time Calibrated with NITZ 2.CCS + eCall: System Time Calibrated with GPS (secondary source NITZ) 3.CCS + NEMS: System Time Calibrated with GPS (secondary source NITZ) Note : For compatibility support with older versions (v2.01 and below) of the interface, the utcoff value of this structure is always expressed in seconds. Please refer Field UtcOffset instead of utcoff in struct SystemTime.
      field UtcOffset: type=int16_t, has-getter=true, has-notifier=true, has-setter=false  # This Field indicates the UTC Offset of SystemTime in Minute. If you can refer to the Field UtcOffset field instead of Int16 utcoff in System Time, use this field to avoid overflow value. Note: There is an overflow issue when reporting UTC information in seconds. (Happened at v2.01 and below). For example, in some regions, such as Australia, the offset is UTC+10=36000 seconds, but the int16 (-32,768 to 32,767) data format can be -29536.
    Time: major-version=1, minor-version=1
      namespaces:
        symbol props Info
        symbol props System
        symbol props Time
      7 x field, all with has-getter=true, has-notifier=true, has-setter=false:
        ClockSource: type=String  # This field is used to get the clock source used by the head unit. The ClockSource has the following format and is a string with uppercase letters. - "INVALID" - "GPS" - "RTC" - "NTP" - "MANUAL"
        DaylightSavingTime: type=bool  # This field is used to know if DST(Daylight Saving Time) is enabled or not.
        DisplayedTime: type=CPP/SystemTime  # [Periodic 30s] Notify time information to subscribers with 30 sec periodic message. Provide the time information displayed on the UI according to the headunit specification.
        SystemTime: type=CPP/SystemTime  # [Periodic 30s] Notify time information to subscribers with 30 sec periodic message. Provide the time information displayed on the UI according to the headunit specification.
        TimeZoneID: type=TimeZoneID  # This field is used to get the time zone which is configured to headunit.
        UTCOffset: type=UTCOffset  # This field is used to get the UTC time Offset
        UserOffset: type=int32_t  # User Offset of SystemTime in Minute.
    TimeManager: major-version=1, minor-version=1
      namespaces:
        symbol props Vehicle
        symbol props ApSysMgr
        symbol props TimeManager
      field CurrentTimeMode: type=CPP/TimeMode, has-getter=true, has-notifier=true, has-setter=false  # provide the TimeMode to each app by field type.
      methods:
        8 x operation:
          GetCurrentEpochTime
            arg time: type=EpochTime, direction=OUT
          GetCurrentTime
            arg time: type=Time, direction=OUT
          GetMCUSysTick  # Time Tick Register 값 취득하여 전달하는 api Invalid시 0 전달
            arg mcuSysTick: type=uint64_t, direction=OUT
          GetRtcWakeupTimer  # get the Timer value for presetTimer and currentCountTimer.
            arg timer: type=CPP/Timer, direction=OUT
            arg appID: type=String, direction=OUT
            arg err: type=uint8_t, direction=OUT
          GetSourceTimeValidity  # 0x0 : Default 0x1 : RTC based System Time Applied (UTC Offset 0) 0x2 : HU CAN Clock (Local Time, UTC Offset Applied) 0x3 : Both of AP & HU Clock invalid
            arg sourceTimeValidity: type=uint8_t, direction=OUT
          GetSystemTickOffset
            arg offset: type=uint64_t, direction=OUT
          SetRtcWakeupTimer  # set the timer by second and enable rtc wakeup function.
            arg presetTimerSec: type=uint64_t, direction=IN
            arg appID: type=String, direction=IN
            arg err: type=uint8_t, direction=OUT
          StopRtcWakeupTimer  # stop rtc wakeup timer
            arg appID: type=String, direction=IN
            arg err: type=uint8_t, direction=OUT
    UdsReprogram: major-version=1, minor-version=0
      namespaces:
        symbol props Vehicle
        symbol props VSUA
        symbol props UdsReprogram
      field UpdateVehicleSystemDiagClient: type=UpdateVehicleSystemDiagClientType, has-getter=true, has-notifier=true, has-setter=false
      field UpdateVehicleSystemStatus: type=UpdateVehicleSystemStatusType, has-getter=true, has-notifier=true, has-setter=false
      methods:
        operation RequestUdsReprogramCCU
          arg msgInfo: type=DiagnosisMsgInfo, direction=IN
          arg error: type=VSUAErrorDomain, direction=OUT
        operation RequestUdsUpdateVehicleSystem
          arg msgInfo: type=DiagnosisMsgInfo, direction=IN
          arg respDiagMsg: type=ByteArray, direction=OUT
          arg error: type=VSUAErrorDomain, direction=OUT
    UpdateRequest: major-version=1, minor-version=0
      namespaces:
        symbol props ara
        symbol props sm
      methods:
        6 x operation:
          PrepareRollback: possible-ap-error=[Rejected, RollbackFailed]  # Has to be called by Update And Configuration Management after State Management allowed to update.
            arg FunctionGroupList: type=FunctionGroupList, direction=IN
          PrepareUpdate: possible-ap-error=[PrepareFailed, Rejected]  # Has to be called by Update And Configuration Management after State Management allowed to update. State Management will decline this request when StartUpdateSession was not called before successfully.
            arg FunctionGroupList: type=FunctionGroupList, direction=IN
          ResetMachine: possible-ap-error=Rejected  # Requests a reset of the machine. Before the reset is performed all information within the machine shall be persisted. Request will be rejected when StartUpdateSession was not called successfully before.
          StartUpdateSession: possible-ap-error=Rejected  # Has to be called by Update And Configuration Management once it has to start interaction with State Management. State Management might decline this request when machine is not in a state to be updated.
          StopUpdateSession: fire-and-forget=true  # Has to be called by Update And Configuration Management once the update is finished to let State Managemen know that update is done and Machine is in a stable state. Request will be rejected when StartUpdateSession was not called successfully before.
          VerifyUpdate: possible-ap-error=[Rejected, VerifyFailed]  # Has to be called by Update And Configuration Management after State Management allowed to update and the update preparation has been done. State Management will decline this request when Prepare Update was not called before successfully.
            arg FunctionGroupList: type=FunctionGroupList, direction=IN
    UpdateStandard: major-version=1, minor-version=2
      namespaces:
        symbol props Update
        symbol props USS
        symbol props UpdateStandard
      4 x field, all with has-getter=true, has-notifier=true, has-setter=false:
        CureentSDSAuthenticationLevel: type=CPP/CertRole  # [NE1aW] SDS 인증 대응용 API / Inform when SDS Authentication is changed userRole bitmask: Bit 0: Default/Anybody Bit 1: OEM servicing Bit 2: enhanced Bit 3: operations Bit 4: basic Bit 5: All functional Bit 6: Rollback Bit 7: reserved diagRoutingRole bitmask: Bit 0: Onboard DoIP (SDS) Bit 1: Offboard DoIP (ERT) Bit 2: Diagnostics CAN (EDT) Bit 3: Disable Flooding protection Bit 4: Airbag deployment (CCU 미사용) Bit 5~7: reserved
        CurrentAuthenticationLevel: type=CPP/AuthLevelType
        CurrentDiagSession: type=CPP/DiagSessionType
        CurrentSecurityLevel: type=CPP/SecurityLevelType
      methods:
        7 x operation:
          CommunicationControl
            4 x arg:
              ctrlType: type=ControlType, direction=IN
              comType: type=CommunicationType, direction=IN
              timeout: type=uint16_t, direction=IN  # unit : 100ms, ex) 0x50 : 8s
              result: type=CPP/DiagResponseType, direction=OUT
          ControlDTCSetting
            arg onOff: type=bool, direction=IN
            arg timeout: type=uint16_t, direction=IN
            arg result: type=CPP/DiagResponseType, direction=OUT  # unit : 100ms, ex) 0x50 : 8s
          GetId
            arg id: type=String, direction=OUT
          RoutineControl
            4 x arg:
              rtCtrlType: type=RoutineControlType, direction=IN
              rtCtrlId: type=uint16_t, direction=IN
              timeout: type=uint16_t, direction=IN  # unit : 100ms, ex) 0x50 : 8s
              result: type=CPP/DiagResponseType, direction=OUT
          SecurityAccess
            6 x arg:
              inSubFunction: type=SecurityAccessType, direction=IN
              sendKey: type=SecurityAccessDataType, direction=IN
              timeout: type=uint16_t, direction=IN  # unit : 100ms, ex) 0x50 : 8s
              outSubFunction: type=SecurityAccessType, direction=OUT
              seedKey: type=SecurityAccessDataType, direction=OUT
              result: type=CPP/DiagResponseType, direction=OUT
          SessionControl
            arg session: type=CPP/DiagSessionType, direction=IN
            arg timeout: type=uint16_t, direction=IN  # unit : 100ms, ex) 0x50 : 8s
            arg result: type=CPP/DiagResponseType, direction=OUT
          SetId
            arg id: type=String, direction=IN
    Variant: major-version=1, minor-version=7
      namespaces:
        symbol props Info
        symbol props System
        symbol props Variant
      field Variants: type=CPP/KeyValue, has-getter=true, has-notifier=true, has-setter=false  # Provides a list of variant infomations to an external system. The Key-Value table follows the specification for each item. Provides the list of variant infomations below to an external system. - CAR_CODE : "GN7" - GENERAL_REGION : "KOR" - SYSTEM_MAIN_SW_VER : Follows the version notation specification. - PLATFORM_TYPE : {"PG6", "CCIC", "CCNC"} - CAR_BRAND : {"HYUNDAI", "KIA", "GENESIS"} - NAVIGATION : {"TRUE", "FALSE"} - DRIVE_TYPE: {"LEFT", "RIGHT"} - VEHICLE_PACKAGE: {"SPORTS", "SPORTY", "STANDARD"} - RRC: {"TRUE", "FALSE"} - FUEL_TYPE: {"GASOLINE", "DIESEL", "LPI"} - EV_TYPE: {"ICE", "HEV", "PHEV", "EV", "FCEV"} - ECALL: {"TRUE", "FALSE"} - RVM_SVM: {"NONE", "RVM", "SVM"} - BODY_TYPE: {"SEDAN", "SUV", "MPV", "WAGON", "HACHBACK", "OPENBED", "TRUCK", "BUS", “LIMOUSINE”} - CCS: {"TRUE", "FALSE"} - N_MODE: {"TRUE", "FALSE"} - BT_NAME: Set the vehicle name according to the Bluetooth connection display name specification of the front seat - AMP_TYPE: {"INTERNAL_AMP", "EXTERNAL_AMP"} - BLACK_LINE: {"TRUE", "FALSE"} - CCRC_TYPE: { "CCRC1", "CCRC2"} - CCS_TYPE: { "CCS1", "CCS2"}
    Variation: major-version=3, minor-version=0
      namespaces:
        symbol props DCU
        symbol props System
        symbol props Variation
      methods:
        operation GetVariation  # Service interface to get a variation of DCU will be provided by DCU, and CCU can be aware of the variation by consuming it. If the regions for which no function is provided in DCU, such as ECALL or NEMS, return empty array results.
          arg error_of_CommonAPI: type=CPP/VarError, direction=OUT
          arg var: type=CPP/VariationInfo, direction=OUT
    VehicleAPI: major-version=2, minor-version=1
      namespaces:
        symbol props Vehicle
        symbol props VAS
        symbol props VehicleAPI
      events:
        data Subscription_1: type=Subscription_1_EventData  # The event occurs for paths that have been subscribed to through the Subscribe_1 method. The number that follows is assigned per consumer unit. subscriptionId should be greater than 0. Array's or Struct's value will be passed in Json format.
      methods:
        5 x operation:
          CheckAvailability  # Only one path can be requested.
            arg path: type=String, direction=IN
            arg statusCode: type=int16_t, direction=OUT
            arg availability: type=Availability, direction=OUT
          Read  # Only one path can be requested. Array and Struct type is not supported. Filter is not supported.
            arg path: type=String, direction=IN
            arg statusCode: type=int16_t, direction=OUT
            arg value: type=String, direction=OUT
          Subscribe_1  # Paths filter is supported for mass subscription. Only available signals will be processed. subscriptionId should be greater than 0.
            4 x arg:
              path: type=String, direction=IN
              pathsFilter: type=Subscribe_1_pathsFilter_VECTOR, direction=IN
              statusCode: type=int16_t, direction=OUT
              subscriptionId: type=int64_t, direction=OUT
          Unsubscribe_1  # This method can only handle unsubscribe requests for subscriptions made through the Subscribe_1 method.
            arg subscriptionId: type=int64_t, direction=IN
            arg statusCode: type=int16_t, direction=OUT
          Update  # Only one path can be requested. Array and Struct type is not supported.
            arg path: type=String, direction=IN
            arg value: type=String, direction=IN
            arg statusCode: type=int16_t, direction=OUT
    VoiceCallManager: major-version=2, minor-version=0
      namespaces:
        symbol props DCU
        symbol props Telephony
        symbol props VoiceCallManager
      events:
        data RecvTones: type=RecvTones_EventData  # Receive the DTMF tones from the network. - tonePress: Press = 1, Release = 0
      field CallSession: type=VoiceCallSession, has-getter=true, has-notifier=true, has-setter=false  # Gets the properties of the ongoing or last voice call object. DisconnectReason field is only filled when VoiceCallStatus::Disconnected
      methods:
        4 x operation:
          Answer  # Answers the incoming call. Only valid if the state of the call is "incoming."
            arg cid: type=String, direction=IN
            arg error_of_CommonAPI: type=CallError, direction=OUT
          Dial  # Initiates a new outgoing call.
            arg number: type=String, direction=IN
            arg error_of_CommonAPI: type=CallError, direction=OUT
            arg cid: type=String, direction=OUT
          HangupAll  # Releases all calls except waiting calls. This includes multiparty calls
            arg error_of_CommonAPI: type=CallError, direction=OUT
          SendTones  # Sends the DTMF tones to the network. - tonePress: Press = 1, Release = 0
            arg tones: type=String, direction=IN
            arg tonePress: type=bool, direction=IN
            arg error_of_CommonAPI: type=DTMFError, direction=OUT
package /PortInterface/Service/ErrorDomain
  10 x ap application error:
    ActivatingUpdateFailed: error-code=108, error-domain=HmcSpecificUCMErrorDomain  # ActivatingUpdate method call is returned as failure.
    ActivationFailed: error-code=50, error-domain=UCMErrorDomain  # Activation 중 Error 발생
    AlreadyInstalledVersion: error-code=1, error-domain=HmcSpecificUCMErrorDomain  # The version of the requested Software Package has been already installed.
    AuthenticationFailed: error-code=8, error-domain=UCMErrorDomain  # Package authentication failed.
    BlockInconsistent: error-code=25, error-domain=UCMErrorDomain  # Consistency check for transferred block failed.
    CancelFailed: error-code=16, error-domain=UCMErrorDomain  # Cancel failed.
    ConditionNotCorrect: error-code=121, error-domain=HmcSpecificUCMErrorDomain
    Delay: error-code=3, error-domain=SMErrorDomain  # FunctionGroup State change request was delayed due to ownership.
    DiagPriviligeFailed: error-code=40, error-domain=HmcSpecificUCMErrorDomain
    Failed: error-code=2, error-domain=SMErrorDomain  # FunctionGroup State change request failed due to other reason.
  ap application error domain HmcSpecificUCMErrorDomain: value=2
    namespaces:
      symbol props hmc
      symbol props ucm
      symbol props pkgmgr
  31 x ap application error:
    IncompatibleDelta: error-code=29, error-domain=UCMErrorDomain  # Delta package dependency check failed.
    IncompatiblePackageVersion: error-code=24, error-domain=UCMErrorDomain  # The version of the Software or Main Configuration to be processed is not compatible with the current version of UCM or Update Master.
    IncorrectBlock: error-code=2, error-domain=UCMErrorDomain  # The same block number is received twice.
    IncorrectBlockSize: error-code=30, error-domain=UCMErrorDomain  # The size of the block exceeds the provided block size from Transfer Start or TransferVehiclePackage.
    IncorrectSize: error-code=3, error-domain=UCMErrorDomain  # The size of the Software or Main Configuration exceeds the provided size in TransferStart.
    InitializeFailed: error-code=10, error-domain=HmcSpecificUCMErrorDomain  # Error during initializing UCM
    InsufficientComputationPower: error-code=28, error-domain=UCMErrorDomain  # Insufficient computation power to perform the requested operation.
    InsufficientData: error-code=6, error-domain=UCMErrorDomain  # TransferExit has been called but total transferred data size does not match expected data size provided with TransferStart call.
    InsufficientMemory: error-code=1, error-domain=UCMErrorDomain  # Insufficient memory to perform operation.
    Invalid: error-code=1, error-domain=SMErrorDomain  # FunctionGroup State change request was invalid e g unknown state.
    InvalidFilePath: error-code=35, error-domain=HmcSpecificUCMErrorDomain  # Filepath is invalid or not accessible path.
    InvalidPackageManifest: error-code=13, error-domain=UCMErrorDomain  # Package manifest could not be read.
    InvalidTransferId: error-code=4, error-domain=UCMErrorDomain  # The Transfer ID is invalid.
    InvalidUpdateClientType: error-code=124, error-domain=HmcSpecificUCMErrorDomain
    LowerVersionDownloadAttempt: error-code=122, error-domain=HmcSpecificUCMErrorDomain
    MissingDependencies: error-code=21, error-domain=UCMErrorDomain  # Activate cannot be performed because of missing dependencies.
    NotAbleToRevertPackages: error-code=15, error-domain=UCMErrorDomain  # RevertProcessedSwPackages failed.
    NotAbleToRollback: error-code=18, error-domain=UCMErrorDomain  # Rollback failed.
    OldVersion: error-code=9, error-domain=UCMErrorDomain  # Software Package version is too old.
    OperationNotPermitted: error-code=5, error-domain=UCMErrorDomain  # The operation is not supported in the current context.
    PackageInconsistent: error-code=7, error-domain=UCMErrorDomain  # Package integrity check failed.
    PreActivationFailed: error-code=19, error-domain=UCMErrorDomain  # Error during preActivation step.
    PrepareFailed: error-code=7, error-domain=SMErrorDomain  # Preparation step of update failed.
    ProcessSwPackageCancelled: error-code=22, error-domain=UCMErrorDomain  # The processing operation has been interrupted by a Cancel() call.
    ProcessedSoftwarePackageInconsistent: error-code=23, error-domain=UCMErrorDomain  # The processed Software Package integrity check has failed.
    Rejected: error-code=5, error-domain=SMErrorDomain  # Requested operation was rejected due to State Managements machines internal state.
    RemoveSwPackageFailed: error-code=125, error-domain=HmcSpecificUCMErrorDomain  # An error occurs when remove app software package
    RequestRDBIFailed: error-code=126, error-domain=HmcSpecificUCMErrorDomain  # An error occurs when requestRDBI method called
    RevertUpdateFailed: error-code=107, error-domain=HmcSpecificUCMErrorDomain  # RevertUpdate method call is returned as failure.
    RollbackFailed: error-code=8, error-domain=SMErrorDomain  # Rollback step of update failed.
    RollingbackUpdateFailed: error-code=109, error-domain=HmcSpecificUCMErrorDomain  # RollingbackUpdate method call is returned as failure.
  ap application error domain SMErrorDomain: value=1
    namespaces:
      symbol props ara
      symbol props sm
  9 x ap application error:
    SecurityAccessDenied: error-code=123, error-domain=HmcSpecificUCMErrorDomain
    SecurityError: error-code=101, error-domain=HmcSpecificUCMErrorDomain  # After receiving Software Package integrity check of it is failed
    ServiceBusy: error-code=12, error-domain=UCMErrorDomain  # Another processing is already ongoing and therefore the current processing request has to be rejected.
    SourceVerificationFailed: error-code=102, error-domain=HmcSpecificUCMErrorDomain  # Before the update verification for the modification check of the source is failed.
    StartSelfUpdateFailed: error-code=105, error-domain=HmcSpecificUCMErrorDomain  # StartSelfUpdate method call is returned as failure.
    Success: error-code=0, error-domain=SMErrorDomain  # FunctionGroup State change request was executed successfully
    SyncAbFailed: error-code=111, error-domain=HmcSpecificUCMErrorDomain  # It is failed to synchronize the A/B partitions.
    TargetVerificationFailed: error-code=104, error-domain=HmcSpecificUCMErrorDomain  # After updating target verification failed.
    TransferInterrupted: error-code=26, error-domain=UCMErrorDomain  # Transfer has been interrupted.
  ap application error domain UCMErrorDomain: value=9223372036854775850
    namespaces:
      symbol props ara
      symbol props ucm
      symbol props pkgmgr
  5 x ap application error:
    UnexpectedPackage: error-code=32, error-domain=UCMErrorDomain  # The Software Package name does not correspond to the RequestedPackage field value.
    UpdateError: error-code=103, error-domain=HmcSpecificUCMErrorDomain  # While updating it is failed due to I/O errors and so on.
    UpdateSessionRejected: error-code=33, error-domain=UCMErrorDomain  # Start of an update session was rejected by State Management
    VerificationFailed: error-code=27, error-domain=UCMErrorDomain  # Error during verification step.
    VerifyFailed: error-code=6, error-domain=SMErrorDomain  # Verification step of update failed.
package /Platform
  machine CCU: machine-design=CCU_MachineDesign
package /System
  system System
    root-software-compositions:
      root sw composition prototype System: software-composition=System
package /System/Service/Deployment
  114 x someip service interface deployment:
    APNManager_Someip: service-interface=APNManager, service-interface-id=3086, service-interface-version={major-version=1, minor-version=0}
      someip event deployment APNConnectionStatus_Event: event=APNConnectionStatus, event-id=4097, maximum-segment-length=0, transport-protocol=UDP
      someip event deployment APNInfo_Event: event=APNInfo, event-id=4098, maximum-segment-length=0, transport-protocol=UDP
      someip method deployment GetAPNInformation_Method: method=GetAPNInformation, maximum-segment-length-request=0, maximum-segment-length-response=0, method-id=4097, transport-protocol=UDP
      someip method deployment GetAPNStatus_Method: method=APNManager/GetAPNStatus, maximum-segment-length-request=0, maximum-segment-length-response=0, method-id=4098, transport-protocol=UDP
      someip method deployment SetActivateAPN_Method: method=SetActivateAPN, maximum-segment-length-request=0, maximum-segment-length-response=0, method-id=4099, transport-protocol=UDP
      someip event group NewEventGroup: event-group-id=1, event=APNConnectionStatus_Event
      someip event group NewEventGroup1: event-group-id=2, event=APNInfo_Event
    ASKMaster_Someip: service-interface=ASKMaster, service-interface-id=3127, service-interface-version={major-version=1, minor-version=0}
      someip method deployment ASKMasterVersion_Method: method=ASKMasterVersion, maximum-segment-length-response=0, method-id=4098, transport-protocol=UDP
      someip method deployment GenerateKey_Method: method=GenerateKey, maximum-segment-length-request=0, maximum-segment-length-response=0, method-id=4097, transport-protocol=UDP
    ActivationManager_Someip: service-interface=ActivationManager, service-interface-id=4057, service-interface-version={major-version=1, minor-version=0}
      someip method deployment RequestRoutineControl_Method: method=ActivationManager/RequestRoutineControl, maximum-segment-length-request=0, maximum-segment-length-response=0, method-id=4097, transport-protocol=UDP
    Body1_Someip: service-interface=Body1, service-interface-id=3093, service-interface-version={major-version=1, minor-version=4}
      216 x someip field deployment:
        ACPrioState_Field: field=ACPrioState
          get getter: maximum-segment-length-request=0, maximum-segment-length-response=0, method-id=8392, transport-protocol=UDP
          notifier notifier: event-id=8392, maximum-segment-length=0, transport-protocol=UDP
        AlarmStatus_Field: field=AlarmStatus
          get getter: maximum-segment-length-request=0, maximum-segment-length-response=0, method-id=8193, transport-protocol=UDP
          notifier notifier: event-id=8193, maximum-segment-length=0, transport-protocol=UDP
        AsstDoorSwitchState_Field: field=AsstDoorSwitchState
          get getter: maximum-segment-length-request=0, maximum-segment-length-response=0, method-id=8194, transport-protocol=UDP
          notifier notifier: event-id=8194, maximum-segment-length=0, transport-protocol=UDP
        AsstDoorSwitchState_SBCM_Field: field=AsstDoorSwitchState_SBCM
          get getter: maximum-segment-length-request=0, maximum-segment-length-response=0, method-id=8278, transport-protocol=UDP
          notifier notifier: event-id=8278, maximum-segment-length=0, transport-protocol=UDP
        AsstDoorUnLockState_Field: field=AsstDoorUnLockState
          get getter: maximum-segment-length-request=0, maximum-segment-length-response=0, method-id=8195, transport-protocol=UDP
          notifier notifier: event-id=8195, maximum-segment-length=0, transport-protocol=UDP
        AsstDoorUnLockState_SBCM_Field: field=AsstDoorUnLockState_SBCM
          get getter: maximum-segment-length-request=0, maximum-segment-length-response=0, method-id=8279, transport-protocol=UDP
          notifier notifier: event-id=8279, maximum-segment-length=0, transport-protocol=UDP
        AsstWindowOpenState_Detail_Field: field=AsstWindowOpenState_Detail
          get getter: maximum-segment-length-request=0, maximum-segment-length-response=0, method-id=8197, transport-protocol=UDP
          notifier notifier: event-id=8197, maximum-segment-length=0, transport-protocol=UDP
        AsstWindowOpenState_Field: field=AsstWindowOpenState
          get getter: maximum-segment-length-request=0, maximum-segment-length-response=0, method-id=8196, transport-protocol=UDP
          notifier notifier: event-id=8196, maximum-segment-length=0, transport-protocol=UDP
        AsstWindowState_Field: field=AsstWindowState
          get getter: maximum-segment-length-request=0, maximum-segment-length-response=0, method-id=8198, transport-protocol=UDP
          notifier notifier: event-id=8198, maximum-segment-length=0, transport-protocol=UDP
        AstDrReleaseInsideSwEnable_Field: field=AstDrReleaseInsideSwEnable
          get getter: maximum-segment-length-request=0, maximum-segment-length-response=0, method-id=8357, transport-protocol=UDP
          notifier notifier: event-id=8357, maximum-segment-length=0, transport-protocol=UDP
        AstSeatHeatVentIndCmd_Field: field=AstSeatHeatVentIndCmd
          get getter: maximum-segment-length-request=0, maximum-segment-length-response=0, method-id=8306, transport-protocol=UDP
          notifier notifier: event-id=8306, maximum-segment-length=0, transport-protocol=UDP
        AstSeatIntgFeedback_Field: field=AstSeatIntgFeedback
          get getter: maximum-segment-length-request=0, maximum-segment-length-response=0, method-id=8354, transport-protocol=UDP
          notifier notifier: event-id=8354, maximum-segment-length=0, transport-protocol=UDP
        AutoExteriorLightState_Field: field=AutoExteriorLightState
          get getter: maximum-segment-length-request=0, maximum-segment-length-response=0, method-id=8199, transport-protocol=UDP
          notifier notifier: event-id=8199, maximum-segment-length=0, transport-protocol=UDP
        AvgCurrAtReset_Field: field=AvgCurrAtReset
          get getter: maximum-segment-length-request=0, maximum-segment-length-response=0, method-id=8373, transport-protocol=UDP
          notifier notifier: event-id=8373, maximum-segment-length=0, transport-protocol=UDP
        BPCM_Ast_IndCmd_Field: field=BPCM_Ast_IndCmd
          get getter: maximum-segment-length-request=0, maximum-segment-length-response=0, method-id=8399, transport-protocol=UDP
          notifier notifier: event-id=8399, maximum-segment-length=0, transport-protocol=UDP
        BPCM_Drv_IndCmd_Field: field=BPCM_Drv_IndCmd
          get getter: maximum-segment-length-request=0, maximum-segment-length-response=0, method-id=8400, transport-protocol=UDP
          notifier notifier: event-id=8400, maximum-segment-length=0, transport-protocol=UDP
        BPCM_FrontOptTypInfo_Field: field=BPCM_FrontOptTypInfo
          get getter: maximum-segment-length-request=0, maximum-segment-length-response=0, method-id=8402, transport-protocol=UDP
          notifier notifier: event-id=8402, maximum-segment-length=0, transport-protocol=UDP
        BPCM_HeatGlsOptTypInfo_Field: field=BPCM_HeatGlsOptTypInfo
          get getter: maximum-segment-length-request=0, maximum-segment-length-response=0, method-id=8407, transport-protocol=UDP
          notifier notifier: event-id=8407, maximum-segment-length=0, transport-protocol=UDP
        BPCM_HeatGls_IndCmd_Field: field=BPCM_HeatGls_IndCmd
          get getter: maximum-segment-length-request=0, maximum-segment-length-response=0, method-id=8406, transport-protocol=UDP
          notifier notifier: event-id=8406, maximum-segment-length=0, transport-protocol=UDP
        BPCM_RL_IndCmd_Field: field=BPCM_RL_IndCmd
          get getter: maximum-segment-length-request=0, maximum-segment-length-response=0, method-id=8401, transport-protocol=UDP
          notifier notifier: event-id=8401, maximum-segment-length=0, transport-protocol=UDP
        BPCM_RR_IndCmd_Field: field=BPCM_RR_IndCmd
          get getter: maximum-segment-length-request=0, maximum-segment-length-response=0, method-id=8403, transport-protocol=UDP
          notifier notifier: event-id=8403, maximum-segment-length=0, transport-protocol=UDP
        BPCM_RearOptTypInfo_Field: field=BPCM_RearOptTypInfo
          get getter: maximum-segment-length-request=0, maximum-segment-length-response=0, method-id=8404, transport-protocol=UDP
          notifier notifier: event-id=8404, maximum-segment-length=0, transport-protocol=UDP
        BatteryDischargeWarningState_Field: field=BatteryDischargeWarningState
          get getter: maximum-segment-length-request=0, maximum-segment-length-response=0, method-id=8200, transport-protocol=UDP
          notifier notifier: event-id=8200, maximum-segment-length=0, transport-protocol=UDP
        BatteryEmergencyState_Field: field=Body1/BatteryEmergencyState
          get getter: maximum-segment-length-request=0, maximum-segment-length-response=0, method-id=8201, transport-protocol=UDP
          notifier notifier: event-id=8201, maximum-segment-length=0, transport-protocol=UDP
        BatteryPowerState_Field: field=BatteryPowerState
          get getter: maximum-segment-length-request=0, maximum-segment-length-response=0, method-id=8280, transport-protocol=UDP
          notifier notifier: event-id=8280, maximum-segment-length=0, transport-protocol=UDP
        BatterySOCValue_Field: field=BatterySOCValue
          get getter: maximum-segment-length-request=0, maximum-segment-length-response=0, method-id=8202, transport-protocol=UDP
          notifier notifier: event-id=8202, maximum-segment-length=0, transport-protocol=UDP
        BatteryStateOfChargeState_Field: field=BatteryStateOfChargeState
          get getter: maximum-segment-length-request=0, maximum-segment-length-response=0, method-id=8203, transport-protocol=UDP
          notifier notifier: event-id=8203, maximum-segment-length=0, transport-protocol=UDP
        BatteryStateOfChargeWarningValue_Field: field=BatteryStateOfChargeWarningValue
          get getter: maximum-segment-length-request=0, maximum-segment-length-response=0, method-id=8204, transport-protocol=UDP
          notifier notifier: event-id=8204, maximum-segment-length=0, transport-protocol=UDP
        BatteryTemperature_Field: field=BatteryTemperature
          get getter: maximum-segment-length-request=0, maximum-segment-length-response=0, method-id=8205, transport-protocol=UDP
          notifier notifier: event-id=8205, maximum-segment-length=0, transport-protocol=UDP
        BatteryVoltage_Field: field=BatteryVoltage
          get getter: maximum-segment-length-request=0, maximum-segment-length-response=0, method-id=8206, transport-protocol=UDP
          notifier notifier: event-id=8206, maximum-segment-length=0, transport-protocol=UDP
        BatteryWarningState_Field: field=BatteryWarningState
          get getter: maximum-segment-length-request=0, maximum-segment-length-response=0, method-id=8207, transport-protocol=UDP
          notifier notifier: event-id=8207, maximum-segment-length=0, transport-protocol=UDP
        BckGls_RrGlsHtdOpt_Field: field=BckGls_RrGlsHtdOpt
          get getter: maximum-segment-length-request=0, maximum-segment-length-response=0, method-id=8405, transport-protocol=UDP
          notifier notifier: event-id=8405, maximum-segment-length=0, transport-protocol=UDP
        BrakeFluidSwitchState_Field: field=BrakeFluidSwitchState
          get getter: maximum-segment-length-request=0, maximum-segment-length-response=0, method-id=8208, transport-protocol=UDP
          notifier notifier: event-id=8208, maximum-segment-length=0, transport-protocol=UDP
        CDMOpenState_Field: field=CDMOpenState
          get getter: maximum-segment-length-request=0, maximum-segment-length-response=0, method-id=8209, transport-protocol=UDP
          notifier notifier: event-id=8209, maximum-segment-length=0, transport-protocol=UDP
        CDMOptionType_Field: field=CDMOptionType
          get getter: maximum-segment-length-request=0, maximum-segment-length-response=0, method-id=8210, transport-protocol=UDP
          notifier notifier: event-id=8210, maximum-segment-length=0, transport-protocol=UDP
        CDMOptionType_SBCM_Field: field=CDMOptionType_SBCM
          get getter: maximum-segment-length-request=0, maximum-segment-length-response=0, method-id=8282, transport-protocol=UDP
          notifier notifier: event-id=8282, maximum-segment-length=0, transport-protocol=UDP
        CDMWarningInfo_Field: field=CDMWarningInfo
          get getter: maximum-segment-length-request=0, maximum-segment-length-response=0, method-id=8211, transport-protocol=UDP
          notifier notifier: event-id=8211, maximum-segment-length=0, transport-protocol=UDP
        CDMWarningInfo_SBCM_Field: field=CDMWarningInfo_SBCM
          get getter: maximum-segment-length-request=0, maximum-segment-length-response=0, method-id=8283, transport-protocol=UDP
          notifier notifier: event-id=8283, maximum-segment-length=0, transport-protocol=UDP
        CMDState_Field: field=CMDState
          get getter: maximum-segment-length-request=0, maximum-segment-length-response=0, method-id=8284, transport-protocol=UDP
          notifier notifier: event-id=8284, maximum-segment-length=0, transport-protocol=UDP
        CMSOptionInfo_Field: field=CMSOptionInfo
          get getter: maximum-segment-length-request=0, maximum-segment-length-response=0, method-id=8285, transport-protocol=UDP
          notifier notifier: event-id=8285, maximum-segment-length=0, transport-protocol=UDP
        CargoFreezerConnectionStatus_Field: field=CargoFreezerConnectionStatus
          get getter: maximum-segment-length-request=0, maximum-segment-length-response=0, method-id=8352, transport-protocol=UDP
          notifier notifier: event-id=8352, maximum-segment-length=0, transport-protocol=UDP
        CargoFreezerCurrentTemp_Field: field=CargoFreezerCurrentTemp
          get getter: maximum-segment-length-request=0, maximum-segment-length-response=0, method-id=8307, transport-protocol=UDP
          notifier notifier: event-id=8307, maximum-segment-length=0, transport-protocol=UDP
        CargoFreezerSetTemp_Field: field=CargoFreezerSetTemp
          get getter: maximum-segment-length-request=0, maximum-segment-length-response=0, method-id=8308, transport-protocol=UDP
          notifier notifier: event-id=8308, maximum-segment-length=0, transport-protocol=UDP
        CargoFreezerState_Field: field=CargoFreezerState
          get getter: maximum-segment-length-request=0, maximum-segment-length-response=0, method-id=8309, transport-protocol=UDP
          notifier notifier: event-id=8309, maximum-segment-length=0, transport-protocol=UDP
        CoachTypeOption_DRV_Field: field=CoachTypeOption_DRV
          get getter: maximum-segment-length-request=0, maximum-segment-length-response=0, method-id=8335, transport-protocol=UDP
          notifier notifier: event-id=8335, maximum-segment-length=0, transport-protocol=UDP
        CtrDrLkUnLkSwEnable_Field: field=CtrDrLkUnLkSwEnable
          get getter: maximum-segment-length-request=0, maximum-segment-length-response=0, method-id=8364, transport-protocol=UDP
          notifier notifier: event-id=8364, maximum-segment-length=0, transport-protocol=UDP
        CtrlDrLockRlyCCS_BDC_Field: field=CtrlDrLockRlyCCS_BDC
          get getter: maximum-segment-length-request=0, maximum-segment-length-response=0, method-id=8394, transport-protocol=UDP
          notifier notifier: event-id=8394, maximum-segment-length=0, transport-protocol=UDP
        CumulativeCountOf12VReq_Field: field=CumulativeCountOf12VReq
          get getter: maximum-segment-length-request=0, maximum-segment-length-response=0, method-id=8375, transport-protocol=UDP
          notifier notifier: event-id=8375, maximum-segment-length=0, transport-protocol=UDP
        CumulativeCountOfCCUReq_Field: field=CumulativeCountOfCCUReq
          get getter: maximum-segment-length-request=0, maximum-segment-length-response=0, method-id=8376, transport-protocol=UDP
          notifier notifier: event-id=8376, maximum-segment-length=0, transport-protocol=UDP
        CurrAtReset_Field: field=CurrAtReset
          get getter: maximum-segment-length-request=0, maximum-segment-length-response=0, method-id=8372, transport-protocol=UDP
          notifier notifier: event-id=8372, maximum-segment-length=0, transport-protocol=UDP
        CurrentValueForReset_Field: field=CurrentValueForReset
          get getter: maximum-segment-length-request=0, maximum-segment-length-response=0, method-id=8369, transport-protocol=UDP
          notifier notifier: event-id=8369, maximum-segment-length=0, transport-protocol=UDP
        DeliveryModeState_Field: field=DeliveryModeState
          get getter: maximum-segment-length-request=0, maximum-segment-length-response=0, method-id=8286, transport-protocol=UDP
          notifier notifier: event-id=8286, maximum-segment-length=0, transport-protocol=UDP
        DigitalKeyOptionInfo_Field: field=DigitalKeyOptionInfo
          get getter: maximum-segment-length-request=0, maximum-segment-length-response=0, method-id=8287, transport-protocol=UDP
          notifier notifier: event-id=8287, maximum-segment-length=0, transport-protocol=UDP
        DirectTypeTPMSOptStatus_Field: field=DirectTypeTPMSOptStatus
          get getter: maximum-segment-length-request=0, maximum-segment-length-response=0, method-id=8336, transport-protocol=UDP
          notifier notifier: event-id=8336, maximum-segment-length=0, transport-protocol=UDP
        DoorLockPsvDrLkReq_Field: field=DoorLockPsvDrLkReq
          get getter: maximum-segment-length-request=0, maximum-segment-length-response=0, method-id=8390, transport-protocol=UDP
          notifier notifier: event-id=8390, maximum-segment-length=0, transport-protocol=UDP
        DriveTypeOptionInfo_Field: field=DriveTypeOptionInfo
          get getter: maximum-segment-length-request=0, maximum-segment-length-response=0, method-id=8288, transport-protocol=UDP
          notifier notifier: event-id=8288, maximum-segment-length=0, transport-protocol=UDP
        DrvDoorSwitchState_Field: field=DrvDoorSwitchState
          get getter: maximum-segment-length-request=0, maximum-segment-length-response=0, method-id=8212, transport-protocol=UDP
          notifier notifier: event-id=8212, maximum-segment-length=0, transport-protocol=UDP
        DrvDoorSwitchState_SBCM_Field: field=DrvDoorSwitchState_SBCM
          get getter: maximum-segment-length-request=0, maximum-segment-length-response=0, method-id=8289, transport-protocol=UDP
          notifier notifier: event-id=8289, maximum-segment-length=0, transport-protocol=UDP
        DrvDoorUnLockState_Field: field=DrvDoorUnLockState
          get getter: maximum-segment-length-request=0, maximum-segment-length-response=0, method-id=8213, transport-protocol=UDP
          notifier notifier: event-id=8213, maximum-segment-length=0, transport-protocol=UDP
        DrvDoorUnLockState_SBCM_Field: field=DrvDoorUnLockState_SBCM
          get getter: maximum-segment-length-request=0, maximum-segment-length-response=0, method-id=8290, transport-protocol=UDP
          notifier notifier: event-id=8290, maximum-segment-length=0, transport-protocol=UDP
        DrvDrReleaseInsideSwEnable_Field: field=DrvDrReleaseInsideSwEnable
          get getter: maximum-segment-length-request=0, maximum-segment-length-response=0, method-id=8356, transport-protocol=UDP
          notifier notifier: event-id=8356, maximum-segment-length=0, transport-protocol=UDP
        DrvSeatHeatVentIndCmd_Field: field=DrvSeatHeatVentIndCmd
          get getter: maximum-segment-length-request=0, maximum-segment-length-response=0, method-id=8310, transport-protocol=UDP
          notifier notifier: event-id=8310, maximum-segment-length=0, transport-protocol=UDP
        DrvSeatIntgFeedback_Field: field=DrvSeatIntgFeedback
          get getter: maximum-segment-length-request=0, maximum-segment-length-response=0, method-id=8353, transport-protocol=UDP
          notifier notifier: event-id=8353, maximum-segment-length=0, transport-protocol=UDP
        DrvWindowOpenState_Detail_Field: field=DrvWindowOpenState_Detail
          get getter: maximum-segment-length-request=0, maximum-segment-length-response=0, method-id=8215, transport-protocol=UDP
          notifier notifier: event-id=8215, maximum-segment-length=0, transport-protocol=UDP
        DrvWindowOpenState_Field: field=DrvWindowOpenState
          get getter: maximum-segment-length-request=0, maximum-segment-length-response=0, method-id=8214, transport-protocol=UDP
          notifier notifier: event-id=8214, maximum-segment-length=0, transport-protocol=UDP
        DrvWindowState_Field: field=DrvWindowState
          get getter: maximum-segment-length-request=0, maximum-segment-length-response=0, method-id=8216, transport-protocol=UDP
          notifier notifier: event-id=8216, maximum-segment-length=0, transport-protocol=UDP
        EngineRunningByRequest_Field: field=EngineRunningByRequest
          get getter: maximum-segment-length-request=0, maximum-segment-length-response=0, method-id=8217, transport-protocol=UDP
          notifier notifier: event-id=8217, maximum-segment-length=0, transport-protocol=UDP
        EuroNACPOption_Field: field=EuroNACPOption
          get getter: maximum-segment-length-request=0, maximum-segment-length-response=0, method-id=8348, transport-protocol=UDP
          notifier notifier: event-id=8348, maximum-segment-length=0, transport-protocol=UDP
        FLTurnSignalLampOpenState_Field: field=FLTurnSignalLampOpenState
          get getter: maximum-segment-length-request=0, maximum-segment-length-response=0, method-id=8218, transport-protocol=UDP
          notifier notifier: event-id=8218, maximum-segment-length=0, transport-protocol=UDP
        FOBBatteryDischarged_Field: field=FOBBatteryDischarged
          get getter: maximum-segment-length-request=0, maximum-segment-length-response=0, method-id=8219, transport-protocol=UDP
          notifier notifier: event-id=8219, maximum-segment-length=0, transport-protocol=UDP
        FRTurnSignalLampOpenState_Field: field=FRTurnSignalLampOpenState
          get getter: maximum-segment-length-request=0, maximum-segment-length-response=0, method-id=8220, transport-protocol=UDP
          notifier notifier: event-id=8220, maximum-segment-length=0, transport-protocol=UDP
        FRTurnSignalLampSwitchState_Field: field=FRTurnSignalLampSwitchState
          get getter: maximum-segment-length-request=0, maximum-segment-length-response=0, method-id=8221, transport-protocol=UDP
          notifier notifier: event-id=8221, maximum-segment-length=0, transport-protocol=UDP
        FrontHeatedGlassState_Field: field=FrontHeatedGlassState
          get getter: maximum-segment-length-request=0, maximum-segment-length-response=0, method-id=8291, transport-protocol=UDP
          notifier notifier: event-id=8291, maximum-segment-length=0, transport-protocol=UDP
        FrontSunroofState_Field: field=FrontSunroofState
          get getter: maximum-segment-length-request=0, maximum-segment-length-response=0, method-id=8292, transport-protocol=UDP
          notifier notifier: event-id=8292, maximum-segment-length=0, transport-protocol=UDP
        GearPositionPState_Field: field=GearPositionPState
          get getter: maximum-segment-length-request=0, maximum-segment-length-response=0, method-id=8222, transport-protocol=UDP
          notifier notifier: event-id=8222, maximum-segment-length=0, transport-protocol=UDP
        HazardSwitchPushState_Field: field=HazardSwitchPushState
          get getter: maximum-segment-length-request=0, maximum-segment-length-response=0, method-id=8411, transport-protocol=UDP
          notifier notifier: event-id=8411, maximum-segment-length=0, transport-protocol=UDP
        HazardSwitchState_Field: field=HazardSwitchState
          get getter: maximum-segment-length-request=0, maximum-segment-length-response=0, method-id=8223, transport-protocol=UDP
          notifier notifier: event-id=8223, maximum-segment-length=0, transport-protocol=UDP
        HighLampState_Field: field=HighLampState
          get getter: maximum-segment-length-request=0, maximum-segment-length-response=0, method-id=8224, transport-protocol=UDP
          notifier notifier: event-id=8224, maximum-segment-length=0, transport-protocol=UDP
        HoodSwitchState_Field: field=HoodSwitchState
          get getter: maximum-segment-length-request=0, maximum-segment-length-response=0, method-id=8225, transport-protocol=UDP
          notifier notifier: event-id=8225, maximum-segment-length=0, transport-protocol=UDP
        HoodSwitchState_SBCM_Field: field=HoodSwitchState_SBCM
          get getter: maximum-segment-length-request=0, maximum-segment-length-response=0, method-id=8293, transport-protocol=UDP
          notifier notifier: event-id=8293, maximum-segment-length=0, transport-protocol=UDP
        HoodTypeOptionInfo_Field: field=HoodTypeOptionInfo
          get getter: maximum-segment-length-request=0, maximum-segment-length-response=0, method-id=8294, transport-protocol=UDP
          notifier notifier: event-id=8294, maximum-segment-length=0, transport-protocol=UDP
        ICUDeliveryMode_Field: field=ICUDeliveryMode
          get getter: maximum-segment-length-request=0, maximum-segment-length-response=0, method-id=8226, transport-protocol=UDP
          notifier notifier: event-id=8226, maximum-segment-length=0, transport-protocol=UDP
        ICUupdateEnable_Field: field=ICUupdateEnable
          get getter: maximum-segment-length-request=0, maximum-segment-length-response=0, method-id=8227, transport-protocol=UDP
          notifier notifier: event-id=8227, maximum-segment-length=0, transport-protocol=UDP
        IGN3CutOffState_Field: field=IGN3CutOffState
          get getter: maximum-segment-length-request=0, maximum-segment-length-response=0, method-id=8388, transport-protocol=UDP
          notifier notifier: event-id=8388, maximum-segment-length=0, transport-protocol=UDP
        LBMOptionInfo_Field: field=LBMOptionInfo
          get getter: maximum-segment-length-request=0, maximum-segment-length-response=0, method-id=8295, transport-protocol=UDP
          notifier notifier: event-id=8295, maximum-segment-length=0, transport-protocol=UDP
        LHHighBeamLEDState_Field: field=LHHighBeamLEDState
          get getter: maximum-segment-length-request=0, maximum-segment-length-response=0, method-id=8230, transport-protocol=UDP
          notifier notifier: event-id=8230, maximum-segment-length=0, transport-protocol=UDP
        LHHighLampOpenState_Field: field=LHHighLampOpenState
          get getter: maximum-segment-length-request=0, maximum-segment-length-response=0, method-id=8231, transport-protocol=UDP
          notifier notifier: event-id=8231, maximum-segment-length=0, transport-protocol=UDP
        LHLampBifuncOpenState_Field: field=LHLampBifuncOpenState
          get getter: maximum-segment-length-request=0, maximum-segment-length-response=0, method-id=8232, transport-protocol=UDP
          notifier notifier: event-id=8232, maximum-segment-length=0, transport-protocol=UDP
        LHLowBeamLEDState_Field: field=LHLowBeamLEDState
          get getter: maximum-segment-length-request=0, maximum-segment-length-response=0, method-id=8233, transport-protocol=UDP
          notifier notifier: event-id=8233, maximum-segment-length=0, transport-protocol=UDP
        LHLowLampOpenState_Field: field=LHLowLampOpenState
          get getter: maximum-segment-length-request=0, maximum-segment-length-response=0, method-id=8234, transport-protocol=UDP
          notifier notifier: event-id=8234, maximum-segment-length=0, transport-protocol=UDP
        LHTurnSignalLampSwitchState_Field: field=LHTurnSignalLampSwitchState
          get getter: maximum-segment-length-request=0, maximum-segment-length-response=0, method-id=8235, transport-protocol=UDP
          notifier notifier: event-id=8235, maximum-segment-length=0, transport-protocol=UDP
        LampLeftSwitchStatusIBU_Field: field=LampLeftSwitchStatusIBU
          get getter: maximum-segment-length-request=0, maximum-segment-length-response=0, method-id=8311, transport-protocol=UDP
          notifier notifier: event-id=8311, maximum-segment-length=0, transport-protocol=UDP
        LatchTypeOptionInfo_Field: field=LatchTypeOptionInfo
          get getter: maximum-segment-length-request=0, maximum-segment-length-response=0, method-id=8228, transport-protocol=UDP
          notifier notifier: event-id=8228, maximum-segment-length=0, transport-protocol=UDP
        LedLampState_Field: field=LedLampState
          get getter: maximum-segment-length-request=0, maximum-segment-length-response=0, method-id=8229, transport-protocol=UDP
          notifier notifier: event-id=8229, maximum-segment-length=0, transport-protocol=UDP
        LeftTurnLampCmdState_Field: field=LeftTurnLampCmdState
          get getter: maximum-segment-length-request=0, maximum-segment-length-response=0, method-id=8312, transport-protocol=UDP
          notifier notifier: event-id=8312, maximum-segment-length=0, transport-protocol=UDP
        LftStopLampState_Field: field=LftStopLampState
          get getter: maximum-segment-length-request=0, maximum-segment-length-response=0, method-id=8296, transport-protocol=UDP
          notifier notifier: event-id=8296, maximum-segment-length=0, transport-protocol=UDP
        LithiumBatteryWarningState_Field: field=LithiumBatteryWarningState
          get getter: maximum-segment-length-request=0, maximum-segment-length-response=0, method-id=8236, transport-protocol=UDP
          notifier notifier: event-id=8236, maximum-segment-length=0, transport-protocol=UDP
        LowLampState_Field: field=LowLampState
          get getter: maximum-segment-length-request=0, maximum-segment-length-response=0, method-id=8237, transport-protocol=UDP
          notifier notifier: event-id=8237, maximum-segment-length=0, transport-protocol=UDP
        MainLBMSocValue_Field: field=MainLBMSocValue
          get getter: maximum-segment-length-request=0, maximum-segment-length-response=0, method-id=8391, transport-protocol=UDP
          notifier notifier: event-id=8391, maximum-segment-length=0, transport-protocol=UDP
        MoodLampDualColorOptSta_Field: field=MoodLampDualColorOptSta
          get getter: maximum-segment-length-request=0, maximum-segment-length-response=0, method-id=8365, transport-protocol=UDP
          notifier notifier: event-id=8365, maximum-segment-length=0, transport-protocol=UDP
        PDC_MainLBMoption_Field: field=PDC_MainLBMoption
          get getter: maximum-segment-length-request=0, maximum-segment-length-response=0, method-id=8398, transport-protocol=UDP
          notifier notifier: event-id=8398, maximum-segment-length=0, transport-protocol=UDP
        PDCexCurtainOptionInform_Field: field=PDCexCurtainOptionInform
          get getter: maximum-segment-length-request=0, maximum-segment-length-response=0, method-id=8313, transport-protocol=UDP
          notifier notifier: event-id=8313, maximum-segment-length=0, transport-protocol=UDP
        PDCexTailgateUnlockedStatus_Field: field=PDCexTailgateUnlockedStatus
          get getter: maximum-segment-length-request=0, maximum-segment-length-response=0, method-id=8314, transport-protocol=UDP
          notifier notifier: event-id=8314, maximum-segment-length=0, transport-protocol=UDP
        PDSTypeOptionDRV_Field: field=PDSTypeOptionDRV
          get getter: maximum-segment-length-request=0, maximum-segment-length-response=0, method-id=8315, transport-protocol=UDP
          notifier notifier: event-id=8315, maximum-segment-length=0, transport-protocol=UDP
        PHEV_FuelDrCtrlFlagInfo_Field: field=PHEV_FuelDrCtrlFlagInfo
          get getter: maximum-segment-length-request=0, maximum-segment-length-response=0, method-id=8297, transport-protocol=UDP
          notifier notifier: event-id=8297, maximum-segment-length=0, transport-protocol=UDP
        PSDInsideSwEnable_Field: field=PSDInsideSwEnable
          get getter: maximum-segment-length-request=0, maximum-segment-length-response=0, method-id=8361, transport-protocol=UDP
          notifier notifier: event-id=8361, maximum-segment-length=0, transport-protocol=UDP
        PSDOptLHRH_Field: field=PSDOptLHRH
          get getter: maximum-segment-length-request=0, maximum-segment-length-response=0, method-id=8360, transport-protocol=UDP
          notifier notifier: event-id=8360, maximum-segment-length=0, transport-protocol=UDP
        PTGDrvSideSwEnable_Field: field=PTGDrvSideSwEnable
          get getter: maximum-segment-length-request=0, maximum-segment-length-response=0, method-id=8367, transport-protocol=UDP
          notifier notifier: event-id=8367, maximum-segment-length=0, transport-protocol=UDP
        PTGInsideSwEnable_Field: field=PTGInsideSwEnable
          get getter: maximum-segment-length-request=0, maximum-segment-length-response=0, method-id=8368, transport-protocol=UDP
          notifier notifier: event-id=8368, maximum-segment-length=0, transport-protocol=UDP
        PTGM_TrnkTlgtOption_Field: field=PTGM_TrnkTlgtOption
          get getter: maximum-segment-length-request=0, maximum-segment-length-response=0, method-id=8397, transport-protocol=UDP
          notifier notifier: event-id=8397, maximum-segment-length=0, transport-protocol=UDP
        PanicAlarmState_Field: field=PanicAlarmState
          get getter: maximum-segment-length-request=0, maximum-segment-length-response=0, method-id=8238, transport-protocol=UDP
          notifier notifier: event-id=8238, maximum-segment-length=0, transport-protocol=UDP
        ParkingPositionState_Field: field=ParkingPositionState
          get getter: maximum-segment-length-request=0, maximum-segment-length-response=0, method-id=8239, transport-protocol=UDP
          notifier notifier: event-id=8239, maximum-segment-length=0, transport-protocol=UDP
        PlatformVersionDate_Field: field=PlatformVersionDate
          get getter: maximum-segment-length-request=0, maximum-segment-length-response=0, method-id=8316, transport-protocol=UDP
          notifier notifier: event-id=8316, maximum-segment-length=0, transport-protocol=UDP
        PlatformVersionType_Field: field=PlatformVersionType
          get getter: maximum-segment-length-request=0, maximum-segment-length-response=0, method-id=8317, transport-protocol=UDP
          notifier notifier: event-id=8317, maximum-segment-length=0, transport-protocol=UDP
        PowerWindowSWType_Field: field=PowerWindowSWType
          get getter: maximum-segment-length-request=0, maximum-segment-length-response=0, method-id=8240, transport-protocol=UDP
          notifier notifier: event-id=8240, maximum-segment-length=0, transport-protocol=UDP
        PrkngBrkSwState_Field: field=PrkngBrkSwState
          get getter: maximum-segment-length-request=0, maximum-segment-length-response=0, method-id=8298, transport-protocol=UDP
          notifier notifier: event-id=8298, maximum-segment-length=0, transport-protocol=UDP
        PwrOnMaintain_Field: field=PwrOnMaintain
          get getter: maximum-segment-length-request=0, maximum-segment-length-response=0, method-id=8363, transport-protocol=UDP
          notifier notifier: event-id=8363, maximum-segment-length=0, transport-protocol=UDP
        PwrTransEnable_Field: field=PwrTransEnable
          get getter: maximum-segment-length-request=0, maximum-segment-length-response=0, method-id=8362, transport-protocol=UDP
          notifier notifier: event-id=8362, maximum-segment-length=0, transport-protocol=UDP
        PwrWdwSwEnable_Field: field=PwrWdwSwEnable
          get getter: maximum-segment-length-request=0, maximum-segment-length-response=0, method-id=8355, transport-protocol=UDP
          notifier notifier: event-id=8355, maximum-segment-length=0, transport-protocol=UDP
        RDCTypeOption_Field: field=RDCTypeOption
          get getter: maximum-segment-length-request=0, maximum-segment-length-response=0, method-id=8318, transport-protocol=UDP
          notifier notifier: event-id=8318, maximum-segment-length=0, transport-protocol=UDP
        RHHighBeamLEDState_Field: field=RHHighBeamLEDState
          get getter: maximum-segment-length-request=0, maximum-segment-length-response=0, method-id=8247, transport-protocol=UDP
          notifier notifier: event-id=8247, maximum-segment-length=0, transport-protocol=UDP
        RHHighLampOpenState_Field: field=RHHighLampOpenState
          get getter: maximum-segment-length-request=0, maximum-segment-length-response=0, method-id=8248, transport-protocol=UDP
          notifier notifier: event-id=8248, maximum-segment-length=0, transport-protocol=UDP
        RHLampBifuncOpenState_Field: field=RHLampBifuncOpenState
          get getter: maximum-segment-length-request=0, maximum-segment-length-response=0, method-id=8249, transport-protocol=UDP
          notifier notifier: event-id=8249, maximum-segment-length=0, transport-protocol=UDP
        RHLowBeamLEDState_Field: field=RHLowBeamLEDState
          get getter: maximum-segment-length-request=0, maximum-segment-length-response=0, method-id=8250, transport-protocol=UDP
          notifier notifier: event-id=8250, maximum-segment-length=0, transport-protocol=UDP
        RHLowLampOpenState_Field: field=RHLowLampOpenState
          get getter: maximum-segment-length-request=0, maximum-segment-length-response=0, method-id=8251, transport-protocol=UDP
          notifier notifier: event-id=8251, maximum-segment-length=0, transport-protocol=UDP
        RLCurtainPosition_Field: field=RLCurtainPosition
          get getter: maximum-segment-length-request=0, maximum-segment-length-response=0, method-id=8253, transport-protocol=UDP
          notifier notifier: event-id=8253, maximum-segment-length=0, transport-protocol=UDP
        RLDoorSwitchState_Field: field=RLDoorSwitchState
          get getter: maximum-segment-length-request=0, maximum-segment-length-response=0, method-id=8254, transport-protocol=UDP
          notifier notifier: event-id=8254, maximum-segment-length=0, transport-protocol=UDP
        RLDoorSwitchState_SBCM_Field: field=RLDoorSwitchState_SBCM
          get getter: maximum-segment-length-request=0, maximum-segment-length-response=0, method-id=8300, transport-protocol=UDP
          notifier notifier: event-id=8300, maximum-segment-length=0, transport-protocol=UDP
        RLDoorUnLockState_SBCM_Field: field=RLDoorUnLockState_SBCM
          get getter: maximum-segment-length-request=0, maximum-segment-length-response=0, method-id=8301, transport-protocol=UDP
          notifier notifier: event-id=8301, maximum-segment-length=0, transport-protocol=UDP
        RLDoorUnlockState_Field: field=RLDoorUnlockState
          get getter: maximum-segment-length-request=0, maximum-segment-length-response=0, method-id=8255, transport-protocol=UDP
          notifier notifier: event-id=8255, maximum-segment-length=0, transport-protocol=UDP
        RLDrLkUnLkInsdSwEnable_Get_Field: field=RLDrLkUnLkInsdSwEnable_Get
          get getter: maximum-segment-length-request=0, maximum-segment-length-response=0, method-id=8395, transport-protocol=UDP
          notifier notifier: event-id=8395, maximum-segment-length=0, transport-protocol=UDP
        RLDrReleaseInsideSwEnable_Field: field=RLDrReleaseInsideSwEnable
          get getter: maximum-segment-length-request=0, maximum-segment-length-response=0, method-id=8358, transport-protocol=UDP
          notifier notifier: event-id=8358, maximum-segment-length=0, transport-protocol=UDP
        RLRrDoorCurtainPosition_Field: field=RLRrDoorCurtainPosition
          get getter: maximum-segment-length-request=0, maximum-segment-length-response=0, method-id=8324, transport-protocol=UDP
          notifier notifier: event-id=8324, maximum-segment-length=0, transport-protocol=UDP
        RLTurnSignalLampOpenState_Field: field=RLTurnSignalLampOpenState
          get getter: maximum-segment-length-request=0, maximum-segment-length-response=0, method-id=8256, transport-protocol=UDP
          notifier notifier: event-id=8256, maximum-segment-length=0, transport-protocol=UDP
        RLWindowOpenState_Field: field=RLWindowOpenState
          get getter: maximum-segment-length-request=0, maximum-segment-length-response=0, method-id=8257, transport-protocol=UDP
          notifier notifier: event-id=8257, maximum-segment-length=0, transport-protocol=UDP
        RLWindowOpenstate_Detail_Field: field=RLWindowOpenstate_Detail
          get getter: maximum-segment-length-request=0, maximum-segment-length-response=0, method-id=8258, transport-protocol=UDP
          notifier notifier: event-id=8258, maximum-segment-length=0, transport-protocol=UDP
        RLWindowState_Field: field=RLWindowState
          get getter: maximum-segment-length-request=0, maximum-segment-length-response=0, method-id=8259, transport-protocol=UDP
          notifier notifier: event-id=8259, maximum-segment-length=0, transport-protocol=UDP
        ROAEnable_Field: field=ROAEnable
          get getter: maximum-segment-length-request=0, maximum-segment-length-response=0, method-id=8366, transport-protocol=UDP
          notifier notifier: event-id=8366, maximum-segment-length=0, transport-protocol=UDP
        RRCurtainPosition_Field: field=RRCurtainPosition
          get getter: maximum-segment-length-request=0, maximum-segment-length-response=0, method-id=8261, transport-protocol=UDP
          notifier notifier: event-id=8261, maximum-segment-length=0, transport-protocol=UDP
        RRDoorSwitchState_Field: field=RRDoorSwitchState
          get getter: maximum-segment-length-request=0, maximum-segment-length-response=0, method-id=8262, transport-protocol=UDP
          notifier notifier: event-id=8262, maximum-segment-length=0, transport-protocol=UDP
        RRDoorSwitchState_SBCM_Field: field=RRDoorSwitchState_SBCM
          get getter: maximum-segment-length-request=0, maximum-segment-length-response=0, method-id=8302, transport-protocol=UDP
          notifier notifier: event-id=8302, maximum-segment-length=0, transport-protocol=UDP
        RRDoorUnLockState_SBCM_Field: field=RRDoorUnLockState_SBCM
          get getter: maximum-segment-length-request=0, maximum-segment-length-response=0, method-id=8303, transport-protocol=UDP
          notifier notifier: event-id=8303, maximum-segment-length=0, transport-protocol=UDP
        RRDoorUnlockState_Field: field=RRDoorUnlockState
          get getter: maximum-segment-length-request=0, maximum-segment-length-response=0, method-id=8263, transport-protocol=UDP
          notifier notifier: event-id=8263, maximum-segment-length=0, transport-protocol=UDP
        RRDrLkUnLkInsdSwEnable_Get_Field: field=RRDrLkUnLkInsdSwEnable_Get
          get getter: maximum-segment-length-request=0, maximum-segment-length-response=0, method-id=8396, transport-protocol=UDP
          notifier notifier: event-id=8396, maximum-segment-length=0, transport-protocol=UDP
        RRDrReleaseInsideSwEnable_Field: field=RRDrReleaseInsideSwEnable
          get getter: maximum-segment-length-request=0, maximum-segment-length-response=0, method-id=8359, transport-protocol=UDP
          notifier notifier: event-id=8359, maximum-segment-length=0, transport-protocol=UDP
        RRRrDoorCurtainPosition_Field: field=RRRrDoorCurtainPosition
          get getter: maximum-segment-length-request=0, maximum-segment-length-response=0, method-id=8325, transport-protocol=UDP
          notifier notifier: event-id=8325, maximum-segment-length=0, transport-protocol=UDP
        RRTurnSignalLampOpenState_Field: field=RRTurnSignalLampOpenState
          get getter: maximum-segment-length-request=0, maximum-segment-length-response=0, method-id=8264, transport-protocol=UDP
          notifier notifier: event-id=8264, maximum-segment-length=0, transport-protocol=UDP
        RRWindowOpenState_Detail_Field: field=RRWindowOpenState_Detail
          get getter: maximum-segment-length-request=0, maximum-segment-length-response=0, method-id=8266, transport-protocol=UDP
          notifier notifier: event-id=8266, maximum-segment-length=0, transport-protocol=UDP
        RRWindowOpenState_Field: field=RRWindowOpenState
          get getter: maximum-segment-length-request=0, maximum-segment-length-response=0, method-id=8265, transport-protocol=UDP
          notifier notifier: event-id=8265, maximum-segment-length=0, transport-protocol=UDP
        RRWindowState_Field: field=RRWindowState
          get getter: maximum-segment-length-request=0, maximum-segment-length-response=0, method-id=8267, transport-protocol=UDP
          notifier notifier: event-id=8267, maximum-segment-length=0, transport-protocol=UDP
        ReadyTimeValueForReset_Field: field=ReadyTimeValueForReset
          get getter: maximum-segment-length-request=0, maximum-segment-length-response=0, method-id=8370, transport-protocol=UDP
          notifier notifier: event-id=8370, maximum-segment-length=0, transport-protocol=UDP
        RearCurtainOptionInfo_Field: field=RearCurtainOptionInfo
          get getter: maximum-segment-length-request=0, maximum-segment-length-response=0, method-id=8241, transport-protocol=UDP
          notifier notifier: event-id=8241, maximum-segment-length=0, transport-protocol=UDP
        RearDefoggerState_Field: field=RearDefoggerState
          get getter: maximum-segment-length-request=0, maximum-segment-length-response=0, method-id=8242, transport-protocol=UDP
          notifier notifier: event-id=8242, maximum-segment-length=0, transport-protocol=UDP
        RearLeftQuarterCurtainPosition_Field: field=RearLeftQuarterCurtainPosition
          get getter: maximum-segment-length-request=0, maximum-segment-length-response=0, method-id=8319, transport-protocol=UDP
          notifier notifier: event-id=8319, maximum-segment-length=0, transport-protocol=UDP
        RearLeftSeatHeatVentIndCmd_Field: field=RearLeftSeatHeatVentIndCmd
          get getter: maximum-segment-length-request=0, maximum-segment-length-response=0, method-id=8320, transport-protocol=UDP
          notifier notifier: event-id=8320, maximum-segment-length=0, transport-protocol=UDP
        RearRightQuarterCurtainPosition_Field: field=RearRightQuarterCurtainPosition
          get getter: maximum-segment-length-request=0, maximum-segment-length-response=0, method-id=8321, transport-protocol=UDP
          notifier notifier: event-id=8321, maximum-segment-length=0, transport-protocol=UDP
        RearRightSeatHeatVentIndCmd_Field: field=RearRightSeatHeatVentIndCmd
          get getter: maximum-segment-length-request=0, maximum-segment-length-response=0, method-id=8322, transport-protocol=UDP
          notifier notifier: event-id=8322, maximum-segment-length=0, transport-protocol=UDP
        RearSeatOccupancyState_Field: field=RearSeatOccupancyState
          get getter: maximum-segment-length-request=0, maximum-segment-length-response=0, method-id=8243, transport-protocol=UDP
          notifier notifier: event-id=8243, maximum-segment-length=0, transport-protocol=UDP
        RearSeatReminderOptionState_Field: field=RearSeatReminderOptionState
          get getter: maximum-segment-length-request=0, maximum-segment-length-response=0, method-id=8244, transport-protocol=UDP
          notifier notifier: event-id=8244, maximum-segment-length=0, transport-protocol=UDP
        RearSeatReminderSystemState_Field: field=RearSeatReminderSystemState
          get getter: maximum-segment-length-request=0, maximum-segment-length-response=0, method-id=8245, transport-protocol=UDP
          notifier notifier: event-id=8245, maximum-segment-length=0, transport-protocol=UDP
        RearSunroofState_Field: field=RearSunroofState
          get getter: maximum-segment-length-request=0, maximum-segment-length-response=0, method-id=8299, transport-protocol=UDP
          notifier notifier: event-id=8299, maximum-segment-length=0, transport-protocol=UDP
        RemoteKeyBtnReq_Field: field=RemoteKeyBtnReq
          get getter: maximum-segment-length-request=0, maximum-segment-length-response=0, method-id=8389, transport-protocol=UDP
          notifier notifier: event-id=8389, maximum-segment-length=0, transport-protocol=UDP
        RemoteStartEncryptionInfo_Field: field=RemoteStartEncryptionInfo
          get getter: maximum-segment-length-request=0, maximum-segment-length-response=0, method-id=8351, transport-protocol=UDP
          notifier notifier: event-id=8351, maximum-segment-length=0, transport-protocol=UDP
        RemoteStartResult_Field: field=RemoteStartResult
          get getter: maximum-segment-length-request=0, maximum-segment-length-response=0, method-id=8350, transport-protocol=UDP
          notifier notifier: event-id=8350, maximum-segment-length=0, transport-protocol=UDP
        RemoteStartRndnum_Field: field=RemoteStartRndnum
          get getter: maximum-segment-length-request=0, maximum-segment-length-response=0, method-id=8349, transport-protocol=UDP
          notifier notifier: event-id=8349, maximum-segment-length=0, transport-protocol=UDP
        ResetCountSetting_Field: field=ResetCountSetting
          get getter: maximum-segment-length-request=0, maximum-segment-length-response=0, method-id=8384, transport-protocol=UDP
          notifier notifier: event-id=8384, maximum-segment-length=0, transport-protocol=UDP
        ResetCount_Field: field=ResetCount
          get getter: maximum-segment-length-request=0, maximum-segment-length-response=0, method-id=8385, transport-protocol=UDP
          notifier notifier: event-id=8385, maximum-segment-length=0, transport-protocol=UDP
        ResetCumulativeCount_Field: field=ResetCumulativeCount
          get getter: maximum-segment-length-request=0, maximum-segment-length-response=0, method-id=8386, transport-protocol=UDP
          notifier notifier: event-id=8386, maximum-segment-length=0, transport-protocol=UDP
        ResetFuncOpt_Field: field=ResetFuncOpt
          get getter: maximum-segment-length-request=0, maximum-segment-length-response=0, method-id=8381, transport-protocol=UDP
          notifier notifier: event-id=8381, maximum-segment-length=0, transport-protocol=UDP
        ResetOpsta_Field: field=ResetOpsta
          get getter: maximum-segment-length-request=0, maximum-segment-length-response=0, method-id=8387, transport-protocol=UDP
          notifier notifier: event-id=8387, maximum-segment-length=0, transport-protocol=UDP
        ResetPreWrngForCCU_Field: field=ResetPreWrngForCCU
          get getter: maximum-segment-length-request=0, maximum-segment-length-response=0, method-id=8377, transport-protocol=UDP
          notifier notifier: event-id=8377, maximum-segment-length=0, transport-protocol=UDP
        ResetPreWrngForOthers_Field: field=ResetPreWrngForOthers
          get getter: maximum-segment-length-request=0, maximum-segment-length-response=0, method-id=8378, transport-protocol=UDP
          notifier notifier: event-id=8378, maximum-segment-length=0, transport-protocol=UDP
        ResetReason_Field: field=ResetReason
          get getter: maximum-segment-length-request=0, maximum-segment-length-response=0, method-id=8374, transport-protocol=UDP
          notifier notifier: event-id=8374, maximum-segment-length=0, transport-protocol=UDP
        ResetReqForCCU_Field: field=ResetReqForCCU
          get getter: maximum-segment-length-request=0, maximum-segment-length-response=0, method-id=8379, transport-protocol=UDP
          notifier notifier: event-id=8379, maximum-segment-length=0, transport-protocol=UDP
        ResetReqForOthers_Field: field=ResetReqForOthers
          get getter: maximum-segment-length-request=0, maximum-segment-length-response=0, method-id=8380, transport-protocol=UDP
          notifier notifier: event-id=8380, maximum-segment-length=0, transport-protocol=UDP
        RightTurnLampCmdState_Field: field=RightTurnLampCmdState
          get getter: maximum-segment-length-request=0, maximum-segment-length-response=0, method-id=8323, transport-protocol=UDP
          notifier notifier: event-id=8323, maximum-segment-length=0, transport-protocol=UDP
        Rly12VCtrl_Field: field=Rly12VCtrl
          get getter: maximum-segment-length-request=0, maximum-segment-length-response=0, method-id=8382, transport-protocol=UDP
          notifier notifier: event-id=8382, maximum-segment-length=0, transport-protocol=UDP
        Rly12VOffHoldingTime_Field: field=Rly12VOffHoldingTime
          get getter: maximum-segment-length-request=0, maximum-segment-length-response=0, method-id=8383, transport-protocol=UDP
          notifier notifier: event-id=8383, maximum-segment-length=0, transport-protocol=UDP
        RtStopLampState_Field: field=RtStopLampState
          get getter: maximum-segment-length-request=0, maximum-segment-length-response=0, method-id=8304, transport-protocol=UDP
          notifier notifier: event-id=8304, maximum-segment-length=0, transport-protocol=UDP
        SACCargoFreezerWarningState_Field: field=SACCargoFreezerWarningState
          get getter: maximum-segment-length-request=0, maximum-segment-length-response=0, method-id=8408, transport-protocol=UDP
          notifier notifier: event-id=8408, maximum-segment-length=0, transport-protocol=UDP
        SACCargoFreezerWarningValue_Field: field=SACCargoFreezerWarningValue
          get getter: maximum-segment-length-request=0, maximum-segment-length-response=0, method-id=8409, transport-protocol=UDP
          notifier notifier: event-id=8409, maximum-segment-length=0, transport-protocol=UDP
        SBCMFrunkState_Field: field=SBCMFrunkState
          get getter: maximum-segment-length-request=0, maximum-segment-length-response=0, method-id=8305, transport-protocol=UDP
          notifier notifier: event-id=8305, maximum-segment-length=0, transport-protocol=UDP
        SMKTlPwrOnState_Field: field=SMKTlPwrOnState
          get getter: maximum-segment-length-request=0, maximum-segment-length-response=0, method-id=8393, transport-protocol=UDP
          notifier notifier: event-id=8393, maximum-segment-length=0, transport-protocol=UDP
        SafetyWindowOptionInfo_Field: field=SafetyWindowOptionInfo
          get getter: maximum-segment-length-request=0, maximum-segment-length-response=0, method-id=8268, transport-protocol=UDP
          notifier notifier: event-id=8268, maximum-segment-length=0, transport-protocol=UDP
        SteeringWheelHeatingOption_Field: field=SteeringWheelHeatingOption
          get getter: maximum-segment-length-request=0, maximum-segment-length-response=0, method-id=8270, transport-protocol=UDP
          notifier notifier: event-id=8270, maximum-segment-length=0, transport-protocol=UDP
        SteeringWheelHeatingState_Field: field=SteeringWheelHeatingState
          get getter: maximum-segment-length-request=0, maximum-segment-length-response=0, method-id=8271, transport-protocol=UDP
          notifier notifier: event-id=8271, maximum-segment-length=0, transport-protocol=UDP
        SteeringWheelheatingCommand_Field: field=SteeringWheelheatingCommand
          get getter: maximum-segment-length-request=0, maximum-segment-length-response=0, method-id=8269, transport-protocol=UDP
          notifier notifier: event-id=8269, maximum-segment-length=0, transport-protocol=UDP
        SteeringWheelheatingStep_Field: field=SteeringWheelheatingStep
          get getter: maximum-segment-length-request=0, maximum-segment-length-response=0, method-id=8272, transport-protocol=UDP
          notifier notifier: event-id=8272, maximum-segment-length=0, transport-protocol=UDP
        SunRoofOptionType_Field: field=SunRoofOptionType
          get getter: maximum-segment-length-request=0, maximum-segment-length-response=0, method-id=8273, transport-protocol=UDP
          notifier notifier: event-id=8273, maximum-segment-length=0, transport-protocol=UDP
        SunRoofState_Field: field=Body1/SunRoofState
          get getter: maximum-segment-length-request=0, maximum-segment-length-response=0, method-id=8274, transport-protocol=UDP
          notifier notifier: event-id=8274, maximum-segment-length=0, transport-protocol=UDP
        TPMSPressUnitStatus_Field: field=TPMSPressUnitStatus
          get getter: maximum-segment-length-request=0, maximum-segment-length-response=0, method-id=8337, transport-protocol=UDP
          notifier notifier: event-id=8337, maximum-segment-length=0, transport-protocol=UDP
        TPMSThreadWarnLampStatus_Field: field=TPMSThreadWarnLampStatus
          get getter: maximum-segment-length-request=0, maximum-segment-length-response=0, method-id=8339, transport-protocol=UDP
          notifier notifier: event-id=8339, maximum-segment-length=0, transport-protocol=UDP
        TPMSWarnLampStatus_Field: field=TPMSWarnLampStatus
          get getter: maximum-segment-length-request=0, maximum-segment-length-response=0, method-id=8338, transport-protocol=UDP
          notifier notifier: event-id=8338, maximum-segment-length=0, transport-protocol=UDP
        TPMS_FrLeftTirePressure_Field: field=TPMS_FrLeftTirePressure
          get getter: maximum-segment-length-request=0, maximum-segment-length-response=0, method-id=8344, transport-protocol=UDP
          notifier notifier: event-id=8344, maximum-segment-length=0, transport-protocol=UDP
        TPMS_FrLeftWarnLampStatus_Field: field=TPMS_FrLeftWarnLampStatus
          get getter: maximum-segment-length-request=0, maximum-segment-length-response=0, method-id=8340, transport-protocol=UDP
          notifier notifier: event-id=8340, maximum-segment-length=0, transport-protocol=UDP
        TPMS_FrRightTirePressure_Field: field=TPMS_FrRightTirePressure
          get getter: maximum-segment-length-request=0, maximum-segment-length-response=0, method-id=8345, transport-protocol=UDP
          notifier notifier: event-id=8345, maximum-segment-length=0, transport-protocol=UDP
        TPMS_FrRightWanrLampStatus_Field: field=TPMS_FrRightWanrLampStatus
          get getter: maximum-segment-length-request=0, maximum-segment-length-response=0, method-id=8341, transport-protocol=UDP
          notifier notifier: event-id=8341, maximum-segment-length=0, transport-protocol=UDP
        TPMS_RrLeftTirePressure_Field: field=TPMS_RrLeftTirePressure
          get getter: maximum-segment-length-request=0, maximum-segment-length-response=0, method-id=8346, transport-protocol=UDP
          notifier notifier: event-id=8346, maximum-segment-length=0, transport-protocol=UDP
        TPMS_RrLeftWarnLampStatus_Field: field=TPMS_RrLeftWarnLampStatus
          get getter: maximum-segment-length-request=0, maximum-segment-length-response=0, method-id=8342, transport-protocol=UDP
          notifier notifier: event-id=8342, maximum-segment-length=0, transport-protocol=UDP
        TPMS_RrRightTirePressure_Field: field=TPMS_RrRightTirePressure
          get getter: maximum-segment-length-request=0, maximum-segment-length-response=0, method-id=8347, transport-protocol=UDP
          notifier notifier: event-id=8347, maximum-segment-length=0, transport-protocol=UDP
        TPMS_RrRightWanrLampStatus_Field: field=TPMS_RrRightWanrLampStatus
          get getter: maximum-segment-length-request=0, maximum-segment-length-response=0, method-id=8343, transport-protocol=UDP
          notifier notifier: event-id=8343, maximum-segment-length=0, transport-protocol=UDP
        TailLampState_Field: field=TailLampState
          get getter: maximum-segment-length-request=0, maximum-segment-length-response=0, method-id=8275, transport-protocol=UDP
          notifier notifier: event-id=8275, maximum-segment-length=0, transport-protocol=UDP
        TerminalControlGroupState_Field: field=TerminalControlGroupState
          get getter: maximum-segment-length-request=0, maximum-segment-length-response=0, method-id=8410, transport-protocol=UDP
          notifier notifier: event-id=8410, maximum-segment-length=0, transport-protocol=UDP
        TimeValueForReset_Field: field=TimeValueForReset
          get getter: maximum-segment-length-request=0, maximum-segment-length-response=0, method-id=8371, transport-protocol=UDP
          notifier notifier: event-id=8371, maximum-segment-length=0, transport-protocol=UDP
        TrdLeftSeatHeatVentIndCmd_Field: field=TrdLeftSeatHeatVentIndCmd
          get getter: maximum-segment-length-request=0, maximum-segment-length-response=0, method-id=8326, transport-protocol=UDP
          notifier notifier: event-id=8326, maximum-segment-length=0, transport-protocol=UDP
        TrdRightSeatHeatVentIndCmd_Field: field=TrdRightSeatHeatVentIndCmd
          get getter: maximum-segment-length-request=0, maximum-segment-length-response=0, method-id=8327, transport-protocol=UDP
          notifier notifier: event-id=8327, maximum-segment-length=0, transport-protocol=UDP
        TrunkSwitchState_Field: field=TrunkSwitchState
          get getter: maximum-segment-length-request=0, maximum-segment-length-response=0, method-id=8276, transport-protocol=UDP
          notifier notifier: event-id=8276, maximum-segment-length=0, transport-protocol=UDP
        TurnLampMode_Field: field=TurnLampMode
          get getter: maximum-segment-length-request=0, maximum-segment-length-response=0, method-id=8328, transport-protocol=UDP
          notifier notifier: event-id=8328, maximum-segment-length=0, transport-protocol=UDP
        TurnSignalLampLeftActiveState_Field: field=TurnSignalLampLeftActiveState
          get getter: maximum-segment-length-request=0, maximum-segment-length-response=0, method-id=8329, transport-protocol=UDP
          notifier notifier: event-id=8329, maximum-segment-length=0, transport-protocol=UDP
        TurnSignalLampRightActiveState_Field: field=TurnSignalLampRightActiveState
          get getter: maximum-segment-length-request=0, maximum-segment-length-response=0, method-id=8330, transport-protocol=UDP
          notifier notifier: event-id=8330, maximum-segment-length=0, transport-protocol=UDP
        W_ADMCmd_BC_Field: field=W_ADMCmd_BC
          get getter: maximum-segment-length-request=0, maximum-segment-length-response=0, method-id=8412, transport-protocol=UDP
          notifier notifier: event-id=8412, maximum-segment-length=0, transport-protocol=UDP
        WarnAsstSeatbeltSwitchStatus_Field: field=WarnAsstSeatbeltSwitchStatus
          get getter: maximum-segment-length-request=0, maximum-segment-length-response=0, method-id=8331, transport-protocol=UDP
          notifier notifier: event-id=8331, maximum-segment-length=0, transport-protocol=UDP
        WarnDriverSeatStaus_Field: field=WarnDriverSeatStaus
          get getter: maximum-segment-length-request=0, maximum-segment-length-response=0, method-id=8333, transport-protocol=UDP
          notifier notifier: event-id=8333, maximum-segment-length=0, transport-protocol=UDP
        WarnDriverSeatbeltSwitchStatus_Field: field=WarnDriverSeatbeltSwitchStatus
          get getter: maximum-segment-length-request=0, maximum-segment-length-response=0, method-id=8332, transport-protocol=UDP
          notifier notifier: event-id=8332, maximum-segment-length=0, transport-protocol=UDP
        WarnPassengerSeatStatus_Field: field=WarnPassengerSeatStatus
          get getter: maximum-segment-length-request=0, maximum-segment-length-response=0, method-id=8334, transport-protocol=UDP
          notifier notifier: event-id=8334, maximum-segment-length=0, transport-protocol=UDP
        WasherFluidSwitchState_Field: field=WasherFluidSwitchState
          get getter: maximum-segment-length-request=0, maximum-segment-length-response=0, method-id=8277, transport-protocol=UDP
          notifier notifier: event-id=8277, maximum-segment-length=0, transport-protocol=UDP
      216 x someip event group:
        NewEventGroup: event-group-id=1, event=AlarmStatus_Field/notifier
        NewEventGroup1: event-group-id=2, event=AsstDoorSwitchState_Field/notifier
        NewEventGroup10: event-group-id=11, event=BatteryDischargeWarningState_Field/notifier
        NewEventGroup100: event-group-id=101, event=RRCurtainPosition_Field/notifier
        NewEventGroup101: event-group-id=102, event=RRDoorSwitchState_Field/notifier
        NewEventGroup102: event-group-id=103, event=RRDoorSwitchState_SBCM_Field/notifier
        NewEventGroup103: event-group-id=104, event=RRDoorUnLockState_SBCM_Field/notifier
        NewEventGroup104: event-group-id=105, event=RRDoorUnlockState_Field/notifier
        NewEventGroup105: event-group-id=106, event=RRRrDoorCurtainPosition_Field/notifier
        NewEventGroup106: event-group-id=107, event=RRTurnSignalLampOpenState_Field/notifier
        NewEventGroup107: event-group-id=108, event=RRWindowOpenState_Field/notifier
        NewEventGroup108: event-group-id=109, event=RRWindowOpenState_Detail_Field/notifier
        NewEventGroup109: event-group-id=110, event=RRWindowState_Field/notifier
        NewEventGroup11: event-group-id=12, event=BatteryEmergencyState_Field/notifier
        NewEventGroup110: event-group-id=111, event=RearCurtainOptionInfo_Field/notifier
        NewEventGroup111: event-group-id=112, event=RearDefoggerState_Field/notifier
        NewEventGroup112: event-group-id=113, event=RearLeftQuarterCurtainPosition_Field/notifier
        NewEventGroup113: event-group-id=114, event=RearLeftSeatHeatVentIndCmd_Field/notifier
        NewEventGroup114: event-group-id=115, event=RearRightQuarterCurtainPosition_Field/notifier
        NewEventGroup115: event-group-id=116, event=RearRightSeatHeatVentIndCmd_Field/notifier
        NewEventGroup116: event-group-id=117, event=RearSeatOccupancyState_Field/notifier
        NewEventGroup117: event-group-id=118, event=RearSeatReminderOptionState_Field/notifier
        NewEventGroup118: event-group-id=119, event=RearSeatReminderSystemState_Field/notifier
        NewEventGroup119: event-group-id=120, event=RearSunroofState_Field/notifier
        NewEventGroup12: event-group-id=13, event=BatteryPowerState_Field/notifier
        NewEventGroup120: event-group-id=121, event=RemoteStartEncryptionInfo_Field/notifier
        NewEventGroup121: event-group-id=122, event=RemoteStartResult_Field/notifier
        NewEventGroup122: event-group-id=123, event=RemoteStartRndnum_Field/notifier
        NewEventGroup123: event-group-id=124, event=RightTurnLampCmdState_Field/notifier
        NewEventGroup124: event-group-id=125, event=RtStopLampState_Field/notifier
        NewEventGroup125: event-group-id=126, event=SBCMFrunkState_Field/notifier
        NewEventGroup126: event-group-id=127, event=SafetyWindowOptionInfo_Field/notifier
        NewEventGroup127: event-group-id=128, event=SteeringWheelHeatingOption_Field/notifier
        NewEventGroup128: event-group-id=129, event=SteeringWheelHeatingState_Field/notifier
        NewEventGroup129: event-group-id=130, event=SteeringWheelheatingCommand_Field/notifier
        NewEventGroup13: event-group-id=14, event=BatterySOCValue_Field/notifier
        NewEventGroup130: event-group-id=131, event=SteeringWheelheatingStep_Field/notifier
        NewEventGroup131: event-group-id=132, event=SunRoofOptionType_Field/notifier
        NewEventGroup132: event-group-id=133, event=SunRoofState_Field/notifier
        NewEventGroup133: event-group-id=134, event=TPMSPressUnitStatus_Field/notifier
        NewEventGroup134: event-group-id=135, event=TPMSThreadWarnLampStatus_Field/notifier
        NewEventGroup135: event-group-id=136, event=TPMSWarnLampStatus_Field/notifier
        NewEventGroup136: event-group-id=137, event=TPMS_FrLeftTirePressure_Field/notifier
        NewEventGroup137: event-group-id=138, event=TPMS_FrLeftWarnLampStatus_Field/notifier
        NewEventGroup138: event-group-id=139, event=TPMS_FrRightTirePressure_Field/notifier
        NewEventGroup139: event-group-id=140, event=TPMS_FrRightWanrLampStatus_Field/notifier
        NewEventGroup14: event-group-id=15, event=BatteryStateOfChargeState_Field/notifier
        NewEventGroup140: event-group-id=141, event=TPMS_RrLeftTirePressure_Field/notifier
        NewEventGroup141: event-group-id=142, event=TPMS_RrLeftWarnLampStatus_Field/notifier
        NewEventGroup142: event-group-id=143, event=TPMS_RrRightTirePressure_Field/notifier
        NewEventGroup143: event-group-id=144, event=TPMS_RrRightWanrLampStatus_Field/notifier
        NewEventGroup144: event-group-id=145, event=TailLampState_Field/notifier
        NewEventGroup145: event-group-id=146, event=TrdLeftSeatHeatVentIndCmd_Field/notifier
        NewEventGroup146: event-group-id=147, event=TrdRightSeatHeatVentIndCmd_Field/notifier
        NewEventGroup147: event-group-id=148, event=TrunkSwitchState_Field/notifier
        NewEventGroup148: event-group-id=149, event=TurnLampMode_Field/notifier
        NewEventGroup149: event-group-id=150, event=TurnSignalLampLeftActiveState_Field/notifier
        NewEventGroup15: event-group-id=16, event=BatteryStateOfChargeWarningValue_Field/notifier
        NewEventGroup150: event-group-id=151, event=TurnSignalLampRightActiveState_Field/notifier
        NewEventGroup151: event-group-id=152, event=WarnAsstSeatbeltSwitchStatus_Field/notifier
        NewEventGroup152: event-group-id=153, event=WarnDriverSeatStaus_Field/notifier
        NewEventGroup153: event-group-id=154, event=WarnDriverSeatbeltSwitchStatus_Field/notifier
        NewEventGroup154: event-group-id=155, event=WarnPassengerSeatStatus_Field/notifier
        NewEventGroup155: event-group-id=156, event=WasherFluidSwitchState_Field/notifier
        NewEventGroup156: event-group-id=157, event=DrvSeatIntgFeedback_Field/notifier
        NewEventGroup157: event-group-id=158, event=AstSeatIntgFeedback_Field/notifier
        NewEventGroup158: event-group-id=159, event=PwrWdwSwEnable_Field/notifier
        NewEventGroup159: event-group-id=160, event=DrvDrReleaseInsideSwEnable_Field/notifier
        NewEventGroup16: event-group-id=17, event=BatteryTemperature_Field/notifier
        NewEventGroup160: event-group-id=161, event=AstDrReleaseInsideSwEnable_Field/notifier
        NewEventGroup161: event-group-id=162, event=RLDrReleaseInsideSwEnable_Field/notifier
        NewEventGroup162: event-group-id=163, event=RRDrReleaseInsideSwEnable_Field/notifier
        NewEventGroup163: event-group-id=164, event=PSDOptLHRH_Field/notifier
        NewEventGroup164: event-group-id=165, event=PSDInsideSwEnable_Field/notifier
        NewEventGroup165: event-group-id=166, event=PwrTransEnable_Field/notifier
        NewEventGroup166: event-group-id=167, event=PwrOnMaintain_Field/notifier
        NewEventGroup167: event-group-id=168, event=CtrDrLkUnLkSwEnable_Field/notifier
        NewEventGroup168: event-group-id=169, event=MoodLampDualColorOptSta_Field/notifier
        NewEventGroup169: event-group-id=170, event=ROAEnable_Field/notifier
        NewEventGroup17: event-group-id=18, event=BatteryVoltage_Field/notifier
        NewEventGroup170: event-group-id=171, event=PTGDrvSideSwEnable_Field/notifier
        NewEventGroup171: event-group-id=172, event=PTGInsideSwEnable_Field/notifier
        NewEventGroup172: event-group-id=173, event=CurrentValueForReset_Field/notifier
        NewEventGroup173: event-group-id=174, event=ReadyTimeValueForReset_Field/notifier
        NewEventGroup174: event-group-id=175, event=TimeValueForReset_Field/notifier
        NewEventGroup175: event-group-id=176, event=CurrAtReset_Field/notifier
        NewEventGroup176: event-group-id=177, event=AvgCurrAtReset_Field/notifier
        NewEventGroup177: event-group-id=178, event=ResetReason_Field/notifier
        NewEventGroup178: event-group-id=179, event=CumulativeCountOf12VReq_Field/notifier
        NewEventGroup179: event-group-id=180, event=CumulativeCountOfCCUReq_Field/notifier
        NewEventGroup18: event-group-id=19, event=BatteryWarningState_Field/notifier
        NewEventGroup180: event-group-id=181, event=ResetPreWrngForCCU_Field/notifier
        NewEventGroup181: event-group-id=182, event=ResetPreWrngForOthers_Field/notifier
        NewEventGroup182: event-group-id=183, event=ResetReqForCCU_Field/notifier
        NewEventGroup183: event-group-id=184, event=ResetReqForOthers_Field/notifier
        NewEventGroup184: event-group-id=185, event=ResetFuncOpt_Field/notifier
        NewEventGroup185: event-group-id=186, event=Rly12VCtrl_Field/notifier
        NewEventGroup186: event-group-id=187, event=Rly12VOffHoldingTime_Field/notifier
        NewEventGroup187: event-group-id=188, event=ResetCountSetting_Field/notifier
        NewEventGroup188: event-group-id=189, event=ResetCount_Field/notifier
        NewEventGroup189: event-group-id=190, event=ResetCumulativeCount_Field/notifier
        NewEventGroup19: event-group-id=20, event=BrakeFluidSwitchState_Field/notifier
        NewEventGroup190: event-group-id=191, event=ResetOpsta_Field/notifier
        NewEventGroup191: event-group-id=192, event=IGN3CutOffState_Field/notifier
        NewEventGroup192: event-group-id=193, event=RemoteKeyBtnReq_Field/notifier
        NewEventGroup193: event-group-id=194, event=DoorLockPsvDrLkReq_Field/notifier
        NewEventGroup194: event-group-id=195, event=MainLBMSocValue_Field/notifier
        NewEventGroup195: event-group-id=196, event=ACPrioState_Field/notifier
        NewEventGroup196: event-group-id=197, event=SMKTlPwrOnState_Field/notifier
        NewEventGroup197: event-group-id=198, event=CtrlDrLockRlyCCS_BDC_Field/notifier
        NewEventGroup198: event-group-id=199, event=RLDrLkUnLkInsdSwEnable_Get_Field/notifier
        NewEventGroup199: event-group-id=200, event=RRDrLkUnLkInsdSwEnable_Get_Field/notifier
        NewEventGroup2: event-group-id=3, event=AsstDoorSwitchState_SBCM_Field/notifier
        NewEventGroup20: event-group-id=21, event=CDMOpenState_Field/notifier
        NewEventGroup200: event-group-id=201, event=PTGM_TrnkTlgtOption_Field/notifier
        NewEventGroup201: event-group-id=202, event=PDC_MainLBMoption_Field/notifier
        NewEventGroup202: event-group-id=203, event=BPCM_Ast_IndCmd_Field/notifier
        NewEventGroup203: event-group-id=204, event=BPCM_Drv_IndCmd_Field/notifier
        NewEventGroup204: event-group-id=205, event=BPCM_RL_IndCmd_Field/notifier
        NewEventGroup205: event-group-id=206, event=BPCM_FrontOptTypInfo_Field/notifier
        NewEventGroup206: event-group-id=207, event=BPCM_RR_IndCmd_Field/notifier
        NewEventGroup207: event-group-id=208, event=BPCM_RearOptTypInfo_Field/notifier
        NewEventGroup208: event-group-id=209, event=BckGls_RrGlsHtdOpt_Field/notifier
        NewEventGroup209: event-group-id=210, event=BPCM_HeatGls_IndCmd_Field/notifier
        NewEventGroup21: event-group-id=22, event=CDMOptionType_Field/notifier
        NewEventGroup210: event-group-id=211, event=BPCM_HeatGlsOptTypInfo_Field/notifier
        NewEventGroup211: event-group-id=212, event=SACCargoFreezerWarningState_Field/notifier
        NewEventGroup212: event-group-id=213, event=SACCargoFreezerWarningValue_Field/notifier
        NewEventGroup213: event-group-id=214, event=TerminalControlGroupState_Field/notifier
        NewEventGroup214: event-group-id=215, event=HazardSwitchPushState_Field/notifier
        NewEventGroup215: event-group-id=216, event=W_ADMCmd_BC_Field/notifier
        NewEventGroup22: event-group-id=23, event=CDMOptionType_SBCM_Field/notifier
        NewEventGroup23: event-group-id=24, event=CDMWarningInfo_Field/notifier
        NewEventGroup24: event-group-id=25, event=CDMWarningInfo_SBCM_Field/notifier
        NewEventGroup25: event-group-id=26, event=CMDState_Field/notifier
        NewEventGroup26: event-group-id=27, event=CMSOptionInfo_Field/notifier
        NewEventGroup27: event-group-id=28, event=CargoFreezerConnectionStatus_Field/notifier
        NewEventGroup28: event-group-id=29, event=CargoFreezerCurrentTemp_Field/notifier
        NewEventGroup29: event-group-id=30, event=CargoFreezerSetTemp_Field/notifier
        NewEventGroup3: event-group-id=4, event=AsstDoorUnLockState_Field/notifier
        NewEventGroup30: event-group-id=31, event=CargoFreezerState_Field/notifier
        NewEventGroup31: event-group-id=32, event=CoachTypeOption_DRV_Field/notifier
        NewEventGroup32: event-group-id=33, event=DeliveryModeState_Field/notifier
        NewEventGroup33: event-group-id=34, event=DigitalKeyOptionInfo_Field/notifier
        NewEventGroup34: event-group-id=35, event=DirectTypeTPMSOptStatus_Field/notifier
        NewEventGroup35: event-group-id=36, event=DriveTypeOptionInfo_Field/notifier
        NewEventGroup36: event-group-id=37, event=DrvDoorSwitchState_Field/notifier
        NewEventGroup37: event-group-id=38, event=DrvDoorSwitchState_SBCM_Field/notifier
        NewEventGroup38: event-group-id=39, event=DrvDoorUnLockState_Field/notifier
        NewEventGroup39: event-group-id=40, event=DrvDoorUnLockState_SBCM_Field/notifier
        NewEventGroup4: event-group-id=5, event=AsstDoorUnLockState_SBCM_Field/notifier
        NewEventGroup40: event-group-id=41, event=DrvSeatHeatVentIndCmd_Field/notifier
        NewEventGroup41: event-group-id=42, event=DrvWindowOpenState_Field/notifier
        NewEventGroup42: event-group-id=43, event=DrvWindowOpenState_Detail_Field/notifier
        NewEventGroup43: event-group-id=44, event=DrvWindowState_Field/notifier
        NewEventGroup44: event-group-id=45, event=EngineRunningByRequest_Field/notifier
        NewEventGroup45: event-group-id=46, event=EuroNACPOption_Field/notifier
        NewEventGroup46: event-group-id=47, event=FLTurnSignalLampOpenState_Field/notifier
        NewEventGroup47: event-group-id=48, event=FOBBatteryDischarged_Field/notifier
        NewEventGroup48: event-group-id=49, event=FRTurnSignalLampOpenState_Field/notifier
        NewEventGroup49: event-group-id=50, event=FRTurnSignalLampSwitchState_Field/notifier
        NewEventGroup5: event-group-id=6, event=AsstWindowOpenState_Field/notifier
        NewEventGroup50: event-group-id=51, event=FrontHeatedGlassState_Field/notifier
        NewEventGroup51: event-group-id=52, event=FrontSunroofState_Field/notifier
        NewEventGroup52: event-group-id=53, event=GearPositionPState_Field/notifier
        NewEventGroup53: event-group-id=54, event=HazardSwitchState_Field/notifier
        NewEventGroup54: event-group-id=55, event=HighLampState_Field/notifier
        NewEventGroup55: event-group-id=56, event=HoodSwitchState_Field/notifier
        NewEventGroup56: event-group-id=57, event=HoodSwitchState_SBCM_Field/notifier
        NewEventGroup57: event-group-id=58, event=HoodTypeOptionInfo_Field/notifier
        NewEventGroup58: event-group-id=59, event=ICUDeliveryMode_Field/notifier
        NewEventGroup59: event-group-id=60, event=ICUupdateEnable_Field/notifier
        NewEventGroup6: event-group-id=7, event=AsstWindowOpenState_Detail_Field/notifier
        NewEventGroup60: event-group-id=61, event=LBMOptionInfo_Field/notifier
        NewEventGroup61: event-group-id=62, event=LHHighBeamLEDState_Field/notifier
        NewEventGroup62: event-group-id=63, event=LHHighLampOpenState_Field/notifier
        NewEventGroup63: event-group-id=64, event=LHLampBifuncOpenState_Field/notifier
        NewEventGroup64: event-group-id=65, event=LHLowBeamLEDState_Field/notifier
        NewEventGroup65: event-group-id=66, event=LHLowLampOpenState_Field/notifier
        NewEventGroup66: event-group-id=67, event=LHTurnSignalLampSwitchState_Field/notifier
        NewEventGroup67: event-group-id=68, event=LampLeftSwitchStatusIBU_Field/notifier
        NewEventGroup68: event-group-id=69, event=LatchTypeOptionInfo_Field/notifier
        NewEventGroup69: event-group-id=70, event=LedLampState_Field/notifier
        NewEventGroup7: event-group-id=8, event=AsstWindowState_Field/notifier
        NewEventGroup70: event-group-id=71, event=LeftTurnLampCmdState_Field/notifier
        NewEventGroup71: event-group-id=72, event=LftStopLampState_Field/notifier
        NewEventGroup72: event-group-id=73, event=LithiumBatteryWarningState_Field/notifier
        NewEventGroup73: event-group-id=74, event=LowLampState_Field/notifier
        NewEventGroup74: event-group-id=75, event=PDCexCurtainOptionInform_Field/notifier
        NewEventGroup75: event-group-id=76, event=PDCexTailgateUnlockedStatus_Field/notifier
        NewEventGroup76: event-group-id=77, event=PDSTypeOptionDRV_Field/notifier
        NewEventGroup77: event-group-id=78, event=PHEV_FuelDrCtrlFlagInfo_Field/notifier
        NewEventGroup78: event-group-id=79, event=PanicAlarmState_Field/notifier
        NewEventGroup79: event-group-id=80, event=ParkingPositionState_Field/notifier
        NewEventGroup8: event-group-id=9, event=AstSeatHeatVentIndCmd_Field/notifier
        NewEventGroup80: event-group-id=81, event=PlatformVersionDate_Field/notifier
        NewEventGroup81: event-group-id=82, event=PlatformVersionType_Field/notifier
        NewEventGroup82: event-group-id=83, event=PowerWindowSWType_Field/notifier
        NewEventGroup83: event-group-id=84, event=PrkngBrkSwState_Field/notifier
        NewEventGroup84: event-group-id=85, event=RDCTypeOption_Field/notifier
        NewEventGroup85: event-group-id=86, event=RHHighBeamLEDState_Field/notifier
        NewEventGroup86: event-group-id=87, event=RHHighLampOpenState_Field/notifier
        NewEventGroup87: event-group-id=88, event=RHLampBifuncOpenState_Field/notifier
        NewEventGroup88: event-group-id=89, event=RHLowBeamLEDState_Field/notifier
        NewEventGroup89: event-group-id=90, event=RHLowLampOpenState_Field/notifier
        NewEventGroup9: event-group-id=10, event=AutoExteriorLightState_Field/notifier
        NewEventGroup90: event-group-id=91, event=RLCurtainPosition_Field/notifier
        NewEventGroup91: event-group-id=92, event=RLDoorSwitchState_Field/notifier
        NewEventGroup92: event-group-id=93, event=RLDoorSwitchState_SBCM_Field/notifier
        NewEventGroup93: event-group-id=94, event=RLDoorUnLockState_SBCM_Field/notifier
        NewEventGroup94: event-group-id=95, event=RLDoorUnlockState_Field/notifier
        NewEventGroup95: event-group-id=96, event=RLRrDoorCurtainPosition_Field/notifier
        NewEventGroup96: event-group-id=97, event=RLTurnSignalLampOpenState_Field/notifier
        NewEventGroup97: event-group-id=98, event=RLWindowOpenState_Field/notifier
        NewEventGroup98: event-group-id=99, event=RLWindowOpenstate_Detail_Field/notifier
        NewEventGroup99: event-group-id=100, event=RLWindowState_Field/notifier
    Body2_Someip: service-interface=Body2, service-interface-id=3094, service-interface-version={major-version=1, minor-version=2}
      47 x someip field deployment:
        APSS_IMSSWOpt_Field: field=APSS_IMSSWOpt
          get getter: maximum-segment-length-request=0, maximum-segment-length-response=0, method-id=8238, transport-protocol=UDP
          notifier notifier: event-id=8238, maximum-segment-length=0, transport-protocol=UDP
        APSS_StRlxModeBtn_Field: field=APSS_StRlxModeBtn
          get getter: maximum-segment-length-request=0, maximum-segment-length-response=0, method-id=8235, transport-protocol=UDP
          notifier notifier: event-id=8235, maximum-segment-length=0, transport-protocol=UDP
        AsstSeatClimateOptionState_Field: field=AsstSeatClimateOptionState
          get getter: maximum-segment-length-request=0, maximum-segment-length-response=0, method-id=8193, transport-protocol=UDP
          notifier notifier: event-id=8193, maximum-segment-length=0, transport-protocol=UDP
        AsstSeatClimateState_Field: field=AsstSeatClimateState
          get getter: maximum-segment-length-request=0, maximum-segment-length-response=0, method-id=8194, transport-protocol=UDP
          notifier notifier: event-id=8194, maximum-segment-length=0, transport-protocol=UDP
        AstSeatAirSupportOpt_Field: field=AstSeatAirSupportOpt
          get getter: maximum-segment-length-request=0, maximum-segment-length-response=0, method-id=8231, transport-protocol=UDP
          notifier notifier: event-id=8231, maximum-segment-length=0, transport-protocol=UDP
        BLTNAuxBatConnectionState_Field: field=BLTNAuxBatConnectionState
          get getter: maximum-segment-length-request=0, maximum-segment-length-response=0, method-id=8208, transport-protocol=UDP
          notifier notifier: event-id=8208, maximum-segment-length=0, transport-protocol=UDP
        BLTNParkModeOperatableTime_Field: field=BLTNParkModeOperatableTime
          get getter: maximum-segment-length-request=0, maximum-segment-length-response=0, method-id=8195, transport-protocol=UDP
          notifier notifier: event-id=8195, maximum-segment-length=0, transport-protocol=UDP
        BLTNParkOperationTerminationInfo_Field: field=BLTNParkOperationTerminationInfo
          get getter: maximum-segment-length-request=0, maximum-segment-length-response=0, method-id=8196, transport-protocol=UDP
          notifier notifier: event-id=8196, maximum-segment-length=0, transport-protocol=UDP
        BLTNParkingOperableTime_Field: field=BLTNParkingOperableTime
          get getter: maximum-segment-length-request=0, maximum-segment-length-response=0, method-id=8209, transport-protocol=UDP
          notifier notifier: event-id=8209, maximum-segment-length=0, transport-protocol=UDP
        BLTNParkingSetTime_Field: field=BLTNParkingSetTime
          get getter: maximum-segment-length-request=0, maximum-segment-length-response=0, method-id=8210, transport-protocol=UDP
          notifier notifier: event-id=8210, maximum-segment-length=0, transport-protocol=UDP
        BLTNSDCardState_Field: field=BLTNSDCardState
          get getter: maximum-segment-length-request=0, maximum-segment-length-response=0, method-id=8211, transport-protocol=UDP
          notifier notifier: event-id=8211, maximum-segment-length=0, transport-protocol=UDP
        CntDriveEventRecord_Field: field=CntDriveEventRecord
          get getter: maximum-segment-length-request=0, maximum-segment-length-response=0, method-id=8228, transport-protocol=UDP
          notifier notifier: event-id=8228, maximum-segment-length=0, transport-protocol=UDP
        CountOfParkingEvent_Field: field=CountOfParkingEvent
          get getter: maximum-segment-length-request=0, maximum-segment-length-response=0, method-id=8197, transport-protocol=UDP
          notifier notifier: event-id=8197, maximum-segment-length=0, transport-protocol=UDP
        DPSS_StRlxModeBtn_Field: field=DPSS_StRlxModeBtn
          get getter: maximum-segment-length-request=0, maximum-segment-length-response=0, method-id=8234, transport-protocol=UDP
          notifier notifier: event-id=8234, maximum-segment-length=0, transport-protocol=UDP
        DRVSwvlTypOpt_Field: field=DRVSwvlTypOpt
          get getter: maximum-segment-length-request=0, maximum-segment-length-response=0, method-id=8229, transport-protocol=UDP
          notifier notifier: event-id=8229, maximum-segment-length=0, transport-protocol=UDP
        DrvSeatAirSupportOpt_Field: field=DrvSeatAirSupportOpt
          get getter: maximum-segment-length-request=0, maximum-segment-length-response=0, method-id=8230, transport-protocol=UDP
          notifier notifier: event-id=8230, maximum-segment-length=0, transport-protocol=UDP
        DrvSeatClimateOptionState_Field: field=DrvSeatClimateOptionState
          get getter: maximum-segment-length-request=0, maximum-segment-length-response=0, method-id=8198, transport-protocol=UDP
          notifier notifier: event-id=8198, maximum-segment-length=0, transport-protocol=UDP
        DrvSeatClimateState_Field: field=DrvSeatClimateState
          get getter: maximum-segment-length-request=0, maximum-segment-length-response=0, method-id=8199, transport-protocol=UDP
          notifier notifier: event-id=8199, maximum-segment-length=0, transport-protocol=UDP
        FrArmrestHeatedType_Field: field=FrArmrestHeatedType
          get getter: maximum-segment-length-request=0, maximum-segment-length-response=0, method-id=8225, transport-protocol=UDP
          notifier notifier: event-id=8225, maximum-segment-length=0, transport-protocol=UDP
        FrAstArmrestHeatedLevel_Field: field=FrAstArmrestHeatedLevel
          get getter: maximum-segment-length-request=0, maximum-segment-length-response=0, method-id=8218, transport-protocol=UDP
          notifier notifier: event-id=8218, maximum-segment-length=0, transport-protocol=UDP
        FrDrvArmrestHeatedLevel_Field: field=FrDrvArmrestHeatedLevel
          get getter: maximum-segment-length-request=0, maximum-segment-length-response=0, method-id=8217, transport-protocol=UDP
          notifier notifier: event-id=8217, maximum-segment-length=0, transport-protocol=UDP
        IMSType_Field: field=IMSType
          get getter: maximum-segment-length-request=0, maximum-segment-length-response=0, method-id=8200, transport-protocol=UDP
          notifier notifier: event-id=8200, maximum-segment-length=0, transport-protocol=UDP
        PSSRLStRlxModeBtn_Field: field=PSSRLStRlxModeBtn
          get getter: maximum-segment-length-request=0, maximum-segment-length-response=0, method-id=8236, transport-protocol=UDP
          notifier notifier: event-id=8236, maximum-segment-length=0, transport-protocol=UDP
        PSSRRStRlxModeBtn_Field: field=PSSRRStRlxModeBtn
          get getter: maximum-segment-length-request=0, maximum-segment-length-response=0, method-id=8237, transport-protocol=UDP
          notifier notifier: event-id=8237, maximum-segment-length=0, transport-protocol=UDP
        PSS_RL_IMSSWOpt_Field: field=PSS_RL_IMSSWOpt
          get getter: maximum-segment-length-request=0, maximum-segment-length-response=0, method-id=8239, transport-protocol=UDP
          notifier notifier: event-id=8239, maximum-segment-length=0, transport-protocol=UDP
        PSS_RR_IMSSWOpt_Field: field=PSS_RR_IMSSWOpt
          get getter: maximum-segment-length-request=0, maximum-segment-length-response=0, method-id=8240, transport-protocol=UDP
          notifier notifier: event-id=8240, maximum-segment-length=0, transport-protocol=UDP
        ParkEventRecordedState_Field: field=ParkEventRecordedState
          get getter: maximum-segment-length-request=0, maximum-segment-length-response=0, method-id=8201, transport-protocol=UDP
          notifier notifier: event-id=8201, maximum-segment-length=0, transport-protocol=UDP
        RCMOptionType_Field: field=RCMOptionType
          get getter: maximum-segment-length-request=0, maximum-segment-length-response=0, method-id=8213, transport-protocol=UDP
          notifier notifier: event-id=8213, maximum-segment-length=0, transport-protocol=UDP
        RLSeatAirSupportOpt_Field: field=RLSeatAirSupportOpt
          get getter: maximum-segment-length-request=0, maximum-segment-length-response=0, method-id=8232, transport-protocol=UDP
          notifier notifier: event-id=8232, maximum-segment-length=0, transport-protocol=UDP
        RLSeatClimateOptionState_Field: field=RLSeatClimateOptionState
          get getter: maximum-segment-length-request=0, maximum-segment-length-response=0, method-id=8203, transport-protocol=UDP
          notifier notifier: event-id=8203, maximum-segment-length=0, transport-protocol=UDP
        RLSeatClimateState_Field: field=RLSeatClimateState
          get getter: maximum-segment-length-request=0, maximum-segment-length-response=0, method-id=8204, transport-protocol=UDP
          notifier notifier: event-id=8204, maximum-segment-length=0, transport-protocol=UDP
        RRSeatAirSupportOpt_Field: field=RRSeatAirSupportOpt
          get getter: maximum-segment-length-request=0, maximum-segment-length-response=0, method-id=8233, transport-protocol=UDP
          notifier notifier: event-id=8233, maximum-segment-length=0, transport-protocol=UDP
        RRSeatClimateOptionState_Field: field=RRSeatClimateOptionState
          get getter: maximum-segment-length-request=0, maximum-segment-length-response=0, method-id=8205, transport-protocol=UDP
          notifier notifier: event-id=8205, maximum-segment-length=0, transport-protocol=UDP
        RRSeatClimateState_Field: field=RRSeatClimateState
          get getter: maximum-segment-length-request=0, maximum-segment-length-response=0, method-id=8206, transport-protocol=UDP
          notifier notifier: event-id=8206, maximum-segment-length=0, transport-protocol=UDP
        RRSunRoofState_Field: field=RRSunRoofState
          get getter: maximum-segment-length-request=0, maximum-segment-length-response=0, method-id=8215, transport-protocol=UDP
          notifier notifier: event-id=8215, maximum-segment-length=0, transport-protocol=UDP
        RrArmrestHeatedType_Field: field=RrArmrestHeatedType
          get getter: maximum-segment-length-request=0, maximum-segment-length-response=0, method-id=8226, transport-protocol=UDP
          notifier notifier: event-id=8226, maximum-segment-length=0, transport-protocol=UDP
        RrLhArmrestHeatedLevel_Field: field=RrLhArmrestHeatedLevel
          get getter: maximum-segment-length-request=0, maximum-segment-length-response=0, method-id=8219, transport-protocol=UDP
          notifier notifier: event-id=8219, maximum-segment-length=0, transport-protocol=UDP
        RrRhArmrestHeatedLevel_Field: field=RrRhArmrestHeatedLevel
          get getter: maximum-segment-length-request=0, maximum-segment-length-response=0, method-id=8220, transport-protocol=UDP
          notifier notifier: event-id=8220, maximum-segment-length=0, transport-protocol=UDP
        SGU_RoofZoneOptTyp_Field: field=SGU_RoofZoneOptTyp
          get getter: maximum-segment-length-request=0, maximum-segment-length-response=0, method-id=8242, transport-protocol=UDP
          notifier notifier: event-id=8242, maximum-segment-length=0, transport-protocol=UDP
        SGU_ZoneAllSta_Field: field=SGU_ZoneAllSta
          get getter: maximum-segment-length-request=0, maximum-segment-length-response=0, method-id=8241, transport-protocol=UDP
          notifier notifier: event-id=8241, maximum-segment-length=0, transport-protocol=UDP
        ShockCount_Field: field=ShockCount
          get getter: maximum-segment-length-request=0, maximum-segment-length-response=0, method-id=8207, transport-protocol=UDP
          notifier notifier: event-id=8207, maximum-segment-length=0, transport-protocol=UDP
        SigDriveEventRecorded_Field: field=SigDriveEventRecorded
          get getter: maximum-segment-length-request=0, maximum-segment-length-response=0, method-id=8227, transport-protocol=UDP
          notifier notifier: event-id=8227, maximum-segment-length=0, transport-protocol=UDP
        SunRoofState_Field: field=Body2/SunRoofState
          get getter: maximum-segment-length-request=0, maximum-segment-length-response=0, method-id=8216, transport-protocol=UDP
          notifier notifier: event-id=8216, maximum-segment-length=0, transport-protocol=UDP
        TrdLhSeatHeatOperationState_Field: field=TrdLhSeatHeatOperationState
          get getter: maximum-segment-length-request=0, maximum-segment-length-response=0, method-id=8221, transport-protocol=UDP
          notifier notifier: event-id=8221, maximum-segment-length=0, transport-protocol=UDP
        TrdLhSeatOperationState_Field: field=TrdLhSeatOperationState
          get getter: maximum-segment-length-request=0, maximum-segment-length-response=0, method-id=8223, transport-protocol=UDP
          notifier notifier: event-id=8223, maximum-segment-length=0, transport-protocol=UDP
        TrdRhSeatHeatOperationState_Field: field=TrdRhSeatHeatOperationState
          get getter: maximum-segment-length-request=0, maximum-segment-length-response=0, method-id=8222, transport-protocol=UDP
          notifier notifier: event-id=8222, maximum-segment-length=0, transport-protocol=UDP
        TrdRhSeatOperationState_Field: field=TrdRhSeatOperationState
          get getter: maximum-segment-length-request=0, maximum-segment-length-response=0, method-id=8224, transport-protocol=UDP
          notifier notifier: event-id=8224, maximum-segment-length=0, transport-protocol=UDP
      47 x someip event group:
        NewEventGroup: event-group-id=1, event=AsstSeatClimateOptionState_Field/notifier
        NewEventGroup1: event-group-id=2, event=AsstSeatClimateState_Field/notifier
        NewEventGroup10: event-group-id=11, event=DrvSeatClimateOptionState_Field/notifier
        NewEventGroup11: event-group-id=12, event=DrvSeatClimateState_Field/notifier
        NewEventGroup12: event-group-id=13, event=FrArmrestHeatedType_Field/notifier
        NewEventGroup13: event-group-id=14, event=FrAstArmrestHeatedLevel_Field/notifier
        NewEventGroup14: event-group-id=15, event=FrDrvArmrestHeatedLevel_Field/notifier
        NewEventGroup15: event-group-id=16, event=IMSType_Field/notifier
        NewEventGroup16: event-group-id=17, event=ParkEventRecordedState_Field/notifier
        NewEventGroup17: event-group-id=18, event=RCMOptionType_Field/notifier
        NewEventGroup18: event-group-id=19, event=RLSeatClimateOptionState_Field/notifier
        NewEventGroup19: event-group-id=20, event=RLSeatClimateState_Field/notifier
        NewEventGroup2: event-group-id=3, event=BLTNAuxBatConnectionState_Field/notifier
        NewEventGroup20: event-group-id=21, event=RRSeatClimateOptionState_Field/notifier
        NewEventGroup21: event-group-id=22, event=RRSeatClimateState_Field/notifier
        NewEventGroup22: event-group-id=23, event=RRSunRoofState_Field/notifier
        NewEventGroup23: event-group-id=24, event=RrArmrestHeatedType_Field/notifier
        NewEventGroup24: event-group-id=25, event=RrLhArmrestHeatedLevel_Field/notifier
        NewEventGroup25: event-group-id=26, event=RrRhArmrestHeatedLevel_Field/notifier
        NewEventGroup26: event-group-id=27, event=ShockCount_Field/notifier
        NewEventGroup27: event-group-id=28, event=SigDriveEventRecorded_Field/notifier
        NewEventGroup28: event-group-id=29, event=SunRoofState_Field/notifier
        NewEventGroup29: event-group-id=30, event=TrdLhSeatHeatOperationState_Field/notifier
        NewEventGroup3: event-group-id=4, event=BLTNParkModeOperatableTime_Field/notifier
        NewEventGroup30: event-group-id=31, event=TrdLhSeatOperationState_Field/notifier
        NewEventGroup31: event-group-id=32, event=TrdRhSeatHeatOperationState_Field/notifier
        NewEventGroup32: event-group-id=33, event=TrdRhSeatOperationState_Field/notifier
        NewEventGroup33: event-group-id=34, event=DRVSwvlTypOpt_Field/notifier
        NewEventGroup34: event-group-id=35, event=DrvSeatAirSupportOpt_Field/notifier
        NewEventGroup35: event-group-id=36, event=AstSeatAirSupportOpt_Field/notifier
        NewEventGroup36: event-group-id=37, event=RLSeatAirSupportOpt_Field/notifier
        NewEventGroup37: event-group-id=38, event=RRSeatAirSupportOpt_Field/notifier
        NewEventGroup38: event-group-id=39, event=DPSS_StRlxModeBtn_Field/notifier
        NewEventGroup39: event-group-id=40, event=APSS_StRlxModeBtn_Field/notifier
        NewEventGroup4: event-group-id=5, event=BLTNParkOperationTerminationInfo_Field/notifier
        NewEventGroup40: event-group-id=41, event=PSSRLStRlxModeBtn_Field/notifier
        NewEventGroup41: event-group-id=42, event=PSSRRStRlxModeBtn_Field/notifier
        NewEventGroup42: event-group-id=43, event=APSS_IMSSWOpt_Field/notifier
        NewEventGroup43: event-group-id=44, event=PSS_RL_IMSSWOpt_Field/notifier
        NewEventGroup44: event-group-id=45, event=PSS_RR_IMSSWOpt_Field/notifier
        NewEventGroup45: event-group-id=46, event=SGU_ZoneAllSta_Field/notifier
        NewEventGroup46: event-group-id=47, event=SGU_RoofZoneOptTyp_Field/notifier
        NewEventGroup5: event-group-id=6, event=BLTNParkingOperableTime_Field/notifier
        NewEventGroup6: event-group-id=7, event=BLTNParkingSetTime_Field/notifier
        NewEventGroup7: event-group-id=8, event=BLTNSDCardState_Field/notifier
        NewEventGroup8: event-group-id=9, event=CntDriveEventRecord_Field/notifier
        NewEventGroup9: event-group-id=10, event=CountOfParkingEvent_Field/notifier
    BootModeManager_Someip: service-interface=BootModeManager, service-interface-id=3140, service-interface-version={major-version=1, minor-version=1}
      someip field deployment APBootModeInfo_Field: field=APBootModeInfo
        get getter: maximum-segment-length-request=0, maximum-segment-length-response=0, method-id=8193, transport-protocol=UDP
        notifier notifier: event-id=8193, maximum-segment-length=0, transport-protocol=UDP
        set setter: maximum-segment-length-request=0, maximum-segment-length-response=0, method-id=12289, transport-protocol=UDP
      someip event group NewEventGroup: event-group-id=1, event=APBootModeInfo_Field/notifier
    BootSyncManager_Someip: service-interface=BootSyncManager, service-interface-id=3139, service-interface-version={major-version=1, minor-version=0}
      someip field deployment BootPartitionInfo_Field: field=BootPartitionInfo
        get getter: maximum-segment-length-request=0, maximum-segment-length-response=0, method-id=8195, transport-protocol=UDP
        notifier notifier: event-id=8195, maximum-segment-length=0, transport-protocol=UDP
      someip field deployment SyncBlockStatusInfo_Field: field=SyncBlockStatusInfo
        get getter: maximum-segment-length-request=0, maximum-segment-length-response=0, method-id=8194, transport-protocol=UDP
        notifier notifier: event-id=8194, maximum-segment-length=0, transport-protocol=UDP
      someip field deployment SyncStatusInfo_Field: field=SyncStatusInfo
        get getter: maximum-segment-length-request=0, maximum-segment-length-response=0, method-id=8193, transport-protocol=UDP
        notifier notifier: event-id=8193, maximum-segment-length=0, transport-protocol=UDP
      6 x someip method deployment, all with maximum-segment-length-request=0, transport-protocol=UDP:
        GetIVDHash_Method: method=GetIVDHash, maximum-segment-length-response=0, method-id=4097
        RequestSyncStatusUpdate_Method: method=RequestSyncStatusUpdate, method-id=4102
        RequestSync_Method: method=RequestSync, maximum-segment-length-response=0, method-id=4098
        SetSyncBlock_Method: method=SetSyncBlock, maximum-segment-length-response=0, method-id=4099
        SetSyncStatus_Method: method=SetSyncStatus, maximum-segment-length-response=0, method-id=4103
        SwapBootPartition_Method: method=SwapBootPartition, maximum-segment-length-response=0, method-id=4101
      someip event group NewEventGroup: event-group-id=1, event=BootPartitionInfo_Field/notifier
      someip event group NewEventGroup1: event-group-id=2, event=SyncBlockStatusInfo_Field/notifier
      someip event group NewEventGroup2: event-group-id=3, event=SyncStatusInfo_Field/notifier
    CANoverIP_Someip: service-interface=CANoverIP, service-interface-id=3095, service-interface-version={major-version=2, minor-version=3}
      162 x someip method deployment, all with maximum-segment-length-request=0, maximum-segment-length-response=0, transport-protocol=UDP:
        ActivateCharging_Method: method=ActivateCharging, method-id=4097
        AirCleaningControl_Method: method=AirCleaningControl, method-id=4098
        AirconditioningControl_Method: method=AirconditioningControl, method-id=4099
        AsstSeatClimateControl_Method: method=AsstSeatClimateControl, method-id=4100
        AsstWindowControl_Method: method=AsstWindowControl, method-id=4101
        AstDrReleaseInsideSwEnable_Set_Method: method=AstDrReleaseInsideSwEnable_Set, method-id=4244
        AstHeatingCoolingMode_Set_Method: method=AstHeatingCoolingMode_Set, method-id=4267
        AstIntgSwivelPos_Set_Method: method=AstIntgSwivelPos_Set, method-id=4241
        AstMassageIntgMode_Set_Method: method=AstMassageIntgMode_Set, method-id=4254
        AstPwrSeatIntgMode_Set_Method: method=AstPwrSeatIntgMode_Set, method-id=4263
        CCU_CCS_AlvCnt7Val_Method: method=CCU_CCS_AlvCnt7Val, method-id=4230
        CCU_CCS_AlvCnt8Val_Method: method=CCU_CCS_AlvCnt8Val, method-id=4235
        CCU_CCS_AlvCnt_Method: method=CCU_CCS_AlvCnt, method-id=4224
        CCU_CCS_Crc7Val_Method: method=CCU_CCS_Crc7Val, method-id=4229
        CCU_CCS_Crc8Val_Method: method=CCU_CCS_Crc8Val, method-id=4234
        CCU_CCS_Crc_Method: method=CCU_CCS_Crc, method-id=4223
        CancelAirconditioning_Method: method=CancelAirconditioning, method-id=4102
        CancelCharging_Method: method=CancelCharging, method-id=4103
        CargoControlMasterSet_Method: method=CargoControlMasterSet, method-id=4202
        CargoTrgetTempSet_Method: method=CargoTrgetTempSet, method-id=4203
        CertCodeRmtCtrl1_Method: method=CertCodeRmtCtrl1, method-id=4227
        CertCodeRmtCtrl2_Method: method=CertCodeRmtCtrl2, method-id=4228
        ContractCertActiveChangeRequest_Method: method=ContractCertActiveChangeRequest, method-id=4208
        ContractCertChangeStateDeliveryResult_Method: method=ContractCertChangeStateDeliveryResult, method-id=4209
        ContractCertDeleteRequest_Method: method=ContractCertDeleteRequest, method-id=4207
        CtrDrLkUnLkSwEnable_Set_Method: method=CtrDrLkUnLkSwEnable_Set, method-id=4251
        DigitalKeyInformAvailable_Method: method=DigitalKeyInformAvailable, method-id=4194
        DrvDrReleaseInsideSwEnable_Set_Method: method=DrvDrReleaseInsideSwEnable_Set, method-id=4243
        DrvHeatingCoolingMode_Set_Method: method=DrvHeatingCoolingMode_Set, method-id=4266
        DrvIntgSwivelPos_Set_Method: method=DrvIntgSwivelPos_Set, method-id=4240
        DrvMassageIntgMode_Set_Method: method=DrvMassageIntgMode_Set, method-id=4253
        DrvPwrSeatIntgMode_Set_Method: method=DrvPwrSeatIntgMode_Set, method-id=4262
        DrvSeatClimateControl_Method: method=DrvSeatClimateControl, method-id=4104
        DrvWindowControl_Method: method=DrvWindowControl, method-id=4105
        EncOptRmtStart_Method: method=EncOptRmtStart, method-id=4222
        EndMINofScheduledTime_Method: method=EndMINofScheduledTime, method-id=4186
        FODmode_Method: method=FODmode, method-id=4205
        FrunkControl_Method: method=FrunkControl, method-id=4185
        HazardLampControl_Method: method=HazardLampControl, method-id=4106
        IGN3Control_Method: method=IGN3Control, method-id=4107
        Intake_Set_Method: method=Intake_Set, method-id=4289
        MapChangeInformAvailable_Method: method=MapChangeInformAvailable, method-id=4195
        NotifyCharingModeWithIG3Condition_Method: method=NotifyCharingModeWithIG3Condition, method-id=4108
        NotifyFailConfirmedToVCU_Method: method=NotifyFailConfirmedToVCU, method-id=4109
        NotifyIG3RelayMode_Method: method=NotifyIG3RelayMode, method-id=4110
        OTADownloadProgress_Method: method=OTADownloadProgress, method-id=4111
        OTAReqPowerState_Method: method=OTAReqPowerState, method-id=4292
        OTAResult_Method: method=OTAResult, method-id=4198
        OTAUIReadyRequest_Method: method=OTAUIReadyRequest, method-id=4197
        OTA_ConditionRequest_Method: method=OTA_ConditionRequest, method-id=4183
        PSDInsideSwEnable_Set_Method: method=PSDInsideSwEnable_Set, method-id=4247
        PTGInsideSwEnable_Set_Method: method=PTGInsideSwEnable_Set, method-id=4291
        PetCareFinish_Method: method=PetCareFinish, method-id=4239
        PetCareOnOffRequest_Method: method=PetCareOnOffRequest, method-id=4231
        PetCareOptInfo_Method: method=PetCareOptInfo, method-id=4236
        PetCareResponse_Method: method=PetCareResponse, method-id=4237
        PetCareStatus_Method: method=PetCareStatus, method-id=4238
        PetCareTempSet_Method: method=PetCareTempSet, method-id=4233
        PetCareTempUnitSet_Method: method=PetCareTempUnitSet, method-id=4232
        PwrOnMaintain_Set_Method: method=PwrOnMaintain_Set, method-id=4249
        PwrTransEnable_Set_Method: method=PwrTransEnable_Set, method-id=4248
        PwrWdwSwEnable_Set_Method: method=PwrWdwSwEnable_Set, method-id=4242
        QtrLCurtainRequest_Method: method=QtrLCurtainRequest, method-id=4218
        QtrRCurtainRequest_Method: method=QtrRCurtainRequest, method-id=4219
        RLCurtainRequest_Method: method=RLCurtainRequest, method-id=4216
        RLDrLkUnLkInsdSwEnable_Set_Method: method=RLDrLkUnLkInsdSwEnable_Set, method-id=4294
        RLDrReleaseInsideSwEnable_Set_Method: method=RLDrReleaseInsideSwEnable_Set, method-id=4245
        RLHeatingCoolingMode_Set_Method: method=RLHeatingCoolingMode_Set, method-id=4268
        RLMassageIntgMode_Set_Method: method=RLMassageIntgMode_Set, method-id=4255
        RLPwrSeatIntgMode_Set_Method: method=RLPwrSeatIntgMode_Set, method-id=4264
        RLQtrShadePos_Set_Method: method=RLQtrShadePos_Set, method-id=4257
        RLRrDrShadePos_Set_Method: method=RLRrDrShadePos_Set, method-id=4260
        RLSeatClimateControl_Method: method=RLSeatClimateControl, method-id=4118
        RLWindowControl_Method: method=RLWindowControl, method-id=4119
        ROAAlarmControl_Method: method=ROAAlarmControl, method-id=4120
        ROAEnable_Set_Method: method=ROAEnable_Set, method-id=4259
        RRCurtainRequest_Method: method=RRCurtainRequest, method-id=4217
        RRDrLkUnLkInsdSwEnable_Set_Method: method=RRDrLkUnLkInsdSwEnable_Set, method-id=4295
        RRDrReleaseInsideSwEnable_Set_Method: method=RRDrReleaseInsideSwEnable_Set, method-id=4246
        RRHeatingCoolingMode_Set_Method: method=RRHeatingCoolingMode_Set, method-id=4269
        RRMassageIntgMode_Set_Method: method=RRMassageIntgMode_Set, method-id=4256
        RRPwrSeatIntgMode_Set_Method: method=RRPwrSeatIntgMode_Set, method-id=4265
        RRQtrShadePos_Set_Method: method=RRQtrShadePos_Set, method-id=4258
        RRRrDrShadePos_Set_Method: method=RRRrDrShadePos_Set, method-id=4261
        RRSeatClimateControl_Method: method=RRSeatClimateControl, method-id=4121
        RRWindowControl_Method: method=RRWindowControl, method-id=4122
        RSD_ACK01_Group_Method: method=RSD_ACK01_Group, method-id=4315
        RequestCDMOpen_Method: method=RequestCDMOpen, method-id=4112
        RequestExtLamp_toHU_Method: method=RequestExtLamp_toHU, method-id=4113
        RequestGearP_toHU_Method: method=RequestGearP_toHU, method-id=4114
        RequestHoodClosed_toHU_Method: method=RequestHoodClosed_toHU, method-id=4115
        RequestParkingBrk_toHU_Method: method=RequestParkingBrk_toHU, method-id=4116
        RequestUmtBcanWakeUp_Method: method=RequestUmtBcanWakeUp, method-id=4317
        RequestUmtHazardLamp_Method: method=RequestUmtHazardLamp, method-id=4319
        RequestVehiclePwr_toHU_Method: method=RequestVehiclePwr_toHU, method-id=4117
        Request_ControlBattCondition_Method: method=Request_ControlBattCondition, method-id=4193
        ReuqestUmtVehicleStart_Method: method=ReuqestUmtVehicleStart, method-id=4318
        RmtStartEncReq_Group_Method: method=RmtStartEncReq_Group, method-id=4293
        RmtStartEncRequest_Method: method=RmtStartEncRequest, method-id=4226
        RndNumRmtCtrlRequest_Method: method=RndNumRmtCtrlRequest, method-id=4225
        RrShadePos_Set_Method: method=RrShadePos_Set, method-id=4250
        SUM_RESP01_Group_Method: method=SUM_RESP01_Group, method-id=4316
        SeatClimateControl_Group_Method: method=SeatClimateControl_Group, method-id=4178
        SetCargoWaringValue_Method: method=SetCargoWaringValue, method-id=4206
        SetChargingData_Method: method=SetChargingData, method-id=4147
        SetChargingMode_Method: method=SetChargingMode, method-id=4148
        SetContractChangeReq_Group_Method: method=SetContractChangeReq_Group, method-id=4310
        SetDefoggerHeating_Method: method=SetDefoggerHeating, method-id=4149
        SetDefoggerState_Method: method=SetDefoggerState, method-id=4150
        SetDoorLock_Method: method=SetDoorLock, method-id=4151
        SetDoorUnlock_Method: method=SetDoorUnlock, method-id=4152
        SetEMAID1_Method: method=SetEMAID1, method-id=4220
        SetEMAID2_Method: method=SetEMAID2, method-id=4221
        SetEasyAccessProfileIDforCCU_Method: method=SetEasyAccessProfileIDforCCU, method-id=4157
        SetFrontHeating_Method: method=SetFrontHeating, method-id=4158
        SetHazardLamp_Method: method=SetHazardLamp, method-id=4159
        SetHeating_Group_Method: method=SetHeating_Group, method-id=4180
        SetOTAEOU_Method: method=SetOTAEOU, method-id=4196
        SetOTAIG3OnReq_Method: method=SetOTAIG3OnReq, method-id=4160
        SetOTAMode_Method: method=SetOTAMode, method-id=4161
        SetOTAUpdateEnableCondition_Group_Method: method=SetOTAUpdateEnableCondition_Group, method-id=4181
        SetPanic_Method: method=SetPanic, method-id=4163
        SetPetModeFodOpt_Method: method=SetPetModeFodOpt, method-id=4309
        SetPetcareDoorState_Method: method=SetPetcareDoorState, method-id=4308
        SetPreCrank_Method: method=SetPreCrank, method-id=4164
        SetRemoteCranking_Method: method=SetRemoteCranking, method-id=4165
        SetRsdACKtype_Method: method=SetRsdACKtype, method-id=4211
        SetRsdACKzero_Method: method=SetRsdACKzero, method-id=4210
        SetSteeringWheelHeating_Method: method=SetSteeringWheelHeating, method-id=4168
        SetSteeringWheelHeatingbyStep_Method: method=SetSteeringWheelHeatingbyStep, method-id=4169
        SetSummaryResponsePayloadSegment1_1_Method: method=SetSummaryResponsePayloadSegment1_1, method-id=4212
        SetSummaryResponsePayloadSegment1_2_Method: method=SetSummaryResponsePayloadSegment1_2, method-id=4213
        SetSummaryResponsePayloadSegment1_3_Method: method=SetSummaryResponsePayloadSegment1_3, method-id=4214
        SetSummaryResponsePayloadSegment1_4_Method: method=SetSummaryResponsePayloadSegment1_4, method-id=4215
        SetTemperatureType_Method: method=SetTemperatureType, method-id=4170
        SetTemperatureValue_Method: method=SetTemperatureValue, method-id=4171
        SetVAPIAlarm01_Group_Method: method=SetVAPIAlarm01_Group, method-id=4301
        SetVAPIBCKGLSHTD01_Group_Method: method=SetVAPIBCKGLSHTD01_Group, method-id=4314
        SetVAPIBPCM01_Group_Method: method=SetVAPIBPCM01_Group, method-id=4311
        SetVAPIDoor01_Group_Method: method=SetVAPIDoor01_Group, method-id=4302
        SetVAPIHVAC01_Group_Method: method=SetVAPIHVAC01_Group, method-id=4296
        SetVAPIHVAC02_Group_Method: method=SetVAPIHVAC02_Group, method-id=4297
        SetVAPIHVAC03_Group_Method: method=SetVAPIHVAC03_Group, method-id=4298
        SetVAPIHVAC06_Group_Method: method=SetVAPIHVAC06_Group, method-id=4299
        SetVAPIHVAC07_Group_Method: method=SetVAPIHVAC07_Group, method-id=4300
        SetVAPILight01_Group_Method: method=SetVAPILight01_Group, method-id=4303
        SetVAPISGU01_Group_Method: method=SetVAPISGU01_Group, method-id=4312
        SetVAPISeat01_Group_Method: method=SetVAPISeat01_Group, method-id=4304
        SetVAPIShade01_Group_Method: method=SetVAPIShade01_Group, method-id=4305
        SetVAPIStart01_Group_Method: method=SetVAPIStart01_Group, method-id=4306
        SetVAPIStrWarmer01_Group_Method: method=SetVAPIStrWarmer01_Group, method-id=4313
        SetVAPITailgate01_Group_Method: method=SetVAPITailgate01_Group, method-id=4307
        SetVINforFoD_Group_Method: method=SetVINforFoD_Group, method-id=4199
        SetVehicleState_Method: method=SetVehicleState, method-id=4172
        Set_DriverProfileID_Method: method=Set_DriverProfileID, method-id=4184
        TailLampControl_Method: method=TailLampControl, method-id=4175
        VehicleCrankingRequest_Method: method=VehicleCrankingRequest, method-id=4182
        WindowControlQtrCurtain_Group_Method: method=WindowControlQtrCurtain_Group, method-id=4321
        WindowControlRearCurtain_Group_Method: method=WindowControlRearCurtain_Group, method-id=4320
        WindowControl_Group_Method: method=WindowControl_Group, method-id=4179
        WindowFrontControl_Group_Method: method=WindowFrontControl_Group, method-id=4322
        compressorControlRequire_Method: method=compressorControlRequire, method-id=4204
    CIDSDiagInfo_Someip: service-interface=CIDSDiagInfo, service-interface-id=3076, service-interface-version={major-version=1, minor-version=0}
      8 x someip method deployment, all with transport-protocol=UDP:
        GetAppInfo_Method: method=CIDSDiagInfo/GetAppInfo, maximum-segment-length-response=0, method-id=4097
        GetAppState_Method: method=CIDSDiagInfo/GetAppState, maximum-segment-length-response=0, method-id=4098
        RemoveBusOffLog_Method: method=RemoveBusOffLog, maximum-segment-length-response=0, method-id=4105
        RemoveTimeOutLog_Method: method=RemoveTimeOutLog, maximum-segment-length-response=0, method-id=4104
        RequestAlertLog_Method: method=RequestAlertLog, maximum-segment-length-request=0, maximum-segment-length-response=0, method-id=4101
        RequestBusOffLog_Method: method=RequestBusOffLog, maximum-segment-length-request=0, maximum-segment-length-response=0, method-id=4103
        RequestTimeOutLog_Method: method=RequestTimeOutLog, maximum-segment-length-request=0, maximum-segment-length-response=0, method-id=4102
        SetAppState_Method: method=SetAppState, maximum-segment-length-request=0, method-id=4100
    CIDSInfo_Someip: service-interface=CIDSInfo, service-interface-id=3077, service-interface-version={major-version=1, minor-version=0}
      someip field deployment CidsAppInfo_Field: field=CidsAppInfo
        get getter: maximum-segment-length-request=0, maximum-segment-length-response=0, method-id=8193, transport-protocol=UDP
        notifier notifier: event-id=8193, maximum-segment-length=0, transport-protocol=UDP
      someip field deployment CidsAppState_Field: field=CidsAppState
        get getter: maximum-segment-length-request=0, maximum-segment-length-response=0, method-id=8194, transport-protocol=UDP
        notifier notifier: event-id=8194, maximum-segment-length=0, transport-protocol=UDP
      someip method deployment GetCidsStatistics_Method: method=GetCidsStatistics, maximum-segment-length-response=0, method-id=4097, transport-protocol=UDP
      someip method deployment GetVersionInfo_Method: method=CIDSInfo/GetVersionInfo, maximum-segment-length-response=0, method-id=4098, transport-protocol=UDP
      someip event group NewEventGroup: event-group-id=1, event=CidsAppInfo_Field/notifier
      someip event group NewEventGroup2: event-group-id=2, event=CidsAppState_Field/notifier
    Chassis_Someip: service-interface=Chassis, service-interface-id=3096, service-interface-version={major-version=1, minor-version=2}
      someip event deployment MDPS_01_10ms_Event: event=MDPS_01_10ms, event-id=4097, maximum-segment-length=0, transport-protocol=UDP
      someip event deployment SAS_01_10ms_Event: event=SAS_01_10ms, event-id=4098, maximum-segment-length=0, transport-protocol=UDP
      someip event deployment WHL_01_10ms_Event: event=WHL_01_10ms, event-id=4099, maximum-segment-length=0, transport-protocol=UDP
      16 x someip field deployment:
        EPBforceState_Field: field=EPBforceState
          get getter: maximum-segment-length-request=0, maximum-segment-length-response=0, method-id=8194, transport-protocol=UDP
          notifier notifier: event-id=8194, maximum-segment-length=0, transport-protocol=UDP
        FLTirePressureInfo_Field: field=FLTirePressureInfo
          get getter: maximum-segment-length-request=0, maximum-segment-length-response=0, method-id=8202, transport-protocol=UDP
          notifier notifier: event-id=8202, maximum-segment-length=0, transport-protocol=UDP
        FRTirePressureInfo_Field: field=FRTirePressureInfo
          get getter: maximum-segment-length-request=0, maximum-segment-length-response=0, method-id=8203, transport-protocol=UDP
          notifier notifier: event-id=8203, maximum-segment-length=0, transport-protocol=UDP
        ParkingBrakeLampState_Field: field=ParkingBrakeLampState
          get getter: maximum-segment-length-request=0, maximum-segment-length-response=0, method-id=8195, transport-protocol=UDP
          notifier notifier: event-id=8195, maximum-segment-length=0, transport-protocol=UDP
        ParkingBrakeState_Field: field=ParkingBrakeState
          get getter: maximum-segment-length-request=0, maximum-segment-length-response=0, method-id=8196, transport-protocol=UDP
          notifier notifier: event-id=8196, maximum-segment-length=0, transport-protocol=UDP
        PetModRdySta_Field: field=PetModRdySta
          get getter: maximum-segment-length-request=0, maximum-segment-length-response=0, method-id=8207, transport-protocol=UDP
          notifier notifier: event-id=8207, maximum-segment-length=0, transport-protocol=UDP
        PetSafetymode_Field: field=PetSafetymode
          get getter: maximum-segment-length-request=0, maximum-segment-length-response=0, method-id=8208, transport-protocol=UDP
          notifier notifier: event-id=8208, maximum-segment-length=0, transport-protocol=UDP
        RLTirePressureInfo_Field: field=RLTirePressureInfo
          get getter: maximum-segment-length-request=0, maximum-segment-length-response=0, method-id=8204, transport-protocol=UDP
          notifier notifier: event-id=8204, maximum-segment-length=0, transport-protocol=UDP
        RRTirePressureInfo_Field: field=RRTirePressureInfo
          get getter: maximum-segment-length-request=0, maximum-segment-length-response=0, method-id=8205, transport-protocol=UDP
          notifier notifier: event-id=8205, maximum-segment-length=0, transport-protocol=UDP
        TPMSFLPositionWarningLampState_Field: field=TPMSFLPositionWarningLampState
          get getter: maximum-segment-length-request=0, maximum-segment-length-response=0, method-id=8197, transport-protocol=UDP
          notifier notifier: event-id=8197, maximum-segment-length=0, transport-protocol=UDP
        TPMSFRPositionWarningLampState_Field: field=TPMSFRPositionWarningLampState
          get getter: maximum-segment-length-request=0, maximum-segment-length-response=0, method-id=8198, transport-protocol=UDP
          notifier notifier: event-id=8198, maximum-segment-length=0, transport-protocol=UDP
        TPMSPressureUnit_Field: field=TPMSPressureUnit
          get getter: maximum-segment-length-request=0, maximum-segment-length-response=0, method-id=8206, transport-protocol=UDP
          notifier notifier: event-id=8206, maximum-segment-length=0, transport-protocol=UDP
        TPMSRLPostionWarningLampState_Field: field=TPMSRLPostionWarningLampState
          get getter: maximum-segment-length-request=0, maximum-segment-length-response=0, method-id=8199, transport-protocol=UDP
          notifier notifier: event-id=8199, maximum-segment-length=0, transport-protocol=UDP
        TPMSRRPostionWarningLampState_Field: field=TPMSRRPostionWarningLampState
          get getter: maximum-segment-length-request=0, maximum-segment-length-response=0, method-id=8200, transport-protocol=UDP
          notifier notifier: event-id=8200, maximum-segment-length=0, transport-protocol=UDP
        TPMSThreadWarningLampState_Field: field=TPMSThreadWarningLampState
          get getter: maximum-segment-length-request=0, maximum-segment-length-response=0, method-id=8201, transport-protocol=UDP
          notifier notifier: event-id=8201, maximum-segment-length=0, transport-protocol=UDP
        WheelVelocityVal_Field: field=WheelVelocityVal
          get getter: maximum-segment-length-request=0, maximum-segment-length-response=0, method-id=8209, transport-protocol=UDP
          notifier notifier: event-id=8209, maximum-segment-length=0, transport-protocol=UDP
      19 x someip event group:
        NewEventGroup: event-group-id=1, event=EPBforceState_Field/notifier
        NewEventGroup1: event-group-id=2, event=FLTirePressureInfo_Field/notifier
        NewEventGroup10: event-group-id=11, event=TPMSRLPostionWarningLampState_Field/notifier
        NewEventGroup11: event-group-id=12, event=TPMSRRPostionWarningLampState_Field/notifier
        NewEventGroup12: event-group-id=13, event=TPMSThreadWarningLampState_Field/notifier
        NewEventGroup13: event-group-id=14, event=PetModRdySta_Field/notifier
        NewEventGroup14: event-group-id=15, event=PetSafetymode_Field/notifier
        NewEventGroup15: event-group-id=16, event=WheelVelocityVal_Field/notifier
        NewEventGroup16: event-group-id=17, event=MDPS_01_10ms_Event
        NewEventGroup17: event-group-id=18, event=SAS_01_10ms_Event
        NewEventGroup18: event-group-id=19, event=WHL_01_10ms_Event
        NewEventGroup2: event-group-id=3, event=FRTirePressureInfo_Field/notifier
        NewEventGroup3: event-group-id=4, event=ParkingBrakeLampState_Field/notifier
        NewEventGroup4: event-group-id=5, event=ParkingBrakeState_Field/notifier
        NewEventGroup5: event-group-id=6, event=RLTirePressureInfo_Field/notifier
        NewEventGroup6: event-group-id=7, event=RRTirePressureInfo_Field/notifier
        NewEventGroup7: event-group-id=8, event=TPMSFLPositionWarningLampState_Field/notifier
        NewEventGroup8: event-group-id=9, event=TPMSFRPositionWarningLampState_Field/notifier
        NewEventGroup9: event-group-id=10, event=TPMSPressureUnit_Field/notifier
    Communicator_Someip: service-interface=Service/Communicator, service-interface-id=7362, service-interface-version={major-version=2, minor-version=0}
      someip event deployment MORequestChanged_Event: event=MORequestChanged, event-id=4099, maximum-segment-length=0, transport-protocol=TCP
      someip event deployment MTRequestAdded_Event: event=MTRequestAdded, event-id=4097, maximum-segment-length=0, transport-protocol=TCP
      someip event deployment MTRequestRemoved_Event: event=MTRequestRemoved, event-id=4098, maximum-segment-length=0, transport-protocol=TCP
      someip field deployment LastActiveUser_Field: field=LastActiveUser
        get getter: maximum-segment-length-request=0, maximum-segment-length-response=0, method-id=8194, transport-protocol=TCP
        notifier notifier: event-id=8194, maximum-segment-length=0, transport-protocol=TCP
      someip field deployment MTRequestQueue_Field: field=MTRequestQueue
        get getter: maximum-segment-length-request=0, maximum-segment-length-response=0, method-id=8193, transport-protocol=TCP
        notifier notifier: event-id=8193, maximum-segment-length=0, transport-protocol=TCP
      someip method deployment ProcessMTRequest_Method: method=ProcessMTRequest, maximum-segment-length-request=0, maximum-segment-length-response=0, method-id=4097, transport-protocol=TCP
      someip method deployment RemoveMTRequest_Method: method=RemoveMTRequest, maximum-segment-length-request=0, maximum-segment-length-response=0, method-id=4098, transport-protocol=TCP
      someip method deployment SendMORequest_Method: method=SendMORequest, maximum-segment-length-request=0, maximum-segment-length-response=0, method-id=4099, transport-protocol=TCP
      someip event group SomeIpEventGroups: event-group-id=4097, event=[LastActiveUser_Field/notifier, MORequestChanged_Event, MTRequestAdded_Event, MTRequestQueue_Field/notifier, MTRequestRemoved_Event]
    Communicator_Someip: service-interface=Service/Communicator, service-interface-id=3105, service-interface-version={major-version=1, minor-version=0}
      someip field deployment PrivacyOfflineMode_Field: field=Communicator/PrivacyOfflineMode
        get getter: maximum-segment-length-request=0, maximum-segment-length-response=0, method-id=8193, transport-protocol=UDP
        notifier notifier: event-id=8193, maximum-segment-length=0, transport-protocol=UDP
      someip event group NewEventGroup1: event-group-id=2, event=PrivacyOfflineMode_Field/notifier
