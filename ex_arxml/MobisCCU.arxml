[part 3 of 9: packages /DataType/Implementation/CPP to /PortInterface/Service]
AUTOSAR XML (schema 00049)
package /DataType/Implementation/CPP  (continued)
  968 x std cpp implementation data type:  (continued)
    SwNameVersionType: category=STRUCTURE, type-emitter=TYPE_EMITTER_ARA
      namespaces:
        symbol props Vehicle
        symbol props CM
        symbol props PackageManagement
      cpp implementation data type element Name: type-reference={inplace=false, type-reference=CPP/SwNameType}
      cpp implementation data type element Version: type-reference={inplace=false, type-reference=CPP/StrongRevisionLabelString}
    SwNameVersionType: category=STRUCTURE, type-emitter=TYPE_EMITTER_ARA
      namespaces:
        symbol props ara
        symbol props ucm
        symbol props pkgmgr
      cpp implementation data type element Name: type-reference={inplace=false, type-reference=CPP/SwNameType}
      cpp implementation data type element Version: type-reference={inplace=false, type-reference=CPP/StrongRevisionLabelString}
    SwNameVersionType: category=STRUCTURE, type-emitter=TYPE_EMITTER_ARA
      namespaces:
        symbol props Vehicle
        symbol props SelfUpdateEngine
        symbol props DeltaUpdate
      cpp implementation data type element name: type-reference={inplace=false, type-reference=String}
      cpp implementation data type element version: type-reference={inplace=false, type-reference=String}
    SwNameVersionType: category=STRUCTURE, type-emitter=TYPE_EMITTER_ARA
      namespaces:
        symbol props Vehicle
        symbol props UpdateMaster
        symbol props PackageManagement
      cpp implementation data type element Name: type-reference={inplace=false, type-reference=CPP/SwNameType}
      cpp implementation data type element Version: type-reference={inplace=false, type-reference=CPP/StrongRevisionLabelString}
    SwNameVersionVectorType: category=VECTOR, cpp-template-argument=CPP/SwNameVersionType, type-emitter=TYPE_EMITTER_ARA
      namespaces:
        symbol props Vehicle
        symbol props CM
        symbol props PackageManagement
    SwNameVersionVectorType: category=VECTOR, cpp-template-argument=CPP/SwNameVersionType, type-emitter=TYPE_EMITTER_ARA
      namespaces:
        symbol props ara
        symbol props ucm
        symbol props pkgmgr
    SwNameVersionVectorType: category=VECTOR, cpp-template-argument=CPP/SwNameVersionType, type-emitter=TYPE_EMITTER_ARA
      namespaces:
        symbol props Vehicle
        symbol props UpdateMaster
        symbol props PackageManagement
    SwPackageInfoType: category=STRUCTURE, type-emitter=TYPE_EMITTER_ARA
      namespaces:
        symbol props Vehicle
        symbol props CM
        symbol props PackageManagement
      6 x cpp implementation data type element:
        Name: type-reference={inplace=false, type-reference=CPP/SwNameType}
        Version: type-reference={inplace=false, type-reference=CPP/StrongRevisionLabelString}
        TransferID: type-reference={inplace=false, type-reference=CPP/TransferIdType}
        ConsecutiveBytesReceived: type-reference={inplace=false, type-reference=uint64_t}
        ConsecutiveBlocksReceived: type-reference={inplace=false, type-reference=uint64_t}
        State: type-reference={inplace=false, type-reference=CPP/SwPackageStateType}
    SwPackageInfoType: category=STRUCTURE, type-emitter=TYPE_EMITTER_ARA
      namespaces:
        symbol props ara
        symbol props ucm
        symbol props pkgmgr
      6 x cpp implementation data type element:
        Name: type-reference={inplace=false, type-reference=CPP/SwNameType}
        Version: type-reference={inplace=false, type-reference=CPP/StrongRevisionLabelString}
        TransferID: type-reference={inplace=false, type-reference=CPP/TransferIdType}
        ConsecutiveBytesReceived: type-reference={inplace=false, type-reference=uint64_t}
        ConsecutiveBlocksReceived: type-reference={inplace=false, type-reference=uint64_t}
        State: type-reference={inplace=false, type-reference=CPP/SwPackageStateType}
    SwPackageInfoVectorType: category=VECTOR, cpp-template-argument=CPP/SwPackageInfoType, type-emitter=TYPE_EMITTER_ARA
      namespaces:
        symbol props Vehicle
        symbol props CM
        symbol props PackageManagement
    SwPackageInfoVectorType: category=VECTOR, cpp-template-argument=CPP/SwPackageInfoType, type-emitter=TYPE_EMITTER_ARA
      namespaces:
        symbol props ara
        symbol props ucm
        symbol props pkgmgr
    SwPackageStateType: compu {texttable}, range raw 0..4, type-emitter=TYPE_EMITTER_ARA, type-reference=uint32_t
      namespaces:
        symbol props Vehicle
        symbol props CM
        symbol props PackageManagement
    SwPackageStateType: compu {texttable}, range raw 0..4, type-emitter=TYPE_EMITTER_ARA, type-reference=uint32_t
      namespaces:
        symbol props ara
        symbol props ucm
        symbol props pkgmgr
    SwReleaseResultReportType: category=STRUCTURE, type-emitter=TYPE_EMITTER_ARA
      namespaces:
        symbol props Vehicle
        symbol props UpdateMaster
        symbol props PackageManagement
      cpp implementation data type element swReleaseId: type-reference={inplace=false, type-reference=String}
      cpp implementation data type element result: type-reference={inplace=false, type-reference=SwReleaseResultType}
    SwReleaseResultReportVectorType: category=VECTOR, cpp-template-argument=SwReleaseResultReportType, type-emitter=TYPE_EMITTER_ARA
      namespaces:
        symbol props Vehicle
        symbol props UpdateMaster
        symbol props PackageManagement
    SwReleaseResultType: compu {texttable}, range raw 0..32, type-emitter=TYPE_EMITTER_ARA, type-reference=uint32_t
      namespaces:
        symbol props Vehicle
        symbol props UpdateMaster
        symbol props PackageManagement
    SwReleaseServerReportType: category=STRUCTURE, type-emitter=TYPE_EMITTER_ARA
      namespaces:
        symbol props Vehicle
        symbol props UpdateMaster
        symbol props PackageManagement
      6 x cpp implementation data type element:
        swReleaseId: type-reference={inplace=false, type-reference=String}
        serverReportStep: type-reference={inplace=false, type-reference=String}
        result: type-reference={inplace=false, type-reference=String}
        resultDetail: type-reference={inplace=false, type-reference=String}
        partInfoServerReport: type-reference={inplace=false, type-reference=PartInfoServerReportVectorType}
        detailInfo: type-reference={inplace=false, type-reference=StringMap}
    SwUnitResultType: compu {texttable}, range raw 0..3, type-emitter=TYPE_EMITTER_ARA, type-reference=uint32_t
      namespaces:
        symbol props Vehicle
        symbol props FlashingAdaptor
        symbol props PackageManagement
    SwUnitResultType: compu {texttable}, range raw 0..3, type-emitter=TYPE_EMITTER_ARA, type-reference=uint32_t
      namespaces:
        symbol props Vehicle
        symbol props UpdateMaster
        symbol props PackageManagement
    SwUnitServerReportType: category=STRUCTURE, type-emitter=TYPE_EMITTER_ARA
      namespaces:
        symbol props Vehicle
        symbol props UpdateMaster
        symbol props PackageManagement
      7 x cpp implementation data type element:
        swUnitId: type-reference={inplace=false, type-reference=String}
        result: type-reference={inplace=false, type-reference=String}
        resultDetail: type-reference={inplace=false, type-reference=String}
        startTime: type-reference={inplace=false, type-reference=uint64_t}
        endTime: type-reference={inplace=false, type-reference=uint64_t}
        leadTime: type-reference={inplace=false, type-reference=uint32_t}
        retryCount: type-reference={inplace=false, type-reference=uint8_t}
    SwUnitServerReportVectorType: category=VECTOR, cpp-template-argument=SwUnitServerReportType, type-emitter=TYPE_EMITTER_ARA
      namespaces:
        symbol props Vehicle
        symbol props UpdateMaster
        symbol props PackageManagement
    SwitchPortStats: category=ASSOCIATIVE_MAP, type-emitter=TYPE_EMITTER_ARA
      namespaces:
        symbol props Vehicle
        symbol props EthHandler
        symbol props EthernetSwitchMgr
      template-arguments:
        category=ASSOC_MAP_KEY, template-type=uint8_t
        category=ASSOC_MAP_VALUE, template-type=StatsIDTable
    SwitchPortStatsConfig: category=ASSOCIATIVE_MAP, type-emitter=TYPE_EMITTER_ARA
      namespaces:
        symbol props Vehicle
        symbol props EthHandler
        symbol props EthernetSwitchMgr
      template-arguments:
        category=ASSOC_MAP_KEY, template-type=uint8_t
        category=ASSOC_MAP_VALUE, template-type=SwitchPortStatsMask
    SwitchPortStatsMask: category=ASSOCIATIVE_MAP, template-arguments=[{category=ASSOC_MAP_KEY, template-type=uint8_t}, {category=ASSOC_MAP_VALUE, template-type=uint16_t}], type-emitter=TYPE_EMITTER_ARA
      namespaces:
        symbol props Vehicle
        symbol props EthHandler
        symbol props EthernetSwitchMgr
    SwitchStats: category=ASSOCIATIVE_MAP, type-emitter=TYPE_EMITTER_ARA
      namespaces:
        symbol props Vehicle
        symbol props EthHandler
        symbol props EthernetSwitchMgr
      template-arguments:
        category=ASSOC_MAP_KEY, template-type=uint8_t
        category=ASSOC_MAP_VALUE, template-type=SwitchPortStats
    SwitchStatsConfig: category=ASSOCIATIVE_MAP, type-emitter=TYPE_EMITTER_ARA
      namespaces:
        symbol props Vehicle
        symbol props EthHandler
        symbol props EthernetSwitchMgr
      template-arguments:
        category=ASSOC_MAP_KEY, template-type=uint8_t
        category=ASSOC_MAP_VALUE, template-type=SwitchPortStatsConfig
    SyncStatusType: compu {texttable}, range raw 0..4, type-emitter=TYPE_EMITTER_ARA, type-reference=uint32_t
      namespaces:
        symbol props Vehicle
        symbol props BSM
        symbol props BootSyncManager
    SysCtrlReq: compu {texttable}, range raw 0..5, type-emitter=TYPE_EMITTER_ARA, type-reference=uint32_t
      namespaces:
        symbol props Vehicle
        symbol props SOAAdaptor
        symbol props Body1
    SysCtrlReq: compu {texttable}, range raw 0..5, type-emitter=TYPE_EMITTER_ARA, type-reference=uint32_t
      namespaces:
        symbol props Vehicle
        symbol props SOAAdaptor
        symbol props Location
    SysCtrlReq: compu {texttable}, range raw 0..5, type-emitter=TYPE_EMITTER_ARA, type-reference=uint32_t
      namespaces:
        symbol props Vehicle
        symbol props SOAAdaptor
        symbol props PowerTrain1
    SysCtrlReq: compu {texttable}, range raw 0..5, type-emitter=TYPE_EMITTER_ARA, type-reference=uint32_t
      namespaces:
        symbol props Vehicle
        symbol props SOAAdaptor
        symbol props DynamicRouting
    SysCtrlReq: compu {texttable}, range raw 0..5, type-emitter=TYPE_EMITTER_ARA, type-reference=uint32_t
      namespaces:
        symbol props Vehicle
        symbol props SOAAdaptor
        symbol props Body2
    SysCtrlReq: compu {texttable}, range raw 0..5, type-emitter=TYPE_EMITTER_ARA, type-reference=uint32_t
      namespaces:
        symbol props Vehicle
        symbol props SOAAdaptor
        symbol props Extended
    SysCtrlReq: compu {texttable}, range raw 0..5, type-emitter=TYPE_EMITTER_ARA, type-reference=uint32_t
      namespaces:
        symbol props Vehicle
        symbol props SOAAdaptor
        symbol props PowerTrain2
    SysCtrlReq: compu {texttable}, range raw 0..5, type-emitter=TYPE_EMITTER_ARA, type-reference=uint32_t
      namespaces:
        symbol props Vehicle
        symbol props SOAAdaptor
        symbol props MultiMedia
    SysCtrlReq: compu {texttable}, range raw 0..5, type-emitter=TYPE_EMITTER_ARA, type-reference=uint32_t
      namespaces:
        symbol props Vehicle
        symbol props SOAAdaptor
        symbol props DataCollection
    SysCtrlReq: compu {texttable}, range raw 0..5, type-emitter=TYPE_EMITTER_ARA, type-reference=uint32_t
      namespaces:
        symbol props Vehicle
        symbol props SM
        symbol props StateManager
    SysCtrlReq: compu {texttable}, range raw 0..5, type-emitter=TYPE_EMITTER_ARA, type-reference=uint32_t
      namespaces:
        symbol props Vehicle
        symbol props SOAAdaptor
        symbol props CANoverIP
    SysCtrlReq: compu {texttable}, range raw 0..5, type-emitter=TYPE_EMITTER_ARA, type-reference=uint32_t
      namespaces:
        symbol props Vehicle
        symbol props SOAAdaptor
        symbol props Chassis
    SysCtrlResp: compu {texttable}, range raw 0..11, type-emitter=TYPE_EMITTER_ARA, type-reference=uint32_t
      namespaces:
        symbol props Vehicle
        symbol props IPCHandler
        symbol props RoutingIPC
    SystemBootReason: compu {texttable}, range raw 0..4, type-emitter=TYPE_EMITTER_ARA, type-reference=uint32_t
      namespaces:
        symbol props DCU
        symbol props System
        symbol props Variation
    SystemBootReason: compu {texttable}, range raw 0..4, type-emitter=TYPE_EMITTER_ARA, type-reference=uint32_t
      namespaces:
        symbol props Info
        symbol props System
        symbol props Variant
    SystemBootReason: compu {texttable}, range raw 0..4, type-emitter=TYPE_EMITTER_ARA, type-reference=uint32_t
      namespaces:
        symbol props Info
        symbol props System
        symbol props EngineeringMode
    SystemBootReason: compu {texttable}, range raw 0..4, type-emitter=TYPE_EMITTER_ARA, type-reference=uint32_t
      namespaces:
        symbol props DCU
        symbol props System
        symbol props Time
    SystemBootReason: compu {texttable}, range raw 0..4, type-emitter=TYPE_EMITTER_ARA, type-reference=uint32_t
      namespaces:
        symbol props DCU
        symbol props System
        symbol props PowerManagement
    SystemBootReason: category=STRUCTURE, type-emitter=TYPE_EMITTER_ARA
      namespaces:
        symbol props CCU
        symbol props System
        symbol props EngineeringMode
      10 x cpp implementation data type element, all with type-reference={inplace=false, type-reference=bool}:
        acc  # Booting by Acc On.
        ign1  # Booting by IGN1
        ign3  # Booting by IGN3
        l_wk_dvrs  # Booting by DVRS
        l_wk_ccic  # Booting by CCIC
        l_wk_dcu  # Booting by DCU
        l_ert_act  # Booting by ERT
        b_can_inh  # Booting by B-CAN WAKEUP
        bnm_can_inh  # Booting by M-CAN WAKEUP
        d_can_inh  # Booting by D-CAN WAKUP
    SystemBootReason: compu {texttable}, range raw 0..4, type-emitter=TYPE_EMITTER_ARA, type-reference=uint32_t
      namespaces:
        symbol props Vehicle
        symbol props MSM
        symbol props MessageManager
    SystemBootReason: compu {texttable}, range raw 0..4, type-emitter=TYPE_EMITTER_ARA, type-reference=uint32_t
      namespaces:
        symbol props Info
        symbol props System
        symbol props Time
    SystemTime: category=STRUCTURE, type-emitter=TYPE_EMITTER_ARA
      namespaces:
        symbol props DCU
        symbol props System
        symbol props Variation
      9 x cpp implementation data type element:
        sec: type-reference={inplace=false, type-reference=int16_t}  # Seconds [0..59]
        min: type-reference={inplace=false, type-reference=int16_t}  # Minutes [0..59]
        hour: type-reference={inplace=false, type-reference=int16_t}  # Hours [0..23]
        mday: type-reference={inplace=false, type-reference=int16_t}  # Day of month [1..31]
        mon: type-reference={inplace=false, type-reference=int16_t}  # Month [1..12]
        year: type-reference={inplace=false, type-reference=int16_t}  # Current year
        dst: type-reference={inplace=false, type-reference=int16_t}  # Current adjustment, in hours
        utcoff: type-reference={inplace=false, type-reference=int16_t}  # Offset from UTC in seconds
        valid: type-reference={inplace=false, type-reference=bool}  # Network Time Valid
    SystemTime: category=STRUCTURE, type-emitter=TYPE_EMITTER_ARA
      namespaces:
        symbol props DCU
        symbol props System
        symbol props Time
      9 x cpp implementation data type element:
        sec: type-reference={inplace=false, type-reference=int16_t}  # Seconds [0..59]
        min: type-reference={inplace=false, type-reference=int16_t}  # Minutes [0..59]
        hour: type-reference={inplace=false, type-reference=int16_t}  # Hours [0..23]
        mday: type-reference={inplace=false, type-reference=int16_t}  # Day of month [1..31]
        mon: type-reference={inplace=false, type-reference=int16_t}  # Month [1..12]
        year: type-reference={inplace=false, type-reference=int16_t}  # Current year
        dst: type-reference={inplace=false, type-reference=int16_t}  # Current adjustment, in hours
        utcoff: type-reference={inplace=false, type-reference=int16_t}  # The value is in Seconds
        valid: type-reference={inplace=false, type-reference=bool}  # Network Time Valid
    SystemTime: category=STRUCTURE, type-emitter=TYPE_EMITTER_ARA
      namespaces:
        symbol props DCU
        symbol props System
        symbol props PowerManagement
      9 x cpp implementation data type element:
        sec: type-reference={inplace=false, type-reference=int16_t}  # Seconds [0..59]
        min: type-reference={inplace=false, type-reference=int16_t}  # Minutes [0..59]
        hour: type-reference={inplace=false, type-reference=int16_t}  # Hours [0..23]
        mday: type-reference={inplace=false, type-reference=int16_t}  # Day of month [1..31]
        mon: type-reference={inplace=false, type-reference=int16_t}  # Month [1..12]
        year: type-reference={inplace=false, type-reference=int16_t}  # Current year
        dst: type-reference={inplace=false, type-reference=int16_t}  # Current adjustment, in hours
        utcoff: type-reference={inplace=false, type-reference=int16_t}  # Offset from UTC in seconds
        valid: type-reference={inplace=false, type-reference=bool}  # Network Time Valid
    SystemTime: category=STRUCTURE, type-emitter=TYPE_EMITTER_ARA
      namespaces:
        symbol props Info
        symbol props System
        symbol props Time
      6 x cpp implementation data type element, all with type-reference={inplace=false, type-reference=int16_t}:
        sec  # Seconds [0..59]
        min  # Minutes [0..59]
        hour  # Hours [0..23]
        mday  # Day of month [1..31]
        mon  # Month [1..12]
        year  # Current year
    TADStatusResult: compu {texttable}, range raw 0..3, type-emitter=TYPE_EMITTER_ARA, type-reference=uint32_t
      namespaces:
        symbol props Vehicle
        symbol props TAD
        symbol props NetManager
    TPError: compu {texttable}, range raw 0..2, type-emitter=TYPE_EMITTER_ARA, type-reference=uint32_t
      namespaces:
        symbol props Vehicle
        symbol props SDE
        symbol props SelfDiagnosis
    TPResultType: compu {texttable}, range raw 0..3, type-emitter=TYPE_EMITTER_ARA, type-reference=uint32_t
      namespaces:
        symbol props Vehicle
        symbol props DiagMgr
        symbol props RoutingTP
    TP_IAU_CCU_EventData: category=STRUCTURE, type-emitter=TYPE_EMITTER_ARA
      namespaces:
        symbol props Vehicle
        symbol props DiagMgr
        symbol props RoutingTP
      cpp implementation data type element tpMessage: type-reference={inplace=false, type-reference=ByteArray}
      cpp implementation data type element result: type-reference={inplace=false, type-reference=TPResultType}
    T_ExtWireInput: compu {texttable}, range raw 0..4, type-emitter=TYPE_EMITTER_ARA, type-reference=uint32_t
      namespaces:
        symbol props Vehicle
        symbol props ApSysMgr
        symbol props TAD
    T_PowerStateKey: compu {texttable}, range raw 0..10, type-emitter=TYPE_EMITTER_ARA, type-reference=uint32_t
      namespaces:
        symbol props Vehicle
        symbol props ApSysMgr
        symbol props TAD
    TePolicyDownloaded_EventData: category=STRUCTURE, type-emitter=TYPE_EMITTER_ARA
      namespaces:
        symbol props Vehicle
        symbol props DPM
        symbol props Policy
      cpp implementation data type element newVersion: type-reference={inplace=false, type-reference=uint32_t}
    TelltaleInfo: category=STRUCTURE, type-emitter=TYPE_EMITTER_ARA
      namespaces:
        symbol props Info
        symbol props Cluster
        symbol props InformationProvider
      cpp implementation data type element DID: type-reference={inplace=false, type-reference=String}
      cpp implementation data type element Status: type-reference={inplace=false, type-reference=uint8_t}
    Telltale_VECTOR: category=VECTOR, cpp-template-argument=TelltaleInfo, type-emitter=TYPE_EMITTER_ARA
      namespaces:
        symbol props Info
        symbol props Cluster
        symbol props InformationProvider
    TempMonitorInfo: category=STRUCTURE, type-emitter=TYPE_EMITTER_ARA
      namespaces:
        symbol props Vehicle
        symbol props IPCHandler
        symbol props RoutingIPC
      5 x cpp implementation data type element, all with type-reference={inplace=false, type-reference=uint8_t}:
        s32g
        emmc
        nvme
        esw
        ddr
    TetheringService: category=STRUCTURE, type-emitter=TYPE_EMITTER_ARA
      namespaces:
        symbol props CCU
        symbol props ExternalNetwork
        symbol props Manager2
      cpp implementation data type element iptype: type-reference={inplace=false, type-reference=CPP/ProtocolTypes}
      cpp implementation data type element status: type-reference={inplace=false, type-reference=CPP/ConnectionStatus}
      cpp implementation data type element ipconfig: type-reference={inplace=false, type-reference=TetheringService_ipconfig_VECTOR}
    TetheringService_ipconfig_VECTOR: category=VECTOR, cpp-template-argument=EndpointConfiguration, type-emitter=TYPE_EMITTER_ARA
      namespaces:
        symbol props CCU
        symbol props ExternalNetwork
        symbol props Manager2
    Themes_VECTOR: category=VECTOR, cpp-template-argument=KeyValueString, type-emitter=TYPE_EMITTER_ARA
      namespaces:
        symbol props Info
        symbol props Setup
        symbol props GeneralSettings
    Time: category=STRUCTURE, type-emitter=TYPE_EMITTER_ARA
      namespaces:
        symbol props Vehicle
        symbol props ApSysMgr
        symbol props TimeManager
      8 x cpp implementation data type element:
        year: type-reference={inplace=false, type-reference=uint16_t}
        month: type-reference={inplace=false, type-reference=uint16_t}
        day: type-reference={inplace=false, type-reference=uint16_t}
        hour: type-reference={inplace=false, type-reference=uint16_t}
        minute: type-reference={inplace=false, type-reference=uint16_t}
        second: type-reference={inplace=false, type-reference=uint16_t}
        mode: type-reference={inplace=false, type-reference=CPP/TimeMode}
        utcOffset: type-reference={inplace=false, type-reference=int16_t}
    TimeInfo: category=STRUCTURE, type-emitter=TYPE_EMITTER_ARA
      namespaces:
        symbol props Vehicle
        symbol props SOAAdaptor
        symbol props Location
      7 x cpp implementation data type element:
        year: type-reference={inplace=false, type-reference=uint16_t}
        month: type-reference={inplace=false, type-reference=uint8_t}
        day: type-reference={inplace=false, type-reference=uint8_t}
        hour: type-reference={inplace=false, type-reference=uint8_t}
        minute: type-reference={inplace=false, type-reference=uint8_t}
        second: type-reference={inplace=false, type-reference=uint8_t}
        isValid: type-reference={inplace=false, type-reference=bool}
    TimeInfo: category=STRUCTURE, type-emitter=TYPE_EMITTER_ARA
      namespaces:
        symbol props Info
        symbol props Cluster
        symbol props InformationProvider
      cpp implementation data type element type: type-reference={inplace=false, type-reference=String}
      cpp implementation data type element hour: type-reference={inplace=false, type-reference=int32_t}
      cpp implementation data type element min: type-reference={inplace=false, type-reference=int32_t}
    TimeMode: compu {texttable}, range raw 0..2, type-emitter=TYPE_EMITTER_ARA, type-reference=uint32_t
      namespaces:
        symbol props Vehicle
        symbol props IPCHandler
        symbol props RoutingIPC
    TimeMode: compu {texttable}, range raw 0..2, type-emitter=TYPE_EMITTER_ARA, type-reference=uint32_t
      namespaces:
        symbol props Vehicle
        symbol props CIDS
        symbol props CIDSInfo
    TimeMode: compu {texttable}, range raw 0..2, type-emitter=TYPE_EMITTER_ARA, type-reference=uint32_t
      namespaces:
        symbol props Vehicle
        symbol props EIDS
        symbol props EIDSInfo
    TimeMode: compu {texttable}, range raw 0..2, type-emitter=TYPE_EMITTER_ARA, type-reference=uint32_t
      namespaces:
        symbol props Vehicle
        symbol props ApSysMgr
        symbol props TimeManager
    TimeSource: compu {texttable}, range raw 0..3, type-emitter=TYPE_EMITTER_ARA, type-reference=uint32_t
      namespaces:
        symbol props Info
        symbol props Location
        symbol props Time
    TimeSource: compu {texttable}, range raw 0..3, type-emitter=TYPE_EMITTER_ARA, type-reference=uint32_t
      namespaces:
        symbol props Vehicle
        symbol props IPCHandler
        symbol props RoutingIPC
    TimeZoneID: compu {texttable}, range raw 0..48, type-emitter=TYPE_EMITTER_ARA, type-reference=uint32_t
      namespaces:
        symbol props Info
        symbol props System
        symbol props Time
    Timer: category=STRUCTURE, type-emitter=TYPE_EMITTER_ARA
      namespaces:
        symbol props Vehicle
        symbol props IPCHandler
        symbol props RoutingIPC
      cpp implementation data type element presetTimer: type-reference={inplace=false, type-reference=uint64_t}
      cpp implementation data type element currentCountTimer: type-reference={inplace=false, type-reference=uint64_t}
    Timer: category=STRUCTURE, type-emitter=TYPE_EMITTER_ARA
      namespaces:
        symbol props Vehicle
        symbol props ApSysMgr
        symbol props TimeManager
      cpp implementation data type element presetTimer: type-reference={inplace=false, type-reference=uint64_t}
      cpp implementation data type element currentCountTimer: type-reference={inplace=false, type-reference=uint64_t}
    TopicMessageV5_EventData: category=STRUCTURE, type-emitter=TYPE_EMITTER_ARA
      namespaces:
        symbol props Vehicle
        symbol props Telemanager
        symbol props MQTT
      cpp implementation data type element topic: type-reference={inplace=false, type-reference=String}
      cpp implementation data type element properties: type-reference={inplace=false, type-reference=String}
      cpp implementation data type element payload: type-reference={inplace=false, type-reference=ByteArray}
    TopicMessage_EventData: category=STRUCTURE, type-emitter=TYPE_EMITTER_ARA
      namespaces:
        symbol props Vehicle
        symbol props Telemanager
        symbol props MQTT
      cpp implementation data type element topic: type-reference={inplace=false, type-reference=String}
      cpp implementation data type element payload: type-reference={inplace=false, type-reference=ByteArray}
    TransferError: compu {texttable}, range raw 0..5, type-emitter=TYPE_EMITTER_ARA, type-reference=uint32_t
      namespaces:
        symbol props Info
        symbol props System
        symbol props Variant
    TransferError: compu {texttable}, range raw 0..5, type-emitter=TYPE_EMITTER_ARA, type-reference=uint32_t
      namespaces:
        symbol props Info
        symbol props System
        symbol props EngineeringMode
    TransferError: compu {texttable}, range raw 0..5, type-emitter=TYPE_EMITTER_ARA, type-reference=uint32_t
      namespaces:
        symbol props Info
        symbol props System
        symbol props Time
    TransferIdType: category=ARRAY, array-size=16, cpp-template-argument=uint8_t, type-emitter=TYPE_EMITTER_ARA
      namespaces:
        symbol props Vehicle
        symbol props CM
        symbol props PackageManagement
    TransferIdType: category=ARRAY, array-size=16, cpp-template-argument=uint8_t, type-emitter=TYPE_EMITTER_ARA
      namespaces:
        symbol props ara
        symbol props ucm
        symbol props pkgmgr
    TransferIdType: category=ARRAY, array-size=16, cpp-template-argument=uint8_t, type-emitter=TYPE_EMITTER_ARA
      namespaces:
        symbol props Vehicle
        symbol props FlashingAdaptor
        symbol props PackageManagement
    TransferIdType: category=ARRAY, array-size=16, cpp-template-argument=uint8_t, type-emitter=TYPE_EMITTER_ARA
      namespaces:
        symbol props Vehicle
        symbol props UpdateMaster
        symbol props PackageManagement
    TransferIdVectorType: category=VECTOR, cpp-template-argument=CPP/TransferIdType, type-emitter=TYPE_EMITTER_ARA
      namespaces:
        symbol props Vehicle
        symbol props FlashingAdaptor
        symbol props PackageManagement
    TransferWhatsNewContentsCCUApp_AllContents_VECTOR: category=VECTOR, cpp-template-argument=WhatsNewContentInfo, type-emitter=TYPE_EMITTER_ARA
      namespaces:
        symbol props Info
        symbol props Update
        symbol props InteractionManager
    TransferWhatsNewContents_AllContents_VECTOR: category=VECTOR, cpp-template-argument=WhatsNewContentInfo, type-emitter=TYPE_EMITTER_ARA
      namespaces:
        symbol props Info
        symbol props Update
        symbol props InteractionManager
    UCMIdentifierType: category=STRING, type-emitter=TYPE_EMITTER_ARA
      namespaces:
        symbol props Vehicle
        symbol props CM
        symbol props PackageManagement
    UCMIdentifierType: category=STRING, type-emitter=TYPE_EMITTER_ARA
      namespaces:
        symbol props ara
        symbol props ucm
        symbol props pkgmgr
    UInt32_vector: category=VECTOR, cpp-template-argument=uint32_t, type-emitter=TYPE_EMITTER_ARA
      namespaces:
        symbol props Vehicle
        symbol props DiagMgr
        symbol props RoutingDiag
    UTCOffset: compu {texttable}, range raw 0..39, type-emitter=TYPE_EMITTER_ARA, type-reference=uint32_t
      namespaces:
        symbol props Info
        symbol props System
        symbol props Time
    UdsResultType: category=STRUCTURE, type-emitter=TYPE_EMITTER_ARA
      namespaces:
        symbol props Vehicle
        symbol props FlashingAdaptor
        symbol props PackageManagement
      cpp implementation data type element canId: type-reference={inplace=false, type-reference=String}
      cpp implementation data type element result: type-reference={inplace=false, type-reference=bool}
      cpp implementation data type element reason: type-reference={inplace=false, type-reference=String}
    UdsResultTypeVector: category=VECTOR, cpp-template-argument=UdsResultType, type-emitter=TYPE_EMITTER_ARA
      namespaces:
        symbol props Vehicle
        symbol props FlashingAdaptor
        symbol props PackageManagement
    UnitSyncStatus: category=STRUCTURE, type-emitter=TYPE_EMITTER_ARA
      namespaces:
        symbol props Vehicle
        symbol props BSM
        symbol props BootSyncManager
      cpp implementation data type element mcuSyncStatus: type-reference={inplace=false, type-reference=SyncStatusType}
      cpp implementation data type element apSyncStatus: type-reference={inplace=false, type-reference=SyncStatusType}
    UpdateExecuteType: compu {texttable}, range raw 0..3, type-emitter=TYPE_EMITTER_ARA, type-reference=uint32_t
      namespaces:
        symbol props Vehicle
        symbol props UpdateMaster
        symbol props PackageManagement
    UpdateExternalPncInfo_VECTOR: category=VECTOR, cpp-template-argument=bool, type-emitter=TYPE_EMITTER_ARA
      namespaces:
        symbol props Vehicle
        symbol props EthNM
        symbol props NM
    UpdateMasterStateType: compu {texttable}, range raw 0..6, type-emitter=TYPE_EMITTER_ARA, type-reference=uint32_t
      namespaces:
        symbol props Vehicle
        symbol props UpdateMaster
        symbol props PackageManagement
    UpdatePhys_ports_VECTOR: category=VECTOR, cpp-template-argument=PortID, type-emitter=TYPE_EMITTER_ARA
      namespaces:
        symbol props Vehicle
        symbol props EthHandler
        symbol props EthernetSwitchMgr
    UpdatePncInfo_VECTOR: category=VECTOR, cpp-template-argument=bool, type-emitter=TYPE_EMITTER_ARA
      namespaces:
        symbol props Vehicle
        symbol props EthNM
        symbol props NM
    UpdateProgressReportType: category=STRUCTURE, type-emitter=TYPE_EMITTER_ARA
      namespaces:
        symbol props Vehicle
        symbol props UpdateMaster
        symbol props PackageManagement
      cpp implementation data type element swReleaseID: type-reference={inplace=false, type-reference=String}
      cpp implementation data type element updateProgress: type-reference={inplace=false, type-reference=uint8_t}
      cpp implementation data type element rollbackProgress: type-reference={inplace=false, type-reference=uint8_t}
    UpdateToken_EventData: category=STRUCTURE, type-emitter=TYPE_EMITTER_ARA
      namespaces:
        symbol props Vehicle
        symbol props Telemanager
        symbol props Provisioning
      cpp implementation data type element token: type-reference={inplace=false, type-reference=UpdateToken_token_VECTOR}
      cpp implementation data type element requestID: type-reference={inplace=false, type-reference=String}
    UpdateToken_token_VECTOR: category=VECTOR, cpp-template-argument=AccessToken, type-emitter=TYPE_EMITTER_ARA
      namespaces:
        symbol props Vehicle
        symbol props Telemanager
        symbol props Provisioning
    UpdateVehicleSystemDiagClientType: compu {texttable}, range raw 0..1, type-emitter=TYPE_EMITTER_ARA, type-reference=uint32_t
      namespaces:
        symbol props Vehicle
        symbol props VSUA
        symbol props UdsReprogram
    UpdateVehicleSystemStatusType: compu {texttable}, range raw 0..2, type-emitter=TYPE_EMITTER_ARA, type-reference=uint32_t
      namespaces:
        symbol props Vehicle
        symbol props VSUA
        symbol props UdsReprogram
    VCU_01_10ms_EventData: category=STRUCTURE, type-emitter=TYPE_EMITTER_ARA
      namespaces:
        symbol props Vehicle
        symbol props SOAAdaptor
        symbol props PowerTrain1
      cpp implementation data type element pdu: type-reference={inplace=false, type-reference=VCU_01_10ms_pdu_VECTOR}
    VCU_01_10ms_pdu_VECTOR: category=VECTOR, cpp-template-argument=uint8_t, type-emitter=TYPE_EMITTER_ARA
      namespaces:
        symbol props Vehicle
        symbol props SOAAdaptor
        symbol props PowerTrain1
    VSMErrorDomain: compu {texttable}, range raw 0..1, type-emitter=TYPE_EMITTER_ARA, type-reference=uint32_t
      namespaces:
        symbol props Vehicle
        symbol props VSM
        symbol props SafeStatusManagement
    VSUAErrorDomain: compu {texttable}, range raw 0..245, type-emitter=TYPE_EMITTER_ARA, type-reference=uint32_t
      namespaces:
        symbol props Vehicle
        symbol props VSUA
        symbol props UdsReprogram
    ValidityError: category=STRUCTURE, type-emitter=TYPE_EMITTER_ARA
      namespaces:
        symbol props Info
        symbol props Location
        symbol props GNSS
      6 x cpp implementation data type element, all with type-reference={inplace=false, type-reference=uint32_t}:
        latitude_error  # The error of latitude. Standard deviation of latitude error (1 sigma). unit : m
        longitude_error  # The error of longitude. Standard deviation of longitude error (1 sigma). unit : m
        altitude_error  # The error of altitude. Standard deviation of altitude error (1 sigma). unit : m
        horizontalspeed_error  # The error of horizontal speed. Standard deviation of horizontal speed error (1 sigma). unit : m/s
        verticalspeed_error  # The error of vertical speed. Standard deviation of vertical speed error (1 sigma). unit : m/s
        heading_error  # The error of heading. Standard deviation of heading error (1 sigma). unit : deg
    VamRecipeDownloaded_EventData: category=STRUCTURE, type-emitter=TYPE_EMITTER_ARA
      namespaces:
        symbol props Vehicle
        symbol props DPM
        symbol props Policy
      cpp implementation data type element newVersion: type-reference={inplace=false, type-reference=uint32_t}
      cpp implementation data type element policyType: type-reference={inplace=false, type-reference=uint32_t}
    VarError: compu {texttable}, range raw 0..2, type-emitter=TYPE_EMITTER_ARA, type-reference=uint32_t
      namespaces:
        symbol props DCU
        symbol props System
        symbol props Variation
    VarError: compu {texttable}, range raw 0..2, type-emitter=TYPE_EMITTER_ARA, type-reference=uint32_t
      namespaces:
        symbol props DCU
        symbol props System
        symbol props Time
    VarError: compu {texttable}, range raw 0..2, type-emitter=TYPE_EMITTER_ARA, type-reference=uint32_t
      namespaces:
        symbol props DCU
        symbol props System
        symbol props PowerManagement
    VariationInfo: compu {texttable}, range raw 0..3, type-emitter=TYPE_EMITTER_ARA, type-reference=uint32_t
      namespaces:
        symbol props DCU
        symbol props System
        symbol props Variation
    VariationInfo: compu {texttable}, range raw 0..3, type-emitter=TYPE_EMITTER_ARA, type-reference=uint32_t
      namespaces:
        symbol props DCU
        symbol props System
        symbol props Time
    VariationInfo: compu {texttable}, range raw 0..3, type-emitter=TYPE_EMITTER_ARA, type-reference=uint32_t
      namespaces:
        symbol props DCU
        symbol props System
        symbol props PowerManagement
    VccPolicyDownloaded_EventData: category=STRUCTURE, type-emitter=TYPE_EMITTER_ARA
      namespaces:
        symbol props Vehicle
        symbol props DPM
        symbol props Policy
      cpp implementation data type element newVersion: type-reference={inplace=false, type-reference=uint32_t}
    VccStatsMask: category=ASSOCIATIVE_MAP, template-arguments=[{category=ASSOC_MAP_KEY, template-type=uint8_t}, {category=ASSOC_MAP_VALUE, template-type=uint16_t}], type-emitter=TYPE_EMITTER_ARA
      namespaces:
        symbol props Vehicle
        symbol props Vcc
        symbol props Policy
    VdcPolicyDownloaded_EventData: category=STRUCTURE, type-emitter=TYPE_EMITTER_ARA
      namespaces:
        symbol props Vehicle
        symbol props DPM
        symbol props Policy
      cpp implementation data type element newVersion: type-reference={inplace=false, type-reference=uint32_t}
      cpp implementation data type element policyType: type-reference={inplace=false, type-reference=uint32_t}
    VersionInfo: category=STRUCTURE, type-emitter=TYPE_EMITTER_ARA
      namespaces:
        symbol props Vehicle
        symbol props IPCHandler
        symbol props RoutingIPC
      6 x cpp implementation data type element, all with type-reference={inplace=false, type-reference=String}:
        hwVersion
        oemHwVersion
        oemSwVersion
        mcuSwVersion
        canDbVersion
        ethDbVersion
    Video_Thumbnail_Index: compu {texttable}, range raw 0..3, type-emitter=TYPE_EMITTER_ARA, type-reference=uint32_t
      namespaces:
        symbol props BltnCam
        symbol props DrivingEvent
        symbol props Manager
    Video_Thumbnail_Index: compu {texttable}, range raw 0..3, type-emitter=TYPE_EMITTER_ARA, type-reference=uint32_t
      namespaces:
        symbol props BltnCam
        symbol props ParkingEvent
        symbol props Manager
    VoLTEMode: compu {texttable}, range raw 0..2, type-emitter=TYPE_EMITTER_ARA, type-reference=uint32_t
      namespaces:
        symbol props DCU
        symbol props Telephony
        symbol props ModemManager
    VoLTEModeError: compu {texttable}, range raw 0..1, type-emitter=TYPE_EMITTER_ARA, type-reference=uint32_t
      namespaces:
        symbol props DCU
        symbol props Telephony
        symbol props ModemManager
    VoiceCallMode: compu {texttable}, range raw 0..4, type-emitter=TYPE_EMITTER_ARA, type-reference=uint32_t
      namespaces:
        symbol props DCU
        symbol props Telephony
        symbol props VoiceCallManager
    VoiceCallSession: category=STRUCTURE, type-emitter=TYPE_EMITTER_ARA
      namespaces:
        symbol props DCU
        symbol props Telephony
        symbol props VoiceCallManager
      5 x cpp implementation data type element:
        cid: type-reference={inplace=false, type-reference=String}
        number: type-reference={inplace=false, type-reference=String}
        status: type-reference={inplace=false, type-reference=VoiceCallStatus}
        mode: type-reference={inplace=false, type-reference=VoiceCallMode}
        disconnectReason: type-reference={inplace=false, type-reference=uint32_t}
    VoiceCallStatus: compu {texttable}, range raw 0..5, type-emitter=TYPE_EMITTER_ARA, type-reference=uint32_t
      namespaces:
        symbol props DCU
        symbol props Telephony
        symbol props VoiceCallManager
    WHL_01_10ms_EventData: category=STRUCTURE, type-emitter=TYPE_EMITTER_ARA
      namespaces:
        symbol props Vehicle
        symbol props SOAAdaptor
        symbol props Chassis
      cpp implementation data type element pdu: type-reference={inplace=false, type-reference=WHL_01_10ms_pdu_VECTOR}
    WHL_01_10ms_pdu_VECTOR: category=VECTOR, cpp-template-argument=uint8_t, type-emitter=TYPE_EMITTER_ARA
      namespaces:
        symbol props Vehicle
        symbol props SOAAdaptor
        symbol props Chassis
    WakeupRemotePhys_ports_VECTOR: category=VECTOR, cpp-template-argument=PortID, type-emitter=TYPE_EMITTER_ARA
      namespaces:
        symbol props Vehicle
        symbol props EthHandler
        symbol props EthernetSwitchMgr
    WhatsNewContentInfo: category=STRUCTURE, type-emitter=TYPE_EMITTER_ARA
      namespaces:
        symbol props Info
        symbol props Update
        symbol props InteractionManager
      6 x cpp implementation data type element:
        Language: type-reference={inplace=false, type-reference=uint8_t}
        UpdateDetailsTitle: type-reference={inplace=false, type-reference=String}
        QRCode: type-reference={inplace=false, type-reference=String}
        UpdatedEventVersion: type-reference={inplace=false, type-reference=String}
        ItemContentsMap: type-reference={inplace=false, type-reference=CPP/KeyValueMap}
        ImageMap: type-reference={inplace=false, type-reference=ByteMap}
    WhatsNewContents: category=STRUCTURE, type-emitter=TYPE_EMITTER_ARA
      namespaces:
        symbol props CCU
        symbol props Update
        symbol props Screen
      4 x cpp implementation data type element:
        language: type-reference={inplace=false, type-reference=uint8_t}
        updateDetailsTitle: type-reference={inplace=false, type-reference=String}  # Major Update list
        qrCode: type-reference={inplace=false, type-reference=String}
        items: type-reference={inplace=false, type-reference=ItemContentsMap}  # "contents":"title1 \n title2 \n title3 \n＂
    WireOutput: category=STRUCTURE, type-emitter=TYPE_EMITTER_ARA
      namespaces:
        symbol props Vehicle
        symbol props ApSysMgr
        symbol props IOManager
      cpp implementation data type element keys: type-reference={inplace=false, type-reference=CPP/WireOutputKey}
      cpp implementation data type element state: type-reference={inplace=false, type-reference=bool}
    WireOutput: category=STRUCTURE, type-emitter=TYPE_EMITTER_ARA
      namespaces:
        symbol props Vehicle
        symbol props IPCHandler
        symbol props RoutingIPC
      cpp implementation data type element keys: type-reference={inplace=false, type-reference=CPP/WireOutputKey}
      cpp implementation data type element state: type-reference={inplace=false, type-reference=bool}
    WireOutputKey: compu {texttable}, range raw 0..15, type-emitter=TYPE_EMITTER_ARA, type-reference=uint32_t
      namespaces:
        symbol props Vehicle
        symbol props ApSysMgr
        symbol props IOManager
    WireOutputKey: compu {texttable}, range raw 0..15, type-emitter=TYPE_EMITTER_ARA, type-reference=uint32_t
      namespaces:
        symbol props Vehicle
        symbol props IPCHandler
        symbol props RoutingIPC
    bool: category=VALUE
    double: category=VALUE
    float: category=VALUE
    int16_t: category=VALUE, type-emitter=cstdint
    int32_t: category=VALUE, type-emitter=cstdint
    int64_t: category=VALUE, type-emitter=cstdint
    int8_t: category=VALUE, type-emitter=cstdint
    svcGroupConnectionStatus_EventData: category=STRUCTURE, type-emitter=TYPE_EMITTER_ARA
      namespaces:
        symbol props Vehicle
        symbol props Vcc
        symbol props Manager
      cpp implementation data type element svcGroup: type-reference={inplace=false, type-reference=CPP/GroupTypes}
      cpp implementation data type element status: type-reference={inplace=false, type-reference=CPP/ConnectionStatus}
    uint16_t: category=VALUE, type-emitter=cstdint
    uint32_t: category=VALUE, type-emitter=cstdint
    uint64_t: category=VALUE, type-emitter=cstdint
    uint8_t: category=VALUE, type-emitter=cstdint
package /DataType/Semantics/CompuMethod
  compu method ActionType_CompuMethod: texttable
  compu method AddContextError_CompuMethod: texttable
  compu method AddContextError_CompuMethod: texttable
  compu method AddContextError_CompuMethod: texttable
  compu method AddContextError_CompuMethod: texttable
  compu method AddContextError_CompuMethod: texttable
  compu method AddContextError_CompuMethod: texttable
  compu method AddContextError_CompuMethod: texttable
  compu method AuthLevelType_CompuMethod: texttable
  compu method CANStatus_CompuMethod: texttable
  compu method CANStatus_CompuMethod: texttable
  compu method CANStatus_CompuMethod: texttable
  compu method CANStatus_CompuMethod: texttable
  compu method CANStatus_CompuMethod: texttable
  compu method CANStatus_CompuMethod: texttable
  compu method CCHTTPError_CompuMethod: texttable
  compu method CCHTTPMethod_CompuMethod: texttable
  compu method CCHTTPMethod_CompuMethod: texttable
  compu method CCResult_CompuMethod: texttable
  compu method CCResult_CompuMethod: texttable
  compu method CCResult_CompuMethod: texttable
  compu method CCServiceGroup_CompuMethod: texttable
  compu method CCServiceGroup_CompuMethod: texttable
  compu method CanNetStatus_CompuMethod: texttable
  compu method ClientType_CompuMethod: texttable
  compu method ConnectionStatus_CompuMethod: texttable
  compu method ConnectionStatus_CompuMethod: texttable
  compu method Connectivity_CompuMethod: texttable
  compu method ContextError_CompuMethod: texttable
  compu method ContextError_CompuMethod: texttable
  compu method ContextError_CompuMethod: texttable
  compu method ContextError_CompuMethod: texttable
  compu method ContextError_CompuMethod: texttable
  compu method ContextError_CompuMethod: texttable
  compu method ContextError_CompuMethod: texttable
  compu method ContextError_CompuMethod: texttable
  compu method ContextIndex_CompuMethod: texttable
  compu method ContextIndex_CompuMethod: texttable
  compu method ContextIndex_CompuMethod: texttable
  compu method ContextIndex_CompuMethod: texttable
  compu method ContextIndex_CompuMethod: texttable
  compu method ContextIndex_CompuMethod: texttable
  compu method ContextIndex_CompuMethod: texttable
  compu method ContextStatus_CompuMethod: texttable
  compu method ContextStatus_CompuMethod: texttable
  compu method ContextStatus_CompuMethod: texttable
  compu method ContextStatus_CompuMethod: texttable
  compu method ContextStatus_CompuMethod: texttable
  compu method ContextStatus_CompuMethod: texttable
  compu method ContextStatus_CompuMethod: texttable
  compu method CrankInhibitStatus_CompuMethod: texttable
  compu method DCanNetStatus_CompuMethod: texttable
  compu method DeactivateReason_CompuMethod: texttable
  compu method DeactivateReason_CompuMethod: texttable
  compu method DeactivateReason_CompuMethod: texttable
  compu method DeactivateReason_CompuMethod: texttable
  compu method DeactivateReason_CompuMethod: texttable
  compu method DeactivateReason_CompuMethod: texttable
  compu method DeactivateReason_CompuMethod: texttable
  compu method DiagResponseType_CompuMethod: texttable
  compu method DiagResponseType_CompuMethod: texttable
  compu method DiagSessionType_CompuMethod: texttable
  compu method DiagSessionType_CompuMethod: texttable
  compu method DiagnosticError_CompuMethod: texttable
  compu method DiagnosticError_CompuMethod: texttable
  compu method DiagnosticError_CompuMethod: texttable
  compu method EndpointType_CompuMethod: texttable
  compu method EndpointType_CompuMethod: texttable
  compu method ErrCode_CompuMethod: texttable
  compu method ErrCode_CompuMethod: texttable
  compu method Error_CompuMethod: texttable
  compu method EventStatus_CompuMethod: texttable
  compu method GetContextError_CompuMethod: texttable
  compu method GetContextError_CompuMethod: texttable
  compu method GetContextError_CompuMethod: texttable
  compu method GetContextError_CompuMethod: texttable
  compu method GetContextError_CompuMethod: texttable
  compu method GetContextError_CompuMethod: texttable
  compu method GetContextError_CompuMethod: texttable
  compu method GroupTypes_CompuMethod: texttable
  compu method GroupTypes_CompuMethod: texttable
  compu method InfrastructureEnvironments_CompuMethod: texttable
  compu method LogServerError_CompuMethod: texttable
  compu method LogServerError_CompuMethod: texttable
  compu method LogServerStatus_CompuMethod: texttable
  compu method LogServerStatus_CompuMethod: texttable
  compu method LogStatus_CompuMethod: texttable
  compu method LogStatus_CompuMethod: texttable
  compu method LogStatuss_CompuMethod: texttable
  compu method LogStatuss_CompuMethod: texttable
  compu method LogTransferError_CompuMethod: texttable
  compu method LogTransferError_CompuMethod: texttable
  compu method LogType_CompuMethod: texttable
  compu method LogType_CompuMethod: texttable
  compu method MapmatchingType_CompuMethod: texttable
  compu method MapmatchingType_CompuMethod: texttable
  compu method MessageError_CompuMethod: texttable
  compu method MessageStatus_CompuMethod: texttable
  compu method MessageStatus_CompuMethod: texttable
  compu method ModemPowerStatus_CompuMethod: texttable
  compu method ModemPowerStatus_CompuMethod: texttable
  compu method ModuleState_CompuMethod: texttable
  compu method NetworkRequest_CompuMethod: texttable
  compu method OperState_CompuMethod: texttable
  compu method OperState_CompuMethod: texttable
  compu method OperState_CompuMethod: texttable
  compu method PackageManagerStatusType_CompuMethod: texttable
  compu method PowerStatus_CompuMethod: texttable
  compu method PowerStatus_CompuMethod: texttable
  compu method PowerStatus_CompuMethod: texttable
  compu method ProtocolTypes_CompuMethod: texttable
  compu method ProvisioningStatus_CompuMethod: texttable
  compu method ProvisioningStatus_CompuMethod: texttable
  compu method Ready_CompuMethod: texttable
  compu method Ready_CompuMethod: texttable
  compu method RemoveContextError_CompuMethod: texttable
  compu method RemoveContextError_CompuMethod: texttable
  compu method RemoveContextError_CompuMethod: texttable
  compu method RemoveContextError_CompuMethod: texttable
  compu method RemoveContextError_CompuMethod: texttable
  compu method RemoveContextError_CompuMethod: texttable
  compu method RemoveContextError_CompuMethod: texttable
  compu method RequestError_CompuMethod: texttable
  compu method RequestError_CompuMethod: texttable
  compu method RequestError_CompuMethod: texttable
  compu method RequestError_CompuMethod: texttable
  compu method ResultType_CompuMethod: texttable
  compu method Result_CompuMethod: texttable
  compu method Result_CompuMethod: texttable
  compu method Result_CompuMethod: texttable
  compu method Result_CompuMethod: texttable
  compu method Result_CompuMethod: texttable
  compu method Result_CompuMethod: texttable
  compu method Result_CompuMethod: texttable
  compu method RollbackResultType_CompuMethod: texttable
  compu method SecurityLevelType_CompuMethod: texttable
  compu method SetContextIndexError_CompuMethod: texttable
  compu method SetContextIndexError_CompuMethod: texttable
  compu method SetContextIndexError_CompuMethod: texttable
  compu method SetContextIndexError_CompuMethod: texttable
  compu method SetContextIndexError_CompuMethod: texttable
  compu method SetContextIndexError_CompuMethod: texttable
  compu method SetContextIndexError_CompuMethod: texttable
  compu method SetError_CompuMethod: texttable
  compu method SetError_CompuMethod: texttable
  compu method SetError_CompuMethod: texttable
  compu method SetError_CompuMethod: texttable
  compu method SetError_CompuMethod: texttable
  compu method SetError_CompuMethod: texttable
  compu method SetPropertyError_CompuMethod: texttable
  compu method SetPropertyError_CompuMethod: texttable
  compu method SetPropertyError_CompuMethod: texttable
  compu method SetPropertyError_CompuMethod: texttable
  compu method SetPropertyError_CompuMethod: texttable
  compu method SetPropertyError_CompuMethod: texttable
  compu method SetPropertyError_CompuMethod: texttable
  compu method SetPropertyError_CompuMethod: texttable
  compu method SetPropertyError_CompuMethod: texttable
  compu method SetPropertyError_CompuMethod: texttable
  compu method SetPropertyError_CompuMethod: texttable
  compu method SignalStrengthType_CompuMethod: texttable
  compu method SwClusterStateType_CompuMethod: texttable
  compu method SwClusterStateType_CompuMethod: texttable
  compu method SwClusterStateType_CompuMethod: texttable
  compu method SwPackageStateType_CompuMethod: texttable
  compu method SwUnitResultType_CompuMethod: texttable
  compu method SysCtrlReq_CompuMethod: texttable
  compu method SysCtrlReq_CompuMethod: texttable
  compu method SysCtrlReq_CompuMethod: texttable
  compu method SysCtrlReq_CompuMethod: texttable
  compu method SysCtrlReq_CompuMethod: texttable
  compu method SysCtrlReq_CompuMethod: texttable
  compu method SysCtrlReq_CompuMethod: texttable
  compu method SysCtrlReq_CompuMethod: texttable
  compu method SysCtrlReq_CompuMethod: texttable
  compu method SysCtrlReq_CompuMethod: texttable
  compu method SysCtrlReq_CompuMethod: texttable
  compu method SystemBootReason_CompuMethod: texttable
  compu method SystemBootReason_CompuMethod: texttable
  compu method SystemBootReason_CompuMethod: texttable
  compu method SystemBootReason_CompuMethod: texttable
  compu method SystemBootReason_CompuMethod: texttable
  compu method SystemBootReason_CompuMethod: texttable
  compu method TimeMode_CompuMethod: texttable
  compu method TimeMode_CompuMethod: texttable
  compu method TimeMode_CompuMethod: texttable
  compu method TimeSource_CompuMethod: texttable
  compu method TransferError_CompuMethod: texttable
  compu method TransferError_CompuMethod: texttable
  compu method VarError_CompuMethod: texttable
  compu method VarError_CompuMethod: texttable
  compu method VariationInfo_CompuMethod: texttable
  compu method VariationInfo_CompuMethod: texttable
  compu method Video_Thumbnail_Index_CompuMethod: texttable
  compu method WireOutputKey_CompuMethod: texttable
package /DataType/Semantics/DataConstr
  range ActionType_DataConstr: raw 0..2
  range AddContextError_DataConstr: raw 0..3
  range AddContextError_DataConstr: raw 0..3
  range AddContextError_DataConstr: raw 0..3
  range AddContextError_DataConstr: raw 0..3
  range AddContextError_DataConstr: raw 0..3
  range AddContextError_DataConstr: raw 0..3
  range AddContextError_DataConstr: raw 0..3
  range AuthLevelType_DataConstr: raw 0..1
  range CANStatus_DataConstr: raw 0..1
  range CANStatus_DataConstr: raw 0..1
  range CANStatus_DataConstr: raw 0..1
  range CANStatus_DataConstr: raw 0..1
  range CANStatus_DataConstr: raw 0..1
  range CANStatus_DataConstr: raw 0..1
  range CCHTTPError_DataConstr: raw 0..10
  range CCHTTPMethod_DataConstr: raw 0..4
  range CCHTTPMethod_DataConstr: raw 0..4
  range CCResult_DataConstr: raw 0..15
  range CCResult_DataConstr: raw 0..15
  range CCResult_DataConstr: raw 0..15
  range CCServiceGroup_DataConstr: raw 0..10
  range CCServiceGroup_DataConstr: raw 0..11
  range CanNetStatus_DataConstr: raw 0..5
  range ClientType_DataConstr: raw 0..7
  range ConnectionStatus_DataConstr: raw 0..2
  range ConnectionStatus_DataConstr: raw 0..2
  range Connectivity_DataConstr: raw 0..1
  range ContextError_DataConstr: raw 0..3
  range ContextError_DataConstr: raw 0..3
  range ContextError_DataConstr: raw 0..3
  range ContextError_DataConstr: raw 0..3
  range ContextError_DataConstr: raw 0..3
  range ContextError_DataConstr: raw 0..3
  range ContextError_DataConstr: raw 0..3
  range ContextError_DataConstr: raw 0..3
  range ContextIndex_DataConstr: raw 0..4
  range ContextIndex_DataConstr: raw 0..4
  range ContextIndex_DataConstr: raw 0..4
  range ContextIndex_DataConstr: raw 0..4
  range ContextIndex_DataConstr: raw 0..4
  range ContextIndex_DataConstr: raw 0..4
  range ContextIndex_DataConstr: raw 0..4
  range ContextStatus_DataConstr: raw 0..2
  range ContextStatus_DataConstr: raw 0..2
  range ContextStatus_DataConstr: raw 0..2
  range ContextStatus_DataConstr: raw 0..2
  range ContextStatus_DataConstr: raw 0..2
  range ContextStatus_DataConstr: raw 0..2
  range ContextStatus_DataConstr: raw 0..2
  range CrankInhibitStatus_DataConstr: raw 0..3
  range DCanNetStatus_DataConstr: raw 0..3
  range DeactivateReason_DataConstr: raw 0..12
  range DeactivateReason_DataConstr: raw 0..12
  range DeactivateReason_DataConstr: raw 0..12
  range DeactivateReason_DataConstr: raw 0..12
  range DeactivateReason_DataConstr: raw 0..12
  range DeactivateReason_DataConstr: raw 0..12
  range DeactivateReason_DataConstr: raw 0..12
  range DiagResponseType_DataConstr: raw 0..2
  range DiagResponseType_DataConstr: raw 0..255
  range DiagSessionType_DataConstr: raw 1..3
  range DiagSessionType_DataConstr: raw 0..2
  range DiagnosticError_DataConstr: raw 0..3
  range DiagnosticError_DataConstr: raw 0..3
  range DiagnosticError_DataConstr: raw 0..3
  range EndpointType_DataConstr: raw 0..2
  range EndpointType_DataConstr: raw 0..2
  range ErrCode_DataConstr: raw 0..9
  range ErrCode_DataConstr: raw 0..2
  range Error_DataConstr: raw 0..2
  range EventStatus_DataConstr: raw 0..3
  range GetContextError_DataConstr: raw 0..3
  range GetContextError_DataConstr: raw 0..3
  range GetContextError_DataConstr: raw 0..3
  range GetContextError_DataConstr: raw 0..3
  range GetContextError_DataConstr: raw 0..3
  range GetContextError_DataConstr: raw 0..3
  range GetContextError_DataConstr: raw 0..3
  range GroupTypes_DataConstr: raw 0..11
  range GroupTypes_DataConstr: raw 0..11
  range InfrastructureEnvironments_DataConstr: raw 0..3
  range LogServerError_DataConstr: raw 0..2
  range LogServerError_DataConstr: raw 0..2
  range LogServerStatus_DataConstr: raw 0..3
  range LogServerStatus_DataConstr: raw 0..3
  range LogStatus_DataConstr: raw 0..5
  range LogStatus_DataConstr: raw 0..5
  range LogStatuss_DataConstr: raw 0..5
  range LogStatuss_DataConstr: raw 0..5
  range LogTransferError_DataConstr: raw 0..1
  range LogTransferError_DataConstr: raw 0..1
  range LogType_DataConstr: raw 0..2
  range LogType_DataConstr: raw 0..2
  range MapmatchingType_DataConstr: raw 0..2
  range MapmatchingType_DataConstr: raw 0..2
  range MessageError_DataConstr: raw 0..3
  range MessageStatus_DataConstr: raw 0..1
  range MessageStatus_DataConstr: raw 0..1
  range ModemPowerStatus_DataConstr: raw 0..2
  range ModemPowerStatus_DataConstr: raw 0..2
  range ModuleState_DataConstr: raw 0..2
  range NetworkRequest_DataConstr: raw 0..2
  range OperState_DataConstr: raw 0..6
  range OperState_DataConstr: raw 0..6
  range OperState_DataConstr: raw 0..6
  range PackageManagerStatusType_DataConstr: raw 0..8
  range PowerStatus_DataConstr: raw 0..5
  range PowerStatus_DataConstr: raw 0..5
  range PowerStatus_DataConstr: raw 0..7
  range ProtocolTypes_DataConstr: raw 0..2
  range ProvisioningStatus_DataConstr: raw 0..8
  range ProvisioningStatus_DataConstr: raw 0..8
  range Ready_DataConstr: raw 0..1
  range Ready_DataConstr: raw 0..1
  range RemoveContextError_DataConstr: raw 0..5
  range RemoveContextError_DataConstr: raw 0..5
  range RemoveContextError_DataConstr: raw 0..5
  range RemoveContextError_DataConstr: raw 0..5
  range RemoveContextError_DataConstr: raw 0..5
  range RemoveContextError_DataConstr: raw 0..5
  range RemoveContextError_DataConstr: raw 0..5
  range RequestError_DataConstr: raw 0..3
  range RequestError_DataConstr: raw 0..3
  range RequestError_DataConstr: raw 0..3
  range RequestError_DataConstr: raw 0..2
  range ResultType_DataConstr: raw 0..1
  range Result_DataConstr: raw 0..2
  range Result_DataConstr: raw 0..1
  range Result_DataConstr: raw 0..3
  range Result_DataConstr: raw 0..3
  range Result_DataConstr: raw 0..3
  range Result_DataConstr: raw 0..15
  range Result_DataConstr: raw 0..3
  range RollbackResultType_DataConstr: raw 0..3
  range SecurityLevelType_DataConstr: raw 0..2
  range SetContextIndexError_DataConstr: raw 0..6
  range SetContextIndexError_DataConstr: raw 0..6
  range SetContextIndexError_DataConstr: raw 0..6
  range SetContextIndexError_DataConstr: raw 0..6
  range SetContextIndexError_DataConstr: raw 0..6
  range SetContextIndexError_DataConstr: raw 0..6
  range SetContextIndexError_DataConstr: raw 0..6
  range SetError_DataConstr: raw 0..2
  range SetError_DataConstr: raw 0..2
  range SetError_DataConstr: raw 0..2
  range SetError_DataConstr: raw 0..2
  range SetError_DataConstr: raw 0..3
  range SetError_DataConstr: raw 0..2
  range SetPropertyError_DataConstr: raw 0..3
  range SetPropertyError_DataConstr: raw 0..5
  range SetPropertyError_DataConstr: raw 0..5
  range SetPropertyError_DataConstr: raw 0..5
  range SetPropertyError_DataConstr: raw 0..5
  range SetPropertyError_DataConstr: raw 0..3
  range SetPropertyError_DataConstr: raw 0..5
  range SetPropertyError_DataConstr: raw 0..3
  range SetPropertyError_DataConstr: raw 0..3
  range SetPropertyError_DataConstr: raw 0..5
  range SetPropertyError_DataConstr: raw 0..5
  range SignalStrengthType_DataConstr: raw 0..3
  range SwClusterStateType_DataConstr: raw 0..3
  range SwClusterStateType_DataConstr: raw 0..3
  range SwClusterStateType_DataConstr: raw 0..3
  range SwPackageStateType_DataConstr: raw 0..4
  range SwUnitResultType_DataConstr: raw 0..3
  range SysCtrlReq_DataConstr: raw 0..5
  range SysCtrlReq_DataConstr: raw 0..5
  range SysCtrlReq_DataConstr: raw 0..5
  range SysCtrlReq_DataConstr: raw 0..5
  range SysCtrlReq_DataConstr: raw 0..5
  range SysCtrlReq_DataConstr: raw 0..5
  range SysCtrlReq_DataConstr: raw 0..5
  range SysCtrlReq_DataConstr: raw 0..5
  range SysCtrlReq_DataConstr: raw 0..5
  range SysCtrlReq_DataConstr: raw 0..6
  range SysCtrlReq_DataConstr: raw 0..5
  range SystemBootReason_DataConstr: raw 0..3
  range SystemBootReason_DataConstr: raw 0..4
  range SystemBootReason_DataConstr: raw 0..4
  range SystemBootReason_DataConstr: raw 0..3
  range SystemBootReason_DataConstr: raw 0..3
  range SystemBootReason_DataConstr: raw 0..4
  range TimeMode_DataConstr: raw 0..2
  range TimeMode_DataConstr: raw 0..1
  range TimeMode_DataConstr: raw 0..1
  range TimeSource_DataConstr: raw 0..3
  range TransferError_DataConstr: raw 0..5
  range TransferError_DataConstr: raw 0..5
  range VarError_DataConstr: raw 0..2
  range VarError_DataConstr: raw 0..2
  range VariationInfo_DataConstr: raw 0..3
  range VariationInfo_DataConstr: raw 0..3
  range Video_Thumbnail_Index_DataConstr: raw 0..3
  range WireOutputKey_DataConstr: raw 0..15
package /PortInterface/Service
  114 x service interface:
    APNManager: major-version=1, minor-version=0
      namespaces:
        symbol props Vehicle
        symbol props MSM
        symbol props APNManager
      events:
        data APNConnectionStatus: type=APNConnectionStatus_EventData
        data APNInfo: type=APNInfo_EventData
      methods:
        operation GetAPNInformation
          arg apn: type=String, direction=IN
          arg information: type=APNInformation, direction=OUT
        operation GetAPNStatus
          arg apn: type=String, direction=IN
          arg status: type=APNStatus, direction=OUT
        operation SetActivateAPN
          arg activate: type=bool, direction=IN
          arg apnType: type=ActivateAPNType, direction=IN
          arg result: type=CPP/Result, direction=OUT
    ASKMaster: major-version=1, minor-version=0
      namespaces:
        symbol props Vehicle
        symbol props Security
        symbol props ASKMaster
      methods:
        operation ASKMasterVersion
          arg version: type=uint32_t, direction=OUT
        operation GenerateKey
          4 x arg:
            seed: type=ByteArray, direction=IN
            ecuCode: type=ByteArray, direction=IN
            err: type=ASKErrCode, direction=OUT
            key: type=ByteArray, direction=OUT
    ActivationManager: major-version=1, minor-version=0
      namespaces:
        symbol props Vehicle
        symbol props FoDClient
        symbol props ActivationManager
      methods:
        operation RequestRoutineControl  # FoD RoutineControl Service Only when ack is OK, res is valid
          4 x arg:
            rid: type=uint16_t, direction=IN
            req: type=ByteArray, direction=IN
            ack: type=FodResponse, direction=OUT
            res: type=ByteArray, direction=OUT
    Body1: major-version=1, minor-version=4
      namespaces:
        symbol props Vehicle
        symbol props SOAAdaptor
        symbol props Body1
      216 x field, all with has-getter=true, has-notifier=true, has-setter=false:
        ACPrioState: type=CPP/SignalInfo_UInt8  # ACPrioSta_FD
        AlarmStatus: type=CPP/SignalInfo_UInt8  # BAlarm_BglrAlrm_CurrentSta
        AsstDoorSwitchState: type=CPP/SignalInfo_UInt8  # Warn_AsstDrSwSta
        AsstDoorSwitchState_SBCM: type=CPP/SignalInfo_UInt8  # Warn_AsstDrSwSta_SBCM
        AsstDoorUnLockState: type=CPP/SignalInfo_UInt8  # DoorLock_AsstDrUnLkSta
        AsstDoorUnLockState_SBCM: type=CPP/SignalInfo_UInt8  # DoorLock_AsstDrUnLkSta_SBCM
        AsstWindowOpenState: type=CPP/SignalInfo_UInt8  # Window_AsstSdWdwSta_BCM
        AsstWindowOpenState_Detail: type=CPP/SignalInfo_UInt8  # Window_AsstSdWdwDetailOpnSta
        AsstWindowState: type=CPP/SignalInfo_UInt8  # Window_AsstSdWdwActSta
        AstDrReleaseInsideSwEnable: type=CPP/SignalInfo_UInt8  # VAPI_AstRlsInsdSwEn_Get
        AstSeatHeatVentIndCmd: type=CPP/SignalInfo_UInt8  # SHV_AstSeatHeatVentIndCmd
        AstSeatIntgFeedback: type=CPP/SignalInfo_UInt8  # Swivel_AstSeatIntgFeedback
        AutoExteriorLightState: type=CPP/SignalInfo_UInt8  # Lamp_AutoLtSnsrNightSta
        AvgCurrAtReset: type=SignalInfo_Int32  # PDC_AvgCurrAtReset
        BPCM_Ast_IndCmd: type=CPP/SignalInfo_UInt8
        BPCM_Drv_IndCmd: type=CPP/SignalInfo_UInt8
        BPCM_FrontOptTypInfo: type=CPP/SignalInfo_UInt8
        BPCM_HeatGlsOptTypInfo: type=CPP/SignalInfo_UInt8
        BPCM_HeatGls_IndCmd: type=CPP/SignalInfo_UInt8
        BPCM_RL_IndCmd: type=CPP/SignalInfo_UInt8
        BPCM_RR_IndCmd: type=CPP/SignalInfo_UInt8
        BPCM_RearOptTypInfo: type=CPP/SignalInfo_UInt8
        BatteryDischargeWarningState: type=CPP/SignalInfo_UInt8  # ICU_BattMngAlert
        BatteryEmergencyState: type=CPP/SignalInfo_UInt8  # xEV_BatEvtAlarm_HS
        BatteryPowerState: type=CPP/SignalInfo_UInt8  # PDC_BatPwrStateClassC
        BatterySOCValue: type=CPP/SignalInfo_UInt8  # ICU_BS2SoC
        BatteryStateOfChargeState: type=CPP/SignalInfo_UInt8  # ICU_SoCBattStaMsgReq
        BatteryStateOfChargeWarningValue: type=CPP/SignalInfo_UInt8  # Batt_SoCWarningValue
        BatteryTemperature: type=CPP/SignalInfo_Float  # ICU_BS1BatTemp
        BatteryVoltage: type=CPP/SignalInfo_Float  # ICU_BS2OpnCirVol
        BatteryWarningState: type=CPP/SignalInfo_UInt8  # ICU_BattAutoCutPreWrng
        BckGls_RrGlsHtdOpt: type=CPP/SignalInfo_UInt8
        BrakeFluidSwitchState: type=CPP/SignalInfo_UInt8  # Warn_BrkFldSwSta
        CDMOpenState: type=CPP/SignalInfo_UInt8  # CDM_HS_OpnClsState
        CDMOptionType: type=CPP/SignalInfo_UInt8  # CDM_HS_OptTyp
        CDMOptionType_SBCM: type=CPP/SignalInfo_UInt8  # CDM_TypeOption
        CDMWarningInfo: type=CPP/SignalInfo_UInt8  # CDM_HS_WarnMsg
        CDMWarningInfo_SBCM: type=CPP/SignalInfo_UInt8  # CDM_WarnMsg_SBCM
        CMDState: type=CPP/SignalInfo_UInt8  # CDM_OpnClsState_SBCM
        CMSOptionInfo: type=CPP/SignalInfo_UInt8  # CMS_Opt
        CargoFreezerConnectionStatus: type=CPP/SignalInfo_UInt8  # ACConnSta_FD
        CargoFreezerCurrentTemp: type=CPP/SignalInfo_Float  # ACCurTemp_1_FD
        CargoFreezerSetTemp: type=CPP/SignalInfo_Int8  # CC_ACSetTemp_FD
        CargoFreezerState: type=CPP/SignalInfo_UInt8  # CC_ACSetSta_FD
        CoachTypeOption_DRV: type=CPP/SignalInfo_UInt8  # Coach_TypeOption_DRV
        CtrDrLkUnLkSwEnable: type=CPP/SignalInfo_UInt8  # VAPI_CtrDrLkUnLkSwEnable_Get
        CtrlDrLockRlyCCS_BDC: type=CPP/SignalInfo_UInt8  # DoorLock_CtrlDrLockRlyCCS_BDC
        CumulativeCountOf12VReq: type=CPP/SignalInfo_UInt16  # PDC_CumulativeCountOf12VReq
        CumulativeCountOfCCUReq: type=CPP/SignalInfo_UInt16  # PDC_CumulativeCountOfCCUReq
        CurrAtReset: type=SignalInfo_Int32  # PDC_CurrAtReset
        CurrentValueForReset: type=CPP/SignalInfo_UInt16  # PDC_CurrentValueForReset
        DeliveryModeState: type=CPP/SignalInfo_UInt8  # Autocut_DlvryModSta
        DigitalKeyOptionInfo: type=CPP/SignalInfo_UInt8  # IAU_DigitalKey2Opt
        DirectTypeTPMSOptStatus: type=CPP/SignalInfo_UInt8  # TPMS_DirectTypeAppliedSta
        DoorLockPsvDrLkReq: type=CPP/SignalInfo_UInt8  # DoorLock_PsvDrLkReq
        DriveTypeOptionInfo: type=CPP/SignalInfo_UInt8
        DrvDoorSwitchState: type=CPP/SignalInfo_UInt8  # Warn_DrvDrSwSta
        DrvDoorSwitchState_SBCM: type=CPP/SignalInfo_UInt8  # Warn_DrvDrSwSta_SBCM
        DrvDoorUnLockState: type=CPP/SignalInfo_UInt8  # DoorLock_DrvDrUnLkSta
        DrvDoorUnLockState_SBCM: type=CPP/SignalInfo_UInt8  # DoorLock_DrvDrUnLkSta_SBCM
        DrvDrReleaseInsideSwEnable: type=CPP/SignalInfo_UInt8  # VAPI_DrvRlsInsdSwEn_Get
        DrvSeatHeatVentIndCmd: type=CPP/SignalInfo_UInt8  # SHV_DrvSeatHeatVentIndCmd
        DrvSeatIntgFeedback: type=CPP/SignalInfo_UInt8  # Swivel_DrvSeatIntgFeedback
        DrvWindowOpenState: type=CPP/SignalInfo_UInt8  # Window_DrvrSdWdwSta_BCM
        DrvWindowOpenState_Detail: type=CPP/SignalInfo_UInt8  # Window_DrvrSdWdwDetailOpnSta
        DrvWindowState: type=CPP/SignalInfo_UInt8  # Window_DrvrSdWdwActSta
        EngineRunningByRequest: type=CPP/SignalInfo_UInt8  # SMK_TlEngRunSta
        EuroNACPOption: type=CPP/SignalInfo_UInt8  # ROA_RegionOpt
        FLTurnSignalLampOpenState: type=CPP/SignalInfo_UInt8  # Lamp_FrTrnSigLmpLftOpnSta
        FOBBatteryDischarged: type=CPP/SignalInfo_UInt8  # Fob_BattStaInfo
        FRTurnSignalLampOpenState: type=CPP/SignalInfo_UInt8  # Lamp_FrTrnSigLmpRtOpnSta
        FRTurnSignalLampSwitchState: type=CPP/SignalInfo_UInt8  # ExtLamp_TrnSigLmpRtSwSta
        FrontHeatedGlassState: type=CPP/SignalInfo_UInt8  # Wndshld_FrtGlsHtdOnCmd
        FrontSunroofState: type=CPP/SignalInfo_UInt8  # PDCex_FrtSunroofOpnSta
        GearPositionPState: type=CPP/SignalInfo_UInt8  # BCM_GearPosPSta
        HazardSwitchPushState: type=CPP/SignalInfo_UInt8  # HzrdSwPushSta
        HazardSwitchState: type=CPP/SignalInfo_UInt8  # ExtLamp_HzrdSwSta
        HighLampState: type=CPP/SignalInfo_UInt8  # Lamp_HdLmpHiOnReq
        HoodSwitchState: type=CPP/SignalInfo_UInt8  # Warn_HoodSwSta
        HoodSwitchState_SBCM: type=CPP/SignalInfo_UInt8  # Warn_HoodSwSta_SBCM
        HoodTypeOptionInfo: type=CPP/SignalInfo_UInt8  # Hood_TypeOption
        ICUDeliveryMode: type=CPP/SignalInfo_UInt8  # ICU_PowerAutoCutModSta
        ICUupdateEnable: type=CPP/SignalInfo_UInt8  # ICU_Update_Enable
        IGN3CutOffState: type=CPP/SignalInfo_UInt8
        LBMOptionInfo: type=CPP/SignalInfo_UInt8  # LBM_Option
        LHHighBeamLEDState: type=CPP/SignalInfo_UInt8  # ILCULH_HighBeamLED_Sta
        LHHighLampOpenState: type=CPP/SignalInfo_UInt8  # Lamp_HdLmpHiLftOpnSta
        LHLampBifuncOpenState: type=CPP/SignalInfo_UInt8  # Lamp_HdLmpBiFuncLftOpnSta
        LHLowBeamLEDState: type=CPP/SignalInfo_UInt8  # ILCULH_LowBeamLED_Sta
        LHLowLampOpenState: type=CPP/SignalInfo_UInt8  # Lamp_HdLmpLoLftOpnSta
        LHTurnSignalLampSwitchState: type=CPP/SignalInfo_UInt8  # ExtLamp_TrnSigLmpLftSwSta
        LampLeftSwitchStatusIBU: type=CPP/SignalInfo_UInt8  # Lamp_LtSwSta_IBU
        LatchTypeOptionInfo: type=CPP/SignalInfo_UInt8  # Latch_TypeOption_DRV
        LedLampState: type=CPP/SignalInfo_UInt8  # Lamp_LedHdLmpSta
        LeftTurnLampCmdState: type=CPP/SignalInfo_UInt8  # Lamp_LftTrnLmpCmdSta
        LftStopLampState: type=CPP/SignalInfo_UInt8  # Lamp_StpLmpLftOpnSta
        LithiumBatteryWarningState: type=CPP/SignalInfo_UInt8  # BmsFailWarning
        LowLampState: type=CPP/SignalInfo_UInt8  # Lamp_HdLmpLoOnReq
        MainLBMSocValue: type=CPP/SignalInfo_UInt8  # MainLBM_SocVal
        MoodLampDualColorOptSta: type=CPP/SignalInfo_UInt8  # MoodLamp_DualColorOptSta
        PDC_MainLBMoption: type=CPP/SignalInfo_UInt8  # PDC_MainLBMOpt
        PDCexCurtainOptionInform: type=CPP/SignalInfo_UInt8  # PDCex_CurtainOpt
        PDCexTailgateUnlockedStatus: type=CPP/SignalInfo_UInt8  # PDCex_TlgtUnLkSta
        PDSTypeOptionDRV: type=CPP/SignalInfo_UInt8  # PDS_TypeOption_DRV
        PHEV_FuelDrCtrlFlagInfo: type=CPP/SignalInfo_UInt8
        PSDInsideSwEnable: type=CPP/SignalInfo_UInt8  # VAPI_PSDInsideSwEnable_Get
        PSDOptLHRH: type=CPP/SignalInfo_UInt8  # C_PSDOptLHRH
        PTGDrvSideSwEnable: type=CPP/SignalInfo_UInt8  # VAPI_PTGDrvSideSwEnable_Get
        PTGInsideSwEnable: type=CPP/SignalInfo_UInt8  # VAPI_PTGInsideSwEnable_Get
        PTGM_TrnkTlgtOption: type=CPP/SignalInfo_UInt8
        PanicAlarmState: type=CPP/SignalInfo_UInt8  # BAlarm_PncAlrmSta
        ParkingPositionState: type=CPP/SignalInfo_UInt8  # SMK_GearPosPSwSta
        PlatformVersionDate: type=CPP/SignalInfo_UInt8  # BDC_PlatformVerDate
        PlatformVersionType: type=CPP/SignalInfo_UInt8  # BDC_PlatformVerType
        PowerWindowSWType: type=CPP/SignalInfo_UInt8  # Win_PwrWdwSwTyp
        PrkngBrkSwState: type=CPP/SignalInfo_UInt8  # Warn_PrkngBrkSwSta
        PwrOnMaintain: type=CPP/SignalInfo_UInt8  # VAPI_PwrOnMaintain_Get
        PwrTransEnable: type=CPP/SignalInfo_UInt8  # VAPI_PwrTransEnable_Get
        PwrWdwSwEnable: type=CPP/SignalInfo_UInt8  # VAPI_PwrWdwSwEnable_Get
        RDCTypeOption: type=CPP/SignalInfo_UInt8  # RDC_TypeOption
        RHHighBeamLEDState: type=CPP/SignalInfo_UInt8  # ILCURH_HighBeamLED_Sta
        RHHighLampOpenState: type=CPP/SignalInfo_UInt8  # Lamp_HdLmpHiRtOpnSta
        RHLampBifuncOpenState: type=CPP/SignalInfo_UInt8  # Lamp_HdLmpBiFuncRtOpnSta
        RHLowBeamLEDState: type=CPP/SignalInfo_UInt8  # ILCURH_LowBeamLED_Sta
        RHLowLampOpenState: type=CPP/SignalInfo_UInt8  # Lamp_HdLmpLoRtOpnSta
        RLCurtainPosition: type=CPP/SignalInfo_UInt8  # RL_CURTAIN_POSITION
        RLDoorSwitchState: type=CPP/SignalInfo_UInt8  # Warn_RrLftDrSwSta
        RLDoorSwitchState_SBCM: type=CPP/SignalInfo_UInt8  # Warn_RrLftDrSwSta_SBCM
        RLDoorUnLockState_SBCM: type=CPP/SignalInfo_UInt8  # DoorLock_RrLftDrUnLkSta_SBCM
        RLDoorUnlockState: type=CPP/SignalInfo_UInt8  # DoorLock_RrLftDrUnLkSta
        RLDrLkUnLkInsdSwEnable_Get: type=CPP/SignalInfo_UInt8  # VAPI_RLDrLkUnLkInsdSwEn_Get
        RLDrReleaseInsideSwEnable: type=CPP/SignalInfo_UInt8  # VAPI_RLRlsInsdSwEn_Get
        RLRrDoorCurtainPosition: type=CPP/SignalInfo_UInt8  # RLRrDrCurtainPosition
        RLTurnSignalLampOpenState: type=CPP/SignalInfo_UInt8  # Lamp_RrTrnSigLmpLftOpnSta
        RLWindowOpenState: type=CPP/SignalInfo_UInt8  # Window_RrLftWdwSta_BCM
        RLWindowOpenstate_Detail: type=CPP/SignalInfo_UInt8  # Window_RrLftWdwDetailOpnSta
        RLWindowState: type=CPP/SignalInfo_UInt8  # Window_RrLftWdwActSta
        ROAEnable: type=CPP/SignalInfo_UInt8  # VAPI_ROAEnable_Get
        RRCurtainPosition: type=CPP/SignalInfo_UInt8  # RR_CURTAIN_POSITION
        RRDoorSwitchState: type=CPP/SignalInfo_UInt8  # Warn_RrRtDrSwSta
        RRDoorSwitchState_SBCM: type=CPP/SignalInfo_UInt8  # Warn_RrRtDrSwSta_SBCM
        RRDoorUnLockState_SBCM: type=CPP/SignalInfo_UInt8  # DoorLock_RrRtDrUnLkSta_SBCM
        RRDoorUnlockState: type=CPP/SignalInfo_UInt8  # DoorLock_RrRtDrUnLkSta
        RRDrLkUnLkInsdSwEnable_Get: type=CPP/SignalInfo_UInt8  # VAPI_RRDrLkUnLkInsdSwEn_Get
        RRDrReleaseInsideSwEnable: type=CPP/SignalInfo_UInt8  # VAPI_RRRlsInsdSwEn_Get
        RRRrDoorCurtainPosition: type=CPP/SignalInfo_UInt8  # RRRrDrCurtainPosition
        RRTurnSignalLampOpenState: type=CPP/SignalInfo_UInt8  # Lamp_RrTrnSigLmpRtOpnSta
        RRWindowOpenState: type=CPP/SignalInfo_UInt8  # Window_RrRtWdwSta_BCM
        RRWindowOpenState_Detail: type=CPP/SignalInfo_UInt8  # Window_RrRtWdwDetailOpnSta
        RRWindowState: type=CPP/SignalInfo_UInt8  # Window_RrRtWdwActSta
        ReadyTimeValueForReset: type=CPP/SignalInfo_UInt16  # PDC_ReadyTimeValueForReset
        RearCurtainOptionInfo: type=CPP/SignalInfo_UInt8  # RDC_OptTyp
        RearDefoggerState: type=CPP/SignalInfo_UInt8  # BckGls_RrGlsHtdOnCmd
        RearLeftQuarterCurtainPosition: type=CPP/SignalInfo_UInt8  # RLQtrCurtain_Position
        RearLeftSeatHeatVentIndCmd: type=CPP/SignalInfo_UInt8  # SHV_RLSeatHeatVentIndCmd
        RearRightQuarterCurtainPosition: type=CPP/SignalInfo_UInt8  # RRQtrCurtain_Position
        RearRightSeatHeatVentIndCmd: type=CPP/SignalInfo_UInt8  # SHV_RRSeatHeatVentIndCmd
        RearSeatOccupancyState: type=CPP/SignalInfo_UInt8  # Warn_RrStRmndAlrmOnReq
        RearSeatReminderOptionState: type=CPP/SignalInfo_UInt8  # Warn_RrStRmndOpt
        RearSeatReminderSystemState: type=CPP/SignalInfo_UInt8  # Warn_RrStRmndSysSta
        RearSunroofState: type=CPP/SignalInfo_UInt8  # PDCex_RrSunroofOpnSta
        RemoteKeyBtnReq: type=CPP/SignalInfo_UInt8  # RKE_BtnReq
        RemoteStartEncryptionInfo: type=CPP/SignalInfo_UInt8  # SMK_EncryptTeleOptSta
        RemoteStartResult: type=CPP/SignalInfo_UInt8  # SMK_ResultRmtStrt
        RemoteStartRndnum: type=CPP/SignalInfo_UInt64  # SMK_RndnumRmtStrt
        ResetCount: type=CPP/SignalInfo_UInt8  # PDC_ResetCount
        ResetCountSetting: type=CPP/SignalInfo_UInt8  # PDC_ResetCountSetting
        ResetCumulativeCount: type=CPP/SignalInfo_UInt16  # PDC_ResetCumulativeCount
        ResetFuncOpt: type=CPP/SignalInfo_UInt8  # PDC_ResetFuncOpt
        ResetOpsta: type=CPP/SignalInfo_UInt8  # PDC_ResetOpsta
        ResetPreWrngForCCU: type=CPP/SignalInfo_UInt8  # PDC_ResetPreWrngForCCU
        ResetPreWrngForOthers: type=CPP/SignalInfo_UInt8  # PDC_ResetPreWrngForOthers
        ResetReason: type=CPP/SignalInfo_UInt8  # PDC_ResetReason
        ResetReqForCCU: type=CPP/SignalInfo_UInt8  # PDC_ResetReqForCCU
        ResetReqForOthers: type=CPP/SignalInfo_UInt8  # PDC_ResetReqForOthers
        RightTurnLampCmdState: type=CPP/SignalInfo_UInt8  # Lamp_RtTrnLmpCmdSta
        Rly12VCtrl: type=CPP/SignalInfo_UInt8  # PDC_12VRlyCtrl
        Rly12VOffHoldingTime: type=CPP/SignalInfo_Float  # PDC_12VRlyOffHoldingTime
        RtStopLampState: type=CPP/SignalInfo_UInt8  # Lamp_StpLmpRtOpnSta
        SACCargoFreezerWarningState: type=CPP/SignalInfo_UInt8  # SAC_FD_CTW_WrngSta
        SACCargoFreezerWarningValue: type=CPP/SignalInfo_UInt8  # SAC_FD_CTW_WrngTempVal
        SBCMFrunkState: type=CPP/SignalInfo_UInt8  # SBCM_FrunkSta
        SMKTlPwrOnState: type=CPP/SignalInfo_UInt8  # SMK_TlPwrOnSta
        SafetyWindowOptionInfo: type=CPP/SignalInfo_UInt8  # BCM_SafetyWdwOptTyp2
        SteeringWheelHeatingOption: type=CPP/SignalInfo_UInt8  # C_StrgWhlHeatingOpt
        SteeringWheelHeatingState: type=CPP/SignalInfo_UInt8  # HeatedSteerWheel_StrWhlHtrSwSta_BCM
        SteeringWheelheatingCommand: type=CPP/SignalInfo_UInt8  # StrWhlWrmr_HtngCmd
        SteeringWheelheatingStep: type=CPP/SignalInfo_UInt8  # C_StrgWhlHeatingSWInf
        SunRoofOptionType: type=CPP/SignalInfo_UInt8  # BCM_SunRoofOptTyp
        SunRoofState: type=CPP/SignalInfo_UInt8  # BCM_SunRoofOpnSta
        TPMSPressUnitStatus: type=CPP/SignalInfo_UInt8  # TPMS_SvcPrsrUnitSta
        TPMSThreadWarnLampStatus: type=CPP/SignalInfo_UInt8  # TPMS_SvcTreadWrngLmpSta
        TPMSWarnLampStatus: type=CPP/SignalInfo_UInt8  # TPMS_svcWrngLmpSta
        TPMS_FrLeftTirePressure: type=CPP/SignalInfo_UInt8  # TPMS_SvcFLTirePrsrVal
        TPMS_FrLeftWarnLampStatus: type=CPP/SignalInfo_UInt8  # TPMS_SvcFLPosWrngLmpSta
        TPMS_FrRightTirePressure: type=CPP/SignalInfo_UInt8  # TPMS_SvcFRTirePrsrVal
        TPMS_FrRightWanrLampStatus: type=CPP/SignalInfo_UInt8  # TPMS_SvcFRPosWrngLmpSta
        TPMS_RrLeftTirePressure: type=CPP/SignalInfo_UInt8  # TPMS_SvcRLTirePrsrVal
        TPMS_RrLeftWarnLampStatus: type=CPP/SignalInfo_UInt8  # TPMS_SvcRLPosWrngLmpSta
        TPMS_RrRightTirePressure: type=CPP/SignalInfo_UInt8  # TPMS_SvcRRTirePrsrVal
        TPMS_RrRightWanrLampStatus: type=CPP/SignalInfo_UInt8  # TPMS_SvcRRPosWrngLmpSta
        TailLampState: type=CPP/SignalInfo_UInt8  # Lamp_ExtrnlTailLmpOnReq
        TerminalControlGroupState: type=CPP/SignalInfo_UInt8  # SMK_TrmnlCtrlGrpStaBDCEV
        TimeValueForReset: type=CPP/SignalInfo_Float  # PDC_TimeValueForReset
        TrdLeftSeatHeatVentIndCmd: type=CPP/SignalInfo_UInt8  # SHV_TLSeatHeatVentIndCmd
        TrdRightSeatHeatVentIndCmd: type=CPP/SignalInfo_UInt8  # SHV_TRSeatHeatVentIndCmd
        TrunkSwitchState: type=CPP/SignalInfo_UInt8  # Trunk_TrnkTlgtSwSta
        TurnLampMode: type=CPP/SignalInfo_UInt8  # Lamp_TrnLmpMode
        TurnSignalLampLeftActiveState: type=CPP/SignalInfo_UInt8  # Lamp_TrnSigLmpLftActiveSt
        TurnSignalLampRightActiveState: type=CPP/SignalInfo_UInt8  # Lamp_TrnSigLmpRtActiveSt
        W_ADMCmd_BC: type=CPP/SignalInfo_UInt8
        WarnAsstSeatbeltSwitchStatus: type=CPP/SignalInfo_UInt8  # Warn_AsstStBltSwSta
        WarnDriverSeatStaus: type=CPP/SignalInfo_UInt8  # Warn_DrvStOccSta
        WarnDriverSeatbeltSwitchStatus: type=CPP/SignalInfo_UInt8  # Warn_DrvStBltSwSta
        WarnPassengerSeatStatus: type=CPP/SignalInfo_UInt8  # Warn_PassStOccSta
        WasherFluidSwitchState: type=CPP/SignalInfo_UInt8  # Warn_WshrFldSwSta
    Body2: major-version=1, minor-version=2
      namespaces:
        symbol props Vehicle
        symbol props SOAAdaptor
        symbol props Body2
      47 x field, all with type=CPP/SignalInfo_UInt8, has-getter=true, has-notifier=true, has-setter=false:
        APSS_IMSSWOpt
        APSS_StRlxModeBtn
        AsstSeatClimateOptionState  # Ast_SHVU_SeatOptSta
        AsstSeatClimateState  # Ast_SHVU_SeatHtOperSta
        AstSeatAirSupportOpt  # SASU_AstSeatAirSupportOpt
        BLTNAuxBatConnectionState  # BLTN_CAM_AuxBat_Conn_State
        BLTNParkModeOperatableTime  # BLTN_CAM_Prk_Oprable_Time
        BLTNParkOperationTerminationInfo  # BLTN_CAM_PrkOp_Termiate_Info
        BLTNParkingOperableTime  # BLTN_CAM_Prk_Oprable_Time_Max
        BLTNParkingSetTime  # BLTN_CAM_Set_PrkTime
        BLTNSDCardState  # BLTN_CAM_SD_Card_State
        CntDriveEventRecord  # BLTN_CAM_DEV_Count
        CountOfParkingEvent  # BLTN_CAM_PEV_Count
        DPSS_StRlxModeBtn
        DRVSwvlTypOpt  # PSU_DRV_SwvlTypOpt
        DrvSeatAirSupportOpt  # SASU_DrvSeatAirSupportOpt
        DrvSeatClimateOptionState  # Drv_SHVU_SeatOptSta
        DrvSeatClimateState  # Drv_SHVU_SeatHtOperSta
        FrArmrestHeatedType  # FCS_FrArmrestHeatedTyp
        FrAstArmrestHeatedLevel  # FCS_FrAstArmrestHeatedLvl
        FrDrvArmrestHeatedLevel  # FCS_FrDrvArmrestHeatedLvl
        IMSType  # PSM_IMSOptTyp
        PSSRLStRlxModeBtn  # PSS_RL_StRlxModeBtn
        PSSRRStRlxModeBtn  # PSS_RR_StRlxModeBtn
        PSS_RL_IMSSWOpt
        PSS_RR_IMSSWOpt
        ParkEventRecordedState  # BLTN_CAM_PEV_Recorded
        RCMOptionType  # RCM_OptTyp
        RLSeatAirSupportOpt  # SASU_RLSeatAirSupportOpt
        RLSeatClimateOptionState  # RL_SHVU_SeatOptSta
        RLSeatClimateState  # RL_SHVU_SeatHtOperSta
        RRSeatAirSupportOpt  # SASU_RRSeatAirSupportOpt
        RRSeatClimateOptionState  # RR_SHVU_SeatOptSta
        RRSeatClimateState  # RR_SHVU_SeatHtOperSta
        RRSunRoofState  # RCM_RR_SunroofOpnSta
        RrArmrestHeatedType  # FCS_RrArmrestHeatedTyp
        RrLhArmrestHeatedLevel  # FCS_RrLhArmrestHeatedLvl
        RrRhArmrestHeatedLevel  # FCS_RrRhArmrestHeatedLvl
        SGU_RoofZoneOptTyp
        SGU_ZoneAllSta
        ShockCount  # BLTN_CAM_Prk_EV_Cnt
        SigDriveEventRecorded  # BLTN_CAM_DEV_Recorded
        SunRoofState  # RCM_SunroofOpnSta
        TrdLhSeatHeatOperationState  # TL_SHVU_SeatHtOperSta
        TrdLhSeatOperationState  # TL_SHVU_SeatOptSta
        TrdRhSeatHeatOperationState  # TR_SHVU_SeatHtOperSta
        TrdRhSeatOperationState  # TR_SHVU_SeatOptSta
    BootModeManager: major-version=1, minor-version=1
      namespaces:
        symbol props Vehicle
        symbol props ApSysMgr
        symbol props BootModeManager
      field APBootModeInfo: type=BootMode, has-getter=true, has-notifier=true, has-setter=true  # WDBI로 Boot Mode 설정시 MCU - IPCH - ASM - eMMC로 전달, 저장하기위핸 api Boot Mode는 0 -> 1 -> 2 로 변경 가능, 역순 불가능
    BootSyncManager: major-version=1, minor-version=0
      namespaces:
        symbol props Vehicle
        symbol props BSM
        symbol props BootSyncManager
      field BootPartitionInfo: type=PartitionType, has-getter=true, has-notifier=true, has-setter=false  # Boot Partition 정보 전달 api True : A Partition, Primary False : B Partition, Secondary
      field SyncBlockStatusInfo: type=bool, has-getter=true, has-notifier=true, has-setter=false  # Sync 수행 금지 정보 전달 api True : Block False : UnBlock
      field SyncStatusInfo: type=UnitSyncStatus, has-getter=true, has-notifier=true, has-setter=false  # Sync 상태 정보 전달 api
      methods:
        6 x operation:
          GetIVDHash  # sw unit, partition 별 IVD Hash Data 제공 api MCU Hash는 IPC로 전달 받음
            4 x arg:
              swUnitID: type=uint8_t, direction=IN
              partitionInfo: type=bool, direction=IN
              hashData: type=ByteArray, direction=OUT
              error: type=BSMErrorType, direction=OUT
          RequestSync  # Partition Sync 수행 api
            arg swUnitID: type=uint8_t, direction=IN
            arg error: type=BSMErrorType, direction=OUT
          RequestSyncStatusUpdate: fire-and-forget=true  # Sync 상태 정보 업데이트 요청 api
          SetSyncBlock  # Sync 수행 금지 api True : Block False : UnBlock
            arg block: type=bool, direction=IN
            arg error: type=BSMErrorType, direction=OUT
          SetSyncStatus  # SyncStatus를 UpdateMode로 변경 api
            arg syncStatus: type=UnitSyncStatus, direction=IN
            arg error: type=BSMErrorType, direction=OUT
          SwapBootPartition  # Boot Partition 스왑 수행 api True : A Partition False : B Partition
            arg partition: type=bool, direction=IN
            arg error: type=BSMErrorType, direction=OUT
    CANoverIP: major-version=2, minor-version=3
      namespaces:
        symbol props Vehicle
        symbol props SOAAdaptor
        symbol props CANoverIP
      methods:
        162 x operation:
          ActivateCharging  # RCC_ChrgCtrlReq_Copy_2
            arg signal: type=uint8_t, direction=IN
            arg result: type=ErrorInfo, direction=OUT
          AirCleaningControl  # RAC_AirCleaningCtrlReq_Copy_1
            arg signal: type=uint8_t, direction=IN
            arg result: type=ErrorInfo, direction=OUT
          AirconditioningControl  # RAC_AcnCtrlReq_Copy_2
            arg signal: type=uint8_t, direction=IN
            arg result: type=ErrorInfo, direction=OUT
          AsstSeatClimateControl  # C_TeleAstSeatOpCmdIBOX_Copy_2
            arg signal: type=uint8_t, direction=IN
            arg result: type=ErrorInfo, direction=OUT
          AsstWindowControl  # C_AstWindowCmdAVN_Copy_2
            arg signal: type=uint8_t, direction=IN
            arg result: type=ErrorInfo, direction=OUT
          AstDrReleaseInsideSwEnable_Set  # VAPI_AstRlsInsdSwEn_Set
            arg signal: type=uint8_t, direction=IN
            arg result: type=ErrorInfo, direction=OUT
          AstHeatingCoolingMode_Set  # VAPI_AstHeatingCoolingMode_Set
            arg signal: type=uint8_t, direction=IN
            arg result: type=ErrorInfo, direction=OUT
          AstIntgSwivelPos_Set  # VAPI_AstIntgSwivelPos_Set
            arg signal: type=uint8_t, direction=IN
            arg result: type=ErrorInfo, direction=OUT
          AstMassageIntgMode_Set  # VAPI_AstMassageIntgMode_Set
            arg signal: type=uint8_t, direction=IN
            arg result: type=ErrorInfo, direction=OUT
          AstPwrSeatIntgMode_Set  # VAPI_AstPwrSeatIntgMode_Set
            arg signal: type=uint8_t, direction=IN
            arg result: type=ErrorInfo, direction=OUT
          CCU_CCS_AlvCnt
            arg signal: type=uint8_t, direction=IN  # CCU_CCS_AlvCnt6Val
            arg result: type=ErrorInfo, direction=OUT
          CCU_CCS_AlvCnt7Val
            arg signal: type=uint8_t, direction=IN
            arg result: type=ErrorInfo, direction=OUT
          CCU_CCS_AlvCnt8Val
            arg signal: type=uint8_t, direction=IN
            arg result: type=ErrorInfo, direction=OUT
          CCU_CCS_Crc
            arg signal: type=uint16_t, direction=IN  # CCU_CCS_Crc6Val
            arg result: type=ErrorInfo, direction=OUT
          CCU_CCS_Crc7Val
            arg signal: type=uint16_t, direction=IN
            arg result: type=ErrorInfo, direction=OUT
          CCU_CCS_Crc8Val
            arg signal: type=uint16_t, direction=IN
            arg result: type=ErrorInfo, direction=OUT
          CancelAirconditioning  # RCC_AcnCtrlCanclReq_Copy_2
            arg signal: type=uint8_t, direction=IN
            arg result: type=ErrorInfo, direction=OUT
          CancelCharging  # RCC_ChrgCtrlCanclReq_Copy_2
            arg signal: type=uint8_t, direction=IN
            arg result: type=ErrorInfo, direction=OUT
          CargoControlMasterSet
            arg signal: type=uint8_t, direction=IN
            arg result: type=ErrorInfo, direction=OUT
          CargoTrgetTempSet  # CargoTrgTempSet
            arg signal: type=int8_t, direction=IN
            arg result: type=ErrorInfo, direction=OUT
          CertCodeRmtCtrl1
            arg signal: type=uint64_t, direction=IN  # RmtCtrlCertCode1
            arg result: type=ErrorInfo, direction=OUT
          CertCodeRmtCtrl2
            arg signal: type=uint64_t, direction=IN  # RmtCtrlCertCode2
            arg result: type=ErrorInfo, direction=OUT
          ContractCertActiveChangeRequest  # C_ContCert_ActiveChnReq
            arg signal: type=uint8_t, direction=IN
            arg result: type=ErrorInfo, direction=OUT
          ContractCertChangeStateDeliveryResult  # C_ContCert_ChnStaDelivery_Result
            arg signal: type=uint8_t, direction=IN
            arg result: type=ErrorInfo, direction=OUT
          ContractCertDeleteRequest  # C_ContCert_DelReq
            arg signal: type=uint8_t, direction=IN
            arg result: type=ErrorInfo, direction=OUT
          CtrDrLkUnLkSwEnable_Set  # VAPI_CtrDrLkUnLkSwEnable_Set
            arg signal: type=uint8_t, direction=IN
            arg result: type=ErrorInfo, direction=OUT
          DigitalKeyInformAvailable  # C_DigitalKeyInformAvailable
            arg signal: type=uint8_t, direction=IN
            arg result: type=ErrorInfo, direction=OUT
          DrvDrReleaseInsideSwEnable_Set  # VAPI_DrvRlsInsdSwEn_Set
            arg signal: type=uint8_t, direction=IN
            arg result: type=ErrorInfo, direction=OUT
          DrvHeatingCoolingMode_Set  # VAPI_DrvHeatingCoolingMode_Set
            arg signal: type=uint8_t, direction=IN
            arg result: type=ErrorInfo, direction=OUT
          DrvIntgSwivelPos_Set  # VAPI_DrvIntgSwivelPos_Set
            arg signal: type=uint8_t, direction=IN
            arg result: type=ErrorInfo, direction=OUT
          DrvMassageIntgMode_Set  # VAPI_DrvMassageIntgMode_Set
            arg signal: type=uint8_t, direction=IN
            arg result: type=ErrorInfo, direction=OUT
          DrvPwrSeatIntgMode_Set  # VAPI_DrvPwrSeatIntgMode_Set
            arg signal: type=uint8_t, direction=IN
            arg result: type=ErrorInfo, direction=OUT
          DrvSeatClimateControl  # C_TeleDrvSeatOpCmdIBOX_Copy_2
            arg signal: type=uint8_t, direction=IN
            arg result: type=ErrorInfo, direction=OUT
          DrvWindowControl  # C_DrvWindowCmdAVN_Copy_2
            arg signal: type=uint8_t, direction=IN
            arg result: type=ErrorInfo, direction=OUT
          EncOptRmtStart
            arg signal: type=uint8_t, direction=IN  # TeleCrankingOpt
            arg result: type=ErrorInfo, direction=OUT
          EndMINofScheduledTime  # RAC_AcnCtrlReqEndMinVal
            arg signal: type=uint8_t, direction=IN
            arg result: type=ErrorInfo, direction=OUT
          FODmode  # CCU_FOD_mode
            arg signal: type=uint8_t, direction=IN
            arg result: type=ErrorInfo, direction=OUT
          FrunkControl  # FrunkCtrlReq
            arg signal: type=uint8_t, direction=IN
            arg result: type=ErrorInfo, direction=OUT
          HazardLampControl  # HazardCtrlReq_Copy
            arg signal: type=uint8_t, direction=IN
            arg result: type=ErrorInfo, direction=OUT
          IGN3Control  # HU_IG3_Request_Copy_1
            arg signal: type=uint8_t, direction=IN
            arg result: type=ErrorInfo, direction=OUT
          Intake_Set  # VAPI_Intake_Set
            arg signal: type=uint8_t, direction=IN
            arg result: type=ErrorInfo, direction=OUT
          MapChangeInformAvailable  # C_MapChangeInformAvailable
            arg signal: type=uint8_t, direction=IN
            arg result: type=ErrorInfo, direction=OUT
          NotifyCharingModeWithIG3Condition  # ECO_Ig3RlyDrvSta_Copy_1
            arg signal: type=uint8_t, direction=IN
            arg result: type=ErrorInfo, direction=OUT
          NotifyFailConfirmedToVCU  # RCC_FlCnfmSta_Copy_2
            arg signal: type=uint8_t, direction=IN
            arg result: type=ErrorInfo, direction=OUT
          NotifyIG3RelayMode  # ECO_Ig3RlyModSta_Copy_2
            arg signal: type=uint8_t, direction=IN
            arg result: type=ErrorInfo, direction=OUT
          OTADownloadProgress  # CCU_OTA_DownloadProgress
            arg signal: type=uint8_t, direction=IN
            arg result: type=ErrorInfo, direction=OUT
          OTAReqPowerState  # CCU_OTA_req_power_State
            arg signal: type=uint8_t, direction=IN
            arg result: type=ErrorInfo, direction=OUT
          OTAResult  # OTA_Result
            arg signal: type=uint8_t, direction=IN
            arg result: type=ErrorInfo, direction=OUT
          OTAUIReadyRequest  # OTA_UI_Ready_request
            arg signal: type=uint8_t, direction=IN
            arg result: type=ErrorInfo, direction=OUT
          OTA_ConditionRequest  # CCU_OTA_Cond_Request
            arg signal: type=uint8_t, direction=IN
            arg result: type=ErrorInfo, direction=OUT
          PSDInsideSwEnable_Set  # VAPI_PSDInsideSwEnable_Set
            arg signal: type=uint8_t, direction=IN
            arg result: type=ErrorInfo, direction=OUT
          PTGInsideSwEnable_Set  # VAPI_PTGInsideSwEnable_Set
            arg signal: type=uint8_t, direction=IN
            arg result: type=ErrorInfo, direction=OUT
          PetCareFinish  # PetModeFinish
            arg signal: type=uint8_t, direction=IN
            arg result: type=ErrorInfo, direction=OUT
          PetCareOnOffRequest  # PetModOnReq
            arg signal: type=uint8_t, direction=IN
            arg result: type=ErrorInfo, direction=OUT
          PetCareOptInfo  # PetModeOpt
            arg signal: type=uint8_t, direction=IN
            arg result: type=ErrorInfo, direction=OUT
          PetCareResponse  # PetModeRes
            arg signal: type=uint8_t, direction=IN
            arg result: type=ErrorInfo, direction=OUT
          PetCareStatus  # PetModeSta
            arg signal: type=uint8_t, direction=IN
            arg result: type=ErrorInfo, direction=OUT
          PetCareTempSet  # PetTempSetVal
            arg signal: type=uint8_t, direction=IN
            arg result: type=ErrorInfo, direction=OUT
          PetCareTempUnitSet  # PetTempUnit
            arg signal: type=uint8_t, direction=IN
            arg result: type=ErrorInfo, direction=OUT
          PwrOnMaintain_Set  # VAPI_PwrOnMaintain_Set
            arg signal: type=uint8_t, direction=IN
            arg result: type=ErrorInfo, direction=OUT
          PwrTransEnable_Set  # VAPI_PwrTransEnable_Set
            arg signal: type=uint8_t, direction=IN
            arg result: type=ErrorInfo, direction=OUT
          PwrWdwSwEnable_Set  # VAPI_PwrWdwSwEnable_Set
            arg signal: type=uint8_t, direction=IN
            arg result: type=ErrorInfo, direction=OUT
          QtrLCurtainRequest
            arg signal: type=uint8_t, direction=IN  # QtrRLCurtainCCSReq
            arg result: type=ErrorInfo, direction=OUT
          QtrRCurtainRequest
            arg signal: type=uint8_t, direction=IN  # QtrRRCurtainCCSReq
            arg result: type=ErrorInfo, direction=OUT
          RLCurtainRequest
            arg signal: type=uint8_t, direction=IN  # RrRLDrCurtainCCSReq
            arg result: type=ErrorInfo, direction=OUT
          RLDrLkUnLkInsdSwEnable_Set  # VAPI_RLDrLkUnLkInsdSwEn_Set
            arg signal: type=uint8_t, direction=IN
            arg result: type=ErrorInfo, direction=OUT
          RLDrReleaseInsideSwEnable_Set  # VAPI_RLRlsInsdSwEn_Set
            arg signal: type=uint8_t, direction=IN
            arg result: type=ErrorInfo, direction=OUT
          RLHeatingCoolingMode_Set  # VAPI_RLHeatingCoolingMode_Set
            arg signal: type=uint8_t, direction=IN
            arg result: type=ErrorInfo, direction=OUT
          RLMassageIntgMode_Set  # VAPI_RLMassageIntgMode_Set
            arg signal: type=uint8_t, direction=IN
            arg result: type=ErrorInfo, direction=OUT
          RLPwrSeatIntgMode_Set  # VAPI_RLPwrSeatIntgMode_Set
            arg signal: type=uint8_t, direction=IN
            arg result: type=ErrorInfo, direction=OUT
          RLQtrShadePos_Set  # VAPI_RLQtrShadePos_Set
            arg signal: type=uint8_t, direction=IN
            arg result: type=ErrorInfo, direction=OUT
          RLRrDrShadePos_Set  # VAPI_RLRrDrShadePos_Set
            arg signal: type=uint8_t, direction=IN
            arg result: type=ErrorInfo, direction=OUT
          RLSeatClimateControl  # C_TeleRLSeatOpCmdIBOX_Copy_1
            arg signal: type=uint8_t, direction=IN
            arg result: type=ErrorInfo, direction=OUT
          RLWindowControl  # C_RLWindowCmdAVN_Copy_2
            arg signal: type=uint8_t, direction=IN
            arg result: type=ErrorInfo, direction=OUT
          ROAAlarmControl  # HU_RrStRemindOffSetReq_Copy_1
            arg signal: type=uint8_t, direction=IN
            arg result: type=ErrorInfo, direction=OUT
          ROAEnable_Set  # VAPI_ROAEnable_Set
            arg signal: type=uint8_t, direction=IN
            arg result: type=ErrorInfo, direction=OUT
          RRCurtainRequest
            arg signal: type=uint8_t, direction=IN  # RrRRDrCurtainCCSReq
            arg result: type=ErrorInfo, direction=OUT
          RRDrLkUnLkInsdSwEnable_Set  # VAPI_RRDrLkUnLkInsdSwEn_Set
            arg signal: type=uint8_t, direction=IN
            arg result: type=ErrorInfo, direction=OUT
          RRDrReleaseInsideSwEnable_Set  # VAPI_RRRlsInsdSwEn_Set
            arg signal: type=uint8_t, direction=IN
            arg result: type=ErrorInfo, direction=OUT
          RRHeatingCoolingMode_Set  # VAPI_RRHeatingCoolingMode_Set
            arg signal: type=uint8_t, direction=IN
            arg result: type=ErrorInfo, direction=OUT
          RRMassageIntgMode_Set  # VAPI_RRMassageIntgMode_Set
            arg signal: type=uint8_t, direction=IN
            arg result: type=ErrorInfo, direction=OUT
          RRPwrSeatIntgMode_Set  # VAPI_RRPwrSeatIntgMode_Set
            arg signal: type=uint8_t, direction=IN
            arg result: type=ErrorInfo, direction=OUT
          RRQtrShadePos_Set  # VAPI_RRQtrShadePos_Set
            arg signal: type=uint8_t, direction=IN
            arg result: type=ErrorInfo, direction=OUT
          RRRrDrShadePos_Set  # VAPI_RRRrDrShadePos_Set
            arg signal: type=uint8_t, direction=IN
            arg result: type=ErrorInfo, direction=OUT
          RRSeatClimateControl  # C_TeleRRSeatOpCmdIBOX_Copy_2
            arg signal: type=uint8_t, direction=IN
            arg result: type=ErrorInfo, direction=OUT
          RRWindowControl  # C_RRWindowCmdAVN_Copy_2
            arg signal: type=uint8_t, direction=IN
            arg result: type=ErrorInfo, direction=OUT
          RSD_ACK01_Group
            arg RSD_ACK_zero: type=uint8_t, direction=IN
            arg RSD_ACK_type: type=uint8_t, direction=IN
            arg result: type=ErrorInfo, direction=OUT
          RequestCDMOpen  # HU_CDMOpenCmd_Copy_1
            arg signal: type=uint8_t, direction=IN
            arg result: type=ErrorInfo, direction=OUT
          RequestExtLamp_toHU  # OTA_Cond_Ext_Lamp
            arg signal: type=uint8_t, direction=IN
            arg result: type=ErrorInfo, direction=OUT
          RequestGearP_toHU  # OTA_Cond_Gear_P
            arg signal: type=uint8_t, direction=IN
            arg result: type=ErrorInfo, direction=OUT
          RequestHoodClosed_toHU  # OTA_Cond_Hood_Closed
            arg signal: type=uint8_t, direction=IN
            arg result: type=ErrorInfo, direction=OUT
          RequestParkingBrk_toHU  # OTA_Cond_Parking_Brk
            arg signal: type=uint8_t, direction=IN
            arg result: type=ErrorInfo, direction=OUT
          RequestUmtBcanWakeUp  # UmtBcanWakeUpReq
            arg signal: type=uint8_t, direction=IN
            arg result: type=ErrorInfo, direction=OUT
          RequestUmtHazardLamp  # UmtHazardLampReq
            arg signal: type=uint8_t, direction=IN
            arg result: type=ErrorInfo, direction=OUT
          RequestVehiclePwr_toHU  # OTA_Cond_Vehicle_Pwr
            arg signal: type=uint8_t, direction=IN
            arg result: type=ErrorInfo, direction=OUT
          Request_ControlBattCondition  # CCU_BattCondActSet
            arg signal: type=uint8_t, direction=IN
            arg result: type=ErrorInfo, direction=OUT
          ReuqestUmtVehicleStart  # UmtVehicleStartReq
            arg signal: type=uint8_t, direction=IN
            arg result: type=ErrorInfo, direction=OUT
          RmtStartEncReq_Group  # TeleCrankingCmdEncrypt & RmtCtrlCertCode1 & RmtCtrlCertCode2
            4 x arg:
              TeleCrankingCmdEncrypt: type=uint8_t, direction=IN
              RmtCtrlCertCode1: type=uint64_t, direction=IN
              RmtCtrlCertCode2: type=uint64_t, direction=IN
              result: type=ErrorInfo, direction=OUT
          RmtStartEncRequest
            arg signal: type=uint8_t, direction=IN  # TeleCrankingCmdEncrypt
            arg result: type=ErrorInfo, direction=OUT
          RndNumRmtCtrlRequest
            arg signal: type=uint8_t, direction=IN  # RmtCtrlReqRndnum
            arg result: type=ErrorInfo, direction=OUT
          RrShadePos_Set  # VAPI_RrShadePos_Set
            arg signal: type=uint8_t, direction=IN
            arg result: type=ErrorInfo, direction=OUT
          SUM_RESP01_Group
            5 x arg:
              SUM_RESP_PldSeg1_{1..4}: type=uint64_t, direction=IN
              result: type=ErrorInfo, direction=OUT
          SeatClimateControl_Group  # C_TeleDrvSeatOpCmdIBOX_Copy_2
            7 x arg:
              C_TeleDrvSeatOpCmdIBOX_Copy_2: type=uint8_t, direction=IN
              C_TeleAstSeatOpCmdIBOX_Copy_2: type=uint8_t, direction=IN
              C_TeleRRSeatOpCmdIBOX_Copy_2: type=uint8_t, direction=IN
              C_TeleRLSeatOpCmdIBOX_Copy_1: type=uint8_t, direction=IN
              C_TeleTRSeatOpCmdIBOX_CCU: type=uint8_t, direction=IN
              C_TeleTLSeatOpCmdIBOX_CCU: type=uint8_t, direction=IN
              result: type=ErrorInfo, direction=OUT
          SetCargoWaringValue  # SetCargoWrngValue
            arg signal: type=uint8_t, direction=IN
            arg result: type=ErrorInfo, direction=OUT
          SetChargingData  # RCC_ChrgDataVal_Copy_2
            arg signal: type=uint8_t, direction=IN
            arg result: type=ErrorInfo, direction=OUT
          SetChargingMode  # RCC_ChrgModTyp_Copy_2
            arg signal: type=uint8_t, direction=IN
            arg result: type=ErrorInfo, direction=OUT
          SetContractChangeReq_Group
            5 x arg:
              C_ContCert_DelReq: type=uint8_t, direction=IN
              C_ContCert_ActiveChnReq: type=uint8_t, direction=IN
              C_ContCert_TargetEMAID1: type=uint64_t, direction=IN
              C_ContCert_TargetEMAID2: type=uint64_t, direction=IN
              result: type=ErrorInfo, direction=OUT
          SetDefoggerHeating  # C_TeleDefoggerHeatingCmdIBOX_Copy_2
            arg signal: type=uint8_t, direction=IN
            arg result: type=ErrorInfo, direction=OUT
          SetDefoggerState  # RAC_DfrstCtrlReq_Copy_2
            arg signal: type=uint8_t, direction=IN
            arg result: type=ErrorInfo, direction=OUT
          SetDoorLock  # C_CtrlDrLockRlyCCS_Copy_2
            arg signal: type=uint8_t, direction=IN
            arg result: type=ErrorInfo, direction=OUT
          SetDoorUnlock  # C_CtrlDrUnlockRlyCCS_Copy_2
            arg signal: type=uint8_t, direction=IN
            arg result: type=ErrorInfo, direction=OUT
          SetEMAID1
            arg signal: type=uint64_t, direction=IN  # C_ContCert_TargetEMAID1
            arg result: type=ErrorInfo, direction=OUT
          SetEMAID2
            arg signal: type=uint64_t, direction=IN  # C_ContCert_TargetEMAID2
            arg result: type=ErrorInfo, direction=OUT
          SetEasyAccessProfileIDforCCU  # C_EsyAcsProfileID_CCU
            arg signal: type=uint8_t, direction=IN
            arg result: type=ErrorInfo, direction=OUT
          SetFrontHeating  # C_TeleFrontHeatingCmdIBOX_Copy_1
            arg signal: type=uint8_t, direction=IN
            arg result: type=ErrorInfo, direction=OUT
          SetHazardLamp  # C_HazardFromCCS_Copy_2
            arg signal: type=uint8_t, direction=IN
            arg result: type=ErrorInfo, direction=OUT
          SetHeating_Group  # HU_StrgWhlHeatingSet_CCS_Copy
            5 x arg:
              HU_StrgWhlHeatingSet_CCS_Copy: type=uint8_t, direction=IN
              C_TeleStrgWhlHeatingCmdIBOX_Copy_2: type=uint8_t, direction=IN
              C_TeleDefoggerHeatingCmdIBOX_Copy_2: type=uint8_t, direction=IN
              C_TeleFrontHeatingCmdIBOX_Copy_1: type=uint8_t, direction=IN
              result: type=ErrorInfo, direction=OUT
          SetOTAEOU  # CCU_OTA_EOU
            arg signal: type=uint8_t, direction=IN
            arg result: type=ErrorInfo, direction=OUT
          SetOTAIG3OnReq  # CCU_OTA_IG3On_request
            arg signal: type=uint8_t, direction=IN
            arg result: type=ErrorInfo, direction=OUT
          SetOTAMode  # CCU_OTA_mode
            arg signal: type=uint8_t, direction=IN
            arg result: type=ErrorInfo, direction=OUT
          SetOTAUpdateEnableCondition_Group  # CCU_OTA_Update_time
            4 x arg:
              CCU_OTA_Update_time: type=uint16_t, direction=IN
              CCU_OTA_Update_Current: type=uint16_t, direction=IN
              CCU_Update_Calfactor: type=uint8_t, direction=IN
              result: type=ErrorInfo, direction=OUT
          SetPanic  # C_PanicFromCCS_Copy_2
            arg signal: type=uint8_t, direction=IN
            arg result: type=ErrorInfo, direction=OUT
          SetPetModeFodOpt
            arg signal: type=uint8_t, direction=IN  # PetModeFodOpt
            arg result: type=ErrorInfo, direction=OUT
          SetPetcareDoorState
            arg signal: type=uint8_t, direction=IN  # Petcare_DrLkUnLkSta
            arg result: type=ErrorInfo, direction=OUT
          SetPreCrank  # C_PreCrankReq_Copy
            arg signal: type=uint8_t, direction=IN
            arg result: type=ErrorInfo, direction=OUT
          SetRemoteCranking  # C_TeleCrankingCmdIBOX_Copy_2
            arg signal: type=uint8_t, direction=IN
            arg result: type=ErrorInfo, direction=OUT
          SetRsdACKtype
            arg signal: type=uint8_t, direction=IN  # RSD_ACK_type
            arg result: type=ErrorInfo, direction=OUT
          SetRsdACKzero
            arg signal: type=uint8_t, direction=IN  # RSD_ACK_zero
            arg result: type=ErrorInfo, direction=OUT
          SetSteeringWheelHeating  # C_TeleStrgWhlHeatingCmdIBOX_Copy_2
            arg signal: type=uint8_t, direction=IN
            arg result: type=ErrorInfo, direction=OUT
          SetSteeringWheelHeatingbyStep  # HU_StrgWhlHeatingSet_CCS_Copy
            arg signal: type=uint8_t, direction=IN
            arg result: type=ErrorInfo, direction=OUT
          SetSummaryResponsePayloadSegment1_1
            arg signal: type=uint64_t, direction=IN  # SUM_RESP_PldSeg1_1
            arg result: type=ErrorInfo, direction=OUT
          SetSummaryResponsePayloadSegment1_2
            arg signal: type=uint64_t, direction=IN  # SUM_RESP_PldSeg1_2
            arg result: type=ErrorInfo, direction=OUT
          SetSummaryResponsePayloadSegment1_3
            arg signal: type=uint64_t, direction=IN  # SUM_RESP_PldSeg1_3
            arg result: type=ErrorInfo, direction=OUT
          SetSummaryResponsePayloadSegment1_4
            arg signal: type=uint64_t, direction=IN  # SUM_RESP_PldSeg1_4
            arg result: type=ErrorInfo, direction=OUT
          SetTemperatureType  # RAC_TempModTyp_Copy_2
            arg signal: type=uint8_t, direction=IN
            arg result: type=ErrorInfo, direction=OUT
          SetTemperatureValue  # RAC_TempSetVal_Copy_2
            arg signal: type=uint16_t, direction=IN
            arg result: type=ErrorInfo, direction=OUT
          SetVAPIAlarm01_Group
            arg VAPI_ROAEnable_Set: type=uint8_t, direction=IN
            arg result: type=ErrorInfo, direction=OUT
          SetVAPIBCKGLSHTD01_Group
            arg VAPI_BckGlsHtd_Set: type=uint8_t, direction=IN
            arg result: type=ErrorInfo, direction=OUT
          SetVAPIBPCM01_Group
            6 x arg:
              VAPI_DrvHeatWarmReq_Set: type=uint8_t, direction=IN
              VAPI_AstHeatWarmReq_Set: type=uint8_t, direction=IN
              VAPI_RLHeatWarmReq_Set: type=uint8_t, direction=IN
              VAPI_RRHeatWarmReq_Set: type=uint8_t, direction=IN
              VAPI_HeatGlsReqReq_Set: type=uint8_t, direction=IN
              result: type=ErrorInfo, direction=OUT
          SetVAPIDoor01_Group
            10 x arg:
              VAPI_CtrDrLkUnLkSwEnable_Set: type=uint8_t, direction=IN
              VAPI_PwrWdwSwEnable_Set: type=uint8_t, direction=IN
              VAPI_RLDrLkUnLkInsdSwEnable_Set: type=uint8_t, direction=IN  # VAPI_RLDrLkUnLkInsdSwEn_Set
              VAPI_RRDrLkUnLkInsdSwEnable_Set: type=uint8_t, direction=IN  # VAPI_RRDrLkUnLkInsdSwEn_Set
              VAPI_DrvDrReleaseInsideSwEnable_Set: type=uint8_t, direction=IN  # VAPI_DrvRlsInsdSwEn_Set
              VAPI_AstDrReleaseInsideSwEnable_Set: type=uint8_t, direction=IN  # VAPI_AstRlsInsdSwEn_Set
              VAPI_RLDrReleaseInsideSwEnable_Set: type=uint8_t, direction=IN  # VAPI_RLRlsInsdSwEn_Set
              VAPI_RRDrReleaseInsideSwEnable_Set: type=uint8_t, direction=IN  # VAPI_RRRlsInsdSwEn_Set
              VAPI_PSDInsideSwEnable_Set: type=uint8_t, direction=IN
              result: type=ErrorInfo, direction=OUT
          SetVAPIHVAC01_Group
            7 x arg:
              VAPI_DrvMod_Set: type=uint8_t, direction=IN
              VAPI_AstMod_Set: type=uint8_t, direction=IN
              VAPI_2ndDrvMod_Set: type=uint8_t, direction=IN
              VAPI_2ndAstMod_Set: type=uint8_t, direction=IN
              VAPI_3rdDrvMod_Set: type=uint8_t, direction=IN
              VAPI_ModPrio_Set: type=uint8_t, direction=IN
              result: type=ErrorInfo, direction=OUT
          SetVAPIHVAC02_Group
            7 x arg:
              VAPI_DrvBlr_Set: type=uint8_t, direction=IN
              VAPI_AstBlr_Set: type=uint8_t, direction=IN
              VAPI_2ndDrvBlr_Set: type=uint8_t, direction=IN
              VAPI_2ndAstBlr_Set: type=uint8_t, direction=IN
              VAPI_3rdDrvBlr_Set: type=uint8_t, direction=IN
              VAPI_BlrPrio_Set: type=uint8_t, direction=IN
              result: type=ErrorInfo, direction=OUT
          SetVAPIHVAC03_Group
            arg VAPI_Intake_Set: type=uint8_t, direction=IN
            arg VAPI_IntakePrio_Set: type=uint8_t, direction=IN
            arg result: type=ErrorInfo, direction=OUT
          SetVAPIHVAC06_Group
            21 x arg:
              VAPI_DrvTmpVal_Set: type=uint16_t, direction=IN
              VAPI_AstTmpVal_Set: type=uint16_t, direction=IN
              VAPI_2ndDrvTmpVal_Set: type=uint16_t, direction=IN
              VAPI_2ndAstTmpVal_Set: type=uint16_t, direction=IN
              VAPI_3rdDrvTmpVal_Set: type=uint16_t, direction=IN
              VAPI_DrvMtAutoBlr_Set: type=uint8_t, direction=IN
              VAPI_AstMtAutoBlr_Set: type=uint8_t, direction=IN
              VAPI_2ndDrvMtAutoBlr_Set: type=uint8_t, direction=IN
              VAPI_2ndAstMtAutoBlr_Set: type=uint8_t, direction=IN
              VAPI_3rdDrvMtAutoBlr_Set: type=uint8_t, direction=IN
              VAPI_DrvAuto_Set: type=uint8_t, direction=IN
              VAPI_AstAuto_Set: type=uint8_t, direction=IN
              VAPI_2ndDrvAuto_Set: type=uint8_t, direction=IN
              VAPI_2ndAstAuto_Set: type=uint8_t, direction=IN
              VAPI_3rdDrvAuto_Set: type=uint8_t, direction=IN
              VAPI_SyncSet: type=uint8_t, direction=IN
              VAPI_HVACSysSta_Set: type=uint8_t, direction=IN
              VAPI_HVAC2ndSysSta_Set: type=uint8_t, direction=IN
              VAPI_HVAC3rdSysSta_Set: type=uint8_t, direction=IN
              VAPI_AllSeatCtrl_Set: type=uint8_t, direction=IN
              result: type=ErrorInfo, direction=OUT
          SetVAPIHVAC07_Group
            14 x arg:
              VAPI_FragCartKind_Set: type=uint8_t, direction=IN
              VAPI_FragCartStrh_Set: type=uint8_t, direction=IN
              VAPI_HVACSwLck_Set: type=uint8_t, direction=IN
              VAPI_HVACExtSwLck_Set: type=uint8_t, direction=IN
              VAPI_HVAC2ndSwLck_Set: type=uint8_t, direction=IN
              VAPI_HVAC2ndExtSwLck_Set: type=uint8_t, direction=IN
              VAPI_HVAC3rdSwLck_Set: type=uint8_t, direction=IN
              VAPI_HVAC3rdExtSwLck_Set: type=uint8_t, direction=IN
              VAPI_Def_Set: type=uint8_t, direction=IN
              VAPI_DrvEvntOpSta_Set: type=uint8_t, direction=IN
              VAPI_AstEvntOpSta_Set: type=uint8_t, direction=IN
              VAPI_2ndDrvEvntOpSta_Set: type=uint8_t, direction=IN
              VAPI_2ndAstEvntOpSta_Set: type=uint8_t, direction=IN
              result: type=ErrorInfo, direction=OUT
          SetVAPILight01_Group
            7 x arg:
              VAPI_MLRedNValue_Set: type=uint16_t, direction=IN
              VAPI_MLGreenNValue_Set: type=uint16_t, direction=IN
              VAPI_MLBlueNValue_Set: type=uint16_t, direction=IN
              VAPI_MLBottomRedNValue_Set: type=uint16_t, direction=IN
              VAPI_MLBottomGreenNValue_Set: type=uint16_t, direction=IN
              VAPI_MLBottomBlueNValue_Set: type=uint16_t, direction=IN
              result: type=ErrorInfo, direction=OUT
          SetVAPISGU01_Group
            arg VAPI_SGUAllZoneSetReq_Set: type=uint8_t, direction=IN
            arg result: type=ErrorInfo, direction=OUT
          SetVAPISeat01_Group
            19 x arg:
              VAPI_DrvPwrSeatIntgMode_Set: type=uint8_t, direction=IN
              VAPI_AstPwrSeatIntgMode_Set: type=uint8_t, direction=IN
              VAPI_RLPwrSeatIntgMode_Set: type=uint8_t, direction=IN
              VAPI_RRPwrSeatIntgMode_Set: type=uint8_t, direction=IN
              VAPI_DrvIntgSwivelPos_Set: type=uint8_t, direction=IN
              VAPI_AstIntgSwivelPos_Set: type=uint8_t, direction=IN
              VAPI_DrvHeatingCoolingMode_Set: type=uint8_t, direction=IN
              VAPI_AstHeatingCoolingMode_Set: type=uint8_t, direction=IN
              VAPI_RLHeatingCoolingMode_Set: type=uint8_t, direction=IN
              VAPI_RRHeatingCoolingMode_Set: type=uint8_t, direction=IN
              VAPI_DrvMassageIntgMode_Set: type=uint8_t, direction=IN
              VAPI_AstMassageIntgMode_Set: type=uint8_t, direction=IN
              VAPI_RLMassageIntgMode_Set: type=uint8_t, direction=IN
              VAPI_RRMassageIntgMode_Set: type=uint8_t, direction=IN
              VAPI_DrvMassageMode_Set: type=uint8_t, direction=IN
              VAPI_AstMassageMode_Set: type=uint8_t, direction=IN
              VAPI_RLMassageMode_Set: type=uint8_t, direction=IN
              VAPI_RRMassageMode_Set: type=uint8_t, direction=IN
              result: type=ErrorInfo, direction=OUT
          SetVAPIShade01_Group
            6 x arg:
              VAPI_RrShadePos_Set: type=uint8_t, direction=IN
              VAPI_RLRrDrShadePos_Set: type=uint8_t, direction=IN
              VAPI_RRRrDrShadePos_Set: type=uint8_t, direction=IN
              VAPI_RLQtrShadePos_Set: type=uint8_t, direction=IN
              VAPI_RRQtrShadePos_Set: type=uint8_t, direction=IN
              result: type=ErrorInfo, direction=OUT
          SetVAPIStart01_Group
            4 x arg:
              VAPI_PwrTransEnable_Set: type=uint8_t, direction=IN
              VAPI_PwrOnMaintain_Set: type=uint8_t, direction=IN
              VAPI_PwrOnMdTimer_Set: type=uint8_t, direction=IN
              result: type=ErrorInfo, direction=OUT
          SetVAPIStrWarmer01_Group
            arg VAPI_StrgWhlWrmrMode_Set: type=uint8_t, direction=IN
            arg result: type=ErrorInfo, direction=OUT
          SetVAPITailgate01_Group
            arg VAPI_PTGInsideSwEnable_Set: type=uint8_t, direction=IN
            arg result: type=ErrorInfo, direction=OUT
          SetVINforFoD_Group  # CCU_FOD_VIN_Status
            4 x arg:
              CCU_FOD_VIN_Status: type=uint8_t, direction=IN
              CCU_FOD_VIN_Index: type=uint8_t, direction=IN
              CCU_FOD_VIN_32: type=uint32_t, direction=IN
              result: type=ErrorInfo, direction=OUT
          SetVehicleState  # HU_TeleVehicleStatusReq_Copy_2
            arg signal: type=uint8_t, direction=IN
            arg result: type=ErrorInfo, direction=OUT
          Set_DriverProfileID  # C_DriverProfileID
            arg signal: type=uint8_t, direction=IN
            arg result: type=ErrorInfo, direction=OUT
          TailLampControl  # TailCtrlReq_Copy
            arg signal: type=uint8_t, direction=IN
            arg result: type=ErrorInfo, direction=OUT
          VehicleCrankingRequest  # CCU_OTA_Tele_Cranking
            arg signal: type=uint8_t, direction=IN
            arg result: type=ErrorInfo, direction=OUT
          WindowControlQtrCurtain_Group
            arg QtrRLCurtainCCSReq: type=uint8_t, direction=IN
            arg QtrRRCurtainCCSReq: type=uint8_t, direction=IN
            arg result: type=ErrorInfo, direction=OUT
          WindowControlRearCurtain_Group
            arg RrRLDrCurtainCCSReq: type=uint8_t, direction=IN
            arg RrRRDrCurtainCCSReq: type=uint8_t, direction=IN
            arg result: type=ErrorInfo, direction=OUT
          WindowControl_Group  # C_DrvWindowCmdAVN_Copy_2
            5 x arg:
              C_DrvWindowCmdAVN_Copy_2: type=uint8_t, direction=IN
              C_AstWindowCmdAVN_Copy_2: type=uint8_t, direction=IN
              C_RLWindowCmdAVN_Copy_2: type=uint8_t, direction=IN
              C_RRWindowCmdAVN_Copy_2: type=uint8_t, direction=IN
              result: type=ErrorInfo, direction=OUT
          WindowFrontControl_Group
            arg C_DrvWindowCmdAVN_Copy_2: type=uint8_t, direction=IN
            arg C_AstWindowCmdAVN_Copy_2: type=uint8_t, direction=IN
            arg result: type=ErrorInfo, direction=OUT
          compressorControlRequire  # CompControlReq
            arg signal: type=uint8_t, direction=IN
            arg result: type=ErrorInfo, direction=OUT
    CIDSDiagInfo: major-version=1, minor-version=0
      namespaces:
        symbol props Vehicle
        symbol props CIDS
        symbol props CIDSDiagInfo
      methods:
        8 x operation:
          GetAppInfo  # &nbsp; &nbsp;
            arg majorVer: type=uint32_t, direction=OUT
            arg ruleVer: type=uint32_t, direction=OUT
            arg policyVer: type=uint32_t, direction=OUT
          GetAppState  # CIDS의 상태 정보 LID: 0x0C14 (0x0: Default, 0x1: ON, 0x2: OFF, 0x3~0xF: RESERVED)
            arg state: type=uint8_t, direction=OUT
          RemoveBusOffLog
            arg errCode: type=uint8_t, direction=OUT
          RemoveTimeOutLog
            arg errCode: type=uint8_t, direction=OUT
          RequestAlertLog  # CIDS 공격 탐지 결과 추출 LID: 0x0C15, 0C16, 0C17
            arg DID: type=uint16_t, direction=IN
            arg alertLogs: type=RequestAlertLog_alertLogs_VECTOR, direction=OUT
          RequestBusOffLog
            arg DID: type=uint16_t, direction=IN
            arg busOffLogs: type=RequestBusOffLog_busOffLogs_VECTOR, direction=OUT
          RequestTimeOutLog
            arg DID: type=uint16_t, direction=IN
            arg timeOutLogs: type=RequestTimeOutLog_timeOutLogs_VECTOR, direction=OUT
          SetAppState  # CIDS 제어 명령 LID: 0x12A5 (0x00: RESERVED, 0x01: ON, 0x02: OFF, 0x03~0xFF: RESERVED)
            arg cidscont: type=uint8_t, direction=IN
    CIDSInfo: major-version=1, minor-version=0
      namespaces:
        symbol props Vehicle
        symbol props CIDS
        symbol props CIDSInfo
      field CidsAppInfo: type=CidsAppInfo, has-getter=true, has-notifier=true, has-setter=false
      field CidsAppState: type=CidsAppState, has-getter=true, has-notifier=true, has-setter=false
      methods:
        operation GetCidsStatistics
          arg statistics: type=CPP/Statistics, direction=OUT
        operation GetVersionInfo
          arg cidsVersion: type=CidsVersionInfo, direction=OUT
    Chassis: major-version=1, minor-version=2
      namespaces:
        symbol props Vehicle
        symbol props SOAAdaptor
        symbol props Chassis
      events:
        data MDPS_01_10ms: type=MDPS_01_10ms_EventData
        data SAS_01_10ms: type=SAS_01_10ms_EventData
        data WHL_01_10ms: type=WHL_01_10ms_EventData
      16 x field, all with has-getter=true, has-notifier=true, has-setter=false:
        EPBforceState: type=CPP/SignalInfo_UInt8  # EPB_FrcSta
        FLTirePressureInfo: type=CPP/SignalInfo_UInt8  # TPMS_FLTirePrsrVal
        FRTirePressureInfo: type=CPP/SignalInfo_UInt8  # TPMS_FRTirePrsrVal
        ParkingBrakeLampState: type=CPP/SignalInfo_UInt8  # EPB_LmpStaDis
        ParkingBrakeState: type=CPP/SignalInfo_UInt8  # ESC_PrkBrkActvSta
        PetModRdySta: type=CPP/SignalInfo_UInt8  # VPC_PetModRdySta
        PetSafetymode: type=CPP/SignalInfo_UInt8  # VPC_PetSafetymode
        RLTirePressureInfo: type=CPP/SignalInfo_UInt8  # TPMS_RLTirePrsrVal
        RRTirePressureInfo: type=CPP/SignalInfo_UInt8  # TPMS_RRTirePrsrVal
        TPMSFLPositionWarningLampState: type=CPP/SignalInfo_UInt8  # TPMS_FLPosWrngLmpSta
        TPMSFRPositionWarningLampState: type=CPP/SignalInfo_UInt8  # TPMS_FRPosWrngLmpSta
        TPMSPressureUnit: type=CPP/SignalInfo_UInt8  # TPMS_PrsrUnitSta
        TPMSRLPostionWarningLampState: type=CPP/SignalInfo_UInt8  # TPMS_RLPosWrngLmpSta
        TPMSRRPostionWarningLampState: type=CPP/SignalInfo_UInt8  # TPMS_RRPosWrngLmpSta
        TPMSThreadWarningLampState: type=CPP/SignalInfo_UInt8  # TPMS_TreadWrngLmpSta
        WheelVelocityVal: type=CPP/SignalInfo_Float  # WHL_SpdFLVal
    Communicator: major-version=1, minor-version=0
      namespaces:
        symbol props Vehicle
        symbol props Telemanager
        symbol props Communicator
      field PrivacyOfflineMode: type=bool, has-getter=true, has-notifier=true, has-setter=false
    Communicator: major-version=2, minor-version=0
      namespaces:
        symbol props CCU
        symbol props Cloud
        symbol props Communicator
      events:
        data MORequestChanged: type=MORequestChanged_EventData  # This event indicates that a MO Request status has been changed.
        data MTRequestAdded: type=MTRequestAdded_EventData  # This event indicates that a new CCS MT request has been received and stored into queue.
        data MTRequestRemoved: type=MTRequestRemoved_EventData  # This event indicates that a CCS MT request has been removed from the task queue.
      field LastActiveUser: type=uint32_t, has-getter=true, has-notifier=true, has-setter=false  # Leave the last remote control user's information.
      field MTRequestQueue: type=MTRequestQueue_VECTOR, has-getter=true, has-notifier=true, has-setter=false  # The CCS service request for the HeadUnit is converted to a struct CCSRequest object and that will be listed in the Received Item. ServiceName : Destination Service Name (Reserved Field) TimeStamp : "2020-09-10 10:20:30.0" MSGID : Timestamp in which a 4byte integer is expressed in characters. However, If sending/receiving with SMS+ scheme, MSGID field is used for MSGID(4Byte) of SMS. TransactionID: Transaction ID is assigned by the server Scheme : CCS Protocol Scheme of CCS Request Object. (HTTP+, SMS+) Status : Processing status of CCS Request Object, Initial status is Idle. Message : Received Message Object
      methods:
        operation ProcessMTRequest  # Endpoint ECU informs to CCU that a struct CCSRequest object is being processing. And the CCU changes the status of the message to processing.
          arg transactionID: type=String, direction=IN
          arg error_of_CommonAPI: type=ProcessMTRequestError, direction=OUT
          arg status: type=MTMessageStatus, direction=OUT
        operation RemoveMTRequest  # The Endpoint ECU requests that the MT request was processed by Communicator and that the request be automatically deleted.
          arg transactionID: type=String, direction=IN
          arg error_of_CommonAPI: type=RemoveMTRequestError, direction=OUT
        operation SendMORequest  # Send a message to recipient. Send Result will be reported by MORequestChanged event.
          arg item: type=CCSRequest, direction=IN
          arg error_of_CommonAPI: type=CPP/MessageError, direction=OUT
          arg msgID: type=String, direction=OUT
    ConnectionContext: major-version=2, minor-version=1
      namespaces:
        symbol props DCU
        symbol props Telephony
        symbol props ConnectionContext
      28 x field, all with has-getter=true, has-notifier=true:
        AccessPointName: type=String, has-setter=true  # Holds the name of the access point. This is abbreviated as APN. This value cannot be changed when the context is active.
        AutoConnect: type=bool, has-setter=true  # To improve remote control service time, DCU will activate data connection when receiving SMS from center on remoted service mode (336h remote control mode). For this, CCU should send CCS APN for remote control service on every booting time.
        ContextIndex: type=CPP/ContextIndex, has-setter=false  # Holds the Context Index for this Connection Context. This Context Index is for managing and transferring connections into the in vehicle network from outer network. Internally, the telephony service provides VLAN IDs and regarding network information following to network specifications by Context Index. Example network configuration for -ContextIndex : CONTEXT_INDEX_0 -VLANID : 0x803 (2051) -Interface : eth0.2051 -Address : 192.168.220.8 -RemoteAddress : 192.168.220.4 -Netmask : 255.255.255.0
        ContextPath: type=String, has-setter=false  # Holds the ContextPath is a self-rule-based string type object path that the telephony middleware generates on its own when it ContextAdded. Each modem manufacturer can have a different generation rule.
        DeactivateReason: type=CPP/DeactivateReason, has-setter=false  # Deactivate data call reasons
        IPV6_Settings_Address: type=String, has-setter=false  # The external network interface information in the network operator's direction. This information is determined by the modem after context activation. Holds the IP address assigned to the context.
        IPV6_Settings_DomainNameServers: type=IPV6_Settings_DomainNameServers_VECTOR, has-setter=false  # The external network interface information in the network operator's direction. This information is determined by the modem after context activation. Holds the list of domain name servers assigned to the context.
        IPV6_Settings_Gateway: type=String, has-setter=false  # The external network interface information in the network operator's direction. This information is determined by the modem after context activation. Holds the gateway for this connection.
        IPV6_Settings_Interface: type=String, has-setter=false  # The external network interface information in the network operator's direction. This information is determined by the modem after context activation. Holds the network interface name assigned to the context. (e.g. "rmnet0")
        IPV6_Settings_PrefixLength: type=String, has-setter=false  # The external network interface information in the network operator's direction. This information is determined by the modem after context activation. Holds the prefix length assigned to the context.
        IVN_Settings_Address: type=String, has-setter=false  # The network interface information in the Internal VLAN Network's direction. This information is determined by the modem after context activation. Holds the local IP address. Examples local IP address for CCU-DCU network topology VLAN 0x803(2051) → 192.168.220.8 VLAN 0x804(2052) → 192.168.221.8 VLAN 0x805(2053) → 192.168.221.8 VLAN 0x806(2054) → 192.168.221.8
        IVN_Settings_Interface: type=String, has-setter=false  # The network interface information in the Internal VLAN Network's direction. This information is determined by the modem after context activation. Holds the local network interface name for internal forwarding network domain. Examples for local network interface name. "eth0.2051", "eth0.2052", "eth0.2053", "eth0.2054"
        IVN_Settings_Netmask: type=String, has-setter=false  # The network interface information in the Internal VLAN Network's direction. This information is determined by the modem after context activation. Holds the netmask for local-remote network. Examples for Subnet Mask : 255.255.255.0
        IVN_Settings_RemoteAddress: type=String, has-setter=false  # The network interface information in the Internal VLAN Network's direction. This information is determined by the modem after context activation. Holds the remote IP address. Examples remote IP address value for CCU-DCU network topology VLAN 0x803(2051) → 192.168.220.4 VLAN 0x804(2052) → 192.168.221.4 VLAN 0x805(2053) → 192.168.221.4 VLAN 0x806(2054) → 192.168.221.4
        IVN_Settings_VLANID: type=String, has-setter=false  # The network interface information in the Internal VLAN Network's direction. This information is determined by the modem after context activation. Holds the VLAN ID for internal forwarding network domain. Examples for CCU-DCU external network connection 0x803(2051), 0x804(2052), 0x805(2053), 0x806(2054)
        Name: type=String, has-setter=true  # The name is a free form string that describes this context. The name should not be empty and limited to a short string for display purposes.
        Password: type=String, has-setter=true  # Holds the password to be used for authentication purposes. his value cannot be changed when the context is active.
        Protocol: type=String, has-setter=true  # Holds the protocol for this context. Valid values are: "ip", "ipv6" and "dual".
        Settings_Address: type=String, has-setter=false  # The external network interface information in the network operator's direction. This information is determined by the modem after context activation. Holds the IP address assigned to the context.
        Settings_DomainNameServers: type=Settings_DomainNameServers_VECTOR, has-setter=false  # The external network interface information in the network operator's direction. This information is determined by the modem after context activation. Holds the list of domain name servers assigned to the context.
        Settings_Gateway: type=String, has-setter=false  # The external network interface information in the network operator's direction. This information is determined by the modem after context activation. Holds the gateway for this connection.
        Settings_Interface: type=String, has-setter=false  # The external network interface information in the network operator's direction. This information is determined by the modem after context activation. This means that regarding network resources can be changed during the activation process. Holds the network interface name assigned to the context. (e.g. "rmnet0")
        Settings_Method: type=String, has-setter=false  # The external network interface information in the network operator's direction. Holds the network interface config methods assigned to the context. "static"- Set IP network statically "dhcp" - Set IP network through DHCP
        Settings_Netmask: type=String, has-setter=false  # The external network interface information in the network operator's direction. This information is determined by the modem after context activation. Holds the netmask assigned to the context.
        Settings_Proxy: type=String, has-setter=false  # The external network interface information in the network operator's direction. This information is determined by the modem after context activation. Holds the proxy for this connection.
        Status: type=CPP/ContextStatus, has-setter=false  # Holds the status of Connection Context
        Type: type=String, has-setter=true  # Contains the intended usage type for this context.
        Username: type=String, has-setter=true  # Holds the username to be used for authentication purposes. This value cannot be changed when the context is active.
      methods:
        operation Activate  # Activate PDP Context Request. The network resources in the external interface(Field Settings, IPv6_Settings) is determined by the modem after context activation. The network resources in the external interface area is determined by the modem after context activation. The remote peer should always consider that network resources can access after external network is activated.
          arg error_of_CommonAPI: type=CPP/ContextError, direction=OUT
        operation Deactivate  # Deactivate PDP Context Request
          arg error_of_CommonAPI: type=CPP/ContextError, direction=OUT
        operation SetContextIndex  # Request to changing the ContextIndex from the default assigned context index. The ContextIndex value to be setted is must be that is not used elsewhere instance. In this conflicted case will return to Error "DuplicatedIndex". Of course, the value of CONTEXT_INVALID is not available. The ContextIndex value changing is not allowed in a Post-Activate state. In this state error case will return to Error "InvalidStatus".
          arg index: type=CPP/ContextIndex, direction=IN
          arg error_of_CommonAPI: type=CPP/SetContextIndexError, direction=OUT
    ConnectionManager: major-version=2, minor-version=0
      namespaces:
        symbol props DCU
        symbol props Telephony
        symbol props ConnectionManager
      events:
        data ContextAdded: type=ContextAdded_EventData  # This event indicates that the ConnectionContext has added. The ContextPath is a self-rule-based string type object path that the telephony middleware generates on its own when it ContextAdded.
        data ContextRemoved: type=ContextRemoved_EventData  # This event indicates that the ConnectionContext has removed
      methods:
        5 x operation:
          AddContext  # Request to creating a new connection context. Input argument AccessPointName is used for specify "Access Point Name" that you want to activate through this Connection Context. Input argument Protocol is used for specify ip mode that you want to activate. Valid values for Protocol is "ip", "ipv6" and "dual" Output argument ContextPath is a self-rule-based string type object path that the telephony middleware generates on its own when it ContextAdded.
            4 x arg:
              accessPointName: type=String, direction=IN
              protocol: type=String, direction=IN
              error_of_CommonAPI: type=CPP/AddContextError, direction=OUT
              contextPath: type=String, direction=OUT
          DeactivateAll  # Deactivates all active contexts
            arg error_of_CommonAPI: type=CPP/ContextError, direction=OUT
          GetContext  # Gets the registered connection context wite ContextID on the modem.
            arg contextPath: type=String, direction=IN
            arg error_of_CommonAPI: type=CPP/GetContextError, direction=OUT
            arg item: type=CPP/ConnectionContextItem, direction=OUT
          GetContexts  # Gets the registered connection contexts on the modem.
            arg items: type=GetContexts_items_VECTOR, direction=OUT
          RemoveContext  # Request to remove a existing connection context. When an object is removed, the ContextIndex value is changed to CONTEXT_INVALID and regarding properties are also cleared.
            arg contextPath: type=String, direction=IN
            arg error_of_CommonAPI: type=CPP/RemoveContextError, direction=OUT
    DataCollection: major-version=1, minor-version=0
      namespaces:
        symbol props Vehicle
        symbol props SOAAdaptor
        symbol props DataCollection
      events:
        data CapturedMessages: type=CapturedMessages_EventData  # [SOME/IP-TP] Events to notify captured messages.
      methods:
        operation SubscribeToMessages  # [SOME/IP-TP] 1. VCRM (VDC) will update the array whenever a new policy is received from the cloud. 2. If the array is empty, SOA should not send any messages to VCRM. 3. When the array is updated and a BusAndMessageId is removed from the array, SOA should stop sending that message to VCRM.
          arg busAndMessageIds: type=SubscribeToMessages_busAndMessageIds_VECTOR, direction=IN
          arg errorinfo: type=MessageSubscriptionError, direction=OUT
    DebugSnapshot: major-version=1, minor-version=0
      namespaces:
        symbol props Vehicle
        symbol props LogCollection
        symbol props DebugSnapshot
      events:
        data IsCompleteDebugSnapshot: type=IsCompleteDebugSnapshot_EventData
      methods:
        operation InsertTag
          arg appid: type=uint32_t, direction=IN
          arg ctxtid: type=uint32_t, direction=IN
          arg message: type=String, direction=IN
        operation StartDebugSnapshot
          arg appId: type=String, direction=IN
    DeltaUpdate: major-version=1, minor-version=0
      namespaces:
        symbol props Vehicle
        symbol props SelfUpdateEngine
        symbol props DeltaUpdate
      field CurrentSelfUpdateStatus: type=SelfUpdateEngineStatusType, has-getter=true, has-notifier=true, has-setter=false
      field ProcessProgress: type=uint8_t, has-getter=true, has-notifier=true, has-setter=false
      methods:
        10 x operation:
          ActivatingUpdate
            arg error: type=SelfupdateEngineErrorDomain, direction=OUT
          ExecuteFwDeltaUpdate
            arg swPackagePath: type=String, direction=IN
            arg error: type=SelfupdateEngineErrorDomain, direction=OUT
          FinishUpdate
            arg error: type=SelfupdateEngineErrorDomain, direction=OUT
          GetVersion
            arg swNameVersion: type=GetVersion_swNameVersion_VECTOR, direction=OUT
            arg error: type=SelfupdateEngineErrorDomain, direction=OUT
          InitUpdate
            arg error: type=SelfupdateEngineErrorDomain, direction=OUT
          RevertUpdate
            arg error: type=SelfupdateEngineErrorDomain, direction=OUT
          RollingbackUpdate
            arg error: type=SelfupdateEngineErrorDomain, direction=OUT
          SelfUpdateDowngradeCheck
            arg error: type=SelfupdateEngineErrorDomain, direction=OUT
          StartSelfUpdate
            arg swPackageName: type=String, direction=IN
            arg error: type=SelfupdateEngineErrorDomain, direction=OUT
          StopSelfUpdate: fire-and-forget=true
    DiagnosticRouting: major-version=2, minor-version=2
      namespaces:
        symbol props CCU
        symbol props Vehicle
        symbol props DiagnosticRouting
      events:
        data DiagnosisStateChanged: type=DiagnosisStateChanged_EventData  # Change the diagnosis status.
        data HigherPriorityDiagnosisServiceStarted: type=HigherPriorityDiagnosisServiceStarted_EventData  # Call back when higher priority diagnosis service started
      field DiagnosisQueue: type=DiagnosisQueue_VECTOR, has-getter=true, has-notifier=true, has-setter=false  # List of diagnosis requests.
      field DiagnosisService: type=DiagnosisServices, has-getter=true, has-notifier=true, has-setter=false  # Indicates which DiagnosisService is operating now.
      field Status: type=DiagSystemStatus, has-getter=true, has-notifier=true, has-setter=false  # Indicates the operational status of the diagnostic system.
      methods:
        5 x operation:
          GetDiagnosisService  # Get privilege for the diagnostic service
            arg diagserviceID: type=DiagnosisServices, direction=IN
            arg result: type=DiagnosisResult, direction=OUT
          GetDiagnosisTarget  # Get exclusive session for the diagnostic target
            arg diagserviceID: type=DiagnosisServices, direction=IN
            arg diagnosisId: type=uint32_t, direction=IN
            arg result: type=DiagnosisResult, direction=OUT
          ReleaseDiagnosisService  # Release privilege for the diagnostic service
            arg diagserviceID: type=DiagnosisServices, direction=IN
          ReleaseDiagnosisTarget  # Release exclusive session for the diagnostic service
            arg diagserviceID: type=DiagnosisServices, direction=IN
            arg diagnosisId: type=uint32_t, direction=IN
          RequestDiagnosis  # Request diagnosis.
            arg req: type=DiagReqItem, direction=IN
            arg error_of_CommonAPI: type=CPP/RequestError, direction=OUT
            arg tid: type=uint32_t, direction=OUT
    DiagnosticService: major-version=2, minor-version=0
      namespaces:
        symbol props CCU
        symbol props Vehicle
        symbol props DiagnosticService
      methods:
        operation GetVIN  # Acquire VIN (Vehicle Identification Number) using the diagnostic protocol. In the diagnostic communication is not available which limited situations, a failed error could be return.
          arg error_of_CommonAPI: type=CPP/RequestError, direction=OUT
          arg vin: type=String, direction=OUT
          arg updated: type=bool, direction=OUT
    DynamicRouting: major-version=1, minor-version=0
      namespaces:
        symbol props Vehicle
        symbol props SOAAdaptor
        symbol props DynamicRouting
      methods:
        operation GetPDUlist  # [SOME/IP-TP] The app requests the required message, and the SoA Adapter provides the result as an output.
          arg busAndMessageIds: type=GetPDUlist_busAndMessageIds_VECTOR, direction=IN
          arg messageInfo: type=GetPDUlist_messageInfo_VECTOR, direction=OUT
    EIDSDiagInfo: major-version=1, minor-version=0
      namespaces:
        symbol props Vehicle
        symbol props EIDS
        symbol props EIDSDiagInfo
      methods:
        operation GetAppInfo
          arg majorVer: type=uint32_t, direction=OUT
          arg ruleVer: type=uint32_t, direction=OUT
          arg policyVer: type=uint32_t, direction=OUT
        operation GetAppState
          arg state: type=uint8_t, direction=OUT
    EIDSInfo: major-version=1, minor-version=0
      namespaces:
        symbol props Vehicle
        symbol props EIDS
        symbol props EIDSInfo
      field EidsAppInfo: type=EidsAppInfo, has-getter=true, has-notifier=true, has-setter=false
      field EidsAppState: type=EidsAppState, has-getter=true, has-notifier=true, has-setter=false
      methods:
        operation GetEidsStatistics
          arg statistics: type=CPP/Statistics, direction=OUT
        operation GetVersionInfo
          arg eidsVersion: type=EidsVersionInfo, direction=OUT
    EcDec: major-version=1, minor-version=3
      namespaces:
        symbol props Vehicle
        symbol props Security
        symbol props EcDec
      methods:
        19 x operation:
          CrypCMAC_Buf  # AES-CMAC 암호화 요청을 처리하기 위한 api
            9 x arg:
              proxy_id: type=uint8_t, direction=IN
              key_name: type=ByteArray, direction=IN
              key_name_len: type=uint32_t, direction=IN
              inText: type=ByteArray, direction=IN
              inLen: type=uint32_t, direction=IN
              key_size: type=uint32_t, direction=IN
              err: type=CPP/ErrCode, direction=OUT
              cmac: type=ByteArray, direction=OUT
              len: type=uint32_t, direction=OUT
          CrypDelete_Data  # 불용 api
            arg obj_name: type=ByteArray, direction=IN
            arg err: type=CPP/ErrCode, direction=OUT
          CrypDelete_aes_key_from_hse  # hse에서 key_name키를 삭제합니다.
            4 x arg:
              key_name: type=ByteArray, direction=IN
              key_name_len: type=uint32_t, direction=IN
              key_len: type=uint32_t, direction=IN
              err: type=CPP/ErrCode, direction=OUT
          CrypDelete_aes_key_from_ss  # Secure Storage에서 key_name 이 가리키는 키를 삭제합니다.
            4 x arg:
              key_name: type=ByteArray, direction=IN
              key_name_len: type=uint32_t, direction=IN
              slot_id: type=uint8_t, direction=IN
              err: type=CPP/ErrCode, direction=OUT
          CrypEcDec_Buf
            14 x arg:
              proxy_id: type=uint8_t, direction=IN
              algo: type=uint8_t, direction=IN  # ECB=0, CBC=1, CTR=2
              purpose: type=uint8_t, direction=IN  # ENCRYPT=0, DECRYPT=1
              key_name: type=ByteArray, direction=IN
              key_name_len: type=uint32_t, direction=IN
              iv: type=ByteArray, direction=IN
              iv_len: type=uint32_t, direction=IN
              inText: type=ByteArray, direction=IN
              inLen: type=uint32_t, direction=IN
              key_size: type=uint32_t, direction=IN
              err: type=CPP/ErrCode, direction=OUT
              outText: type=ByteArray, direction=OUT
              len: type=uint32_t, direction=OUT
              slot_id: type=uint8_t, direction=OUT
          CrypEcDec_File
            13 x arg:
              proxy_id: type=uint8_t, direction=IN
              algo: type=uint8_t, direction=IN  # ECB=0, CBC=1, CTR=2
              purpose: type=uint8_t, direction=IN  # ENCRYPT=0, DECRYPT=1
              key_name: type=ByteArray, direction=IN
              key_name_len: type=uint32_t, direction=IN
              iv: type=ByteArray, direction=IN
              iv_len: type=uint32_t, direction=IN
              inFileName: type=String, direction=IN
              start_offset: type=uint32_t, direction=IN
              end_offset: type=uint32_t, direction=IN
              outFileName: type=String, direction=IN
              key_size: type=uint32_t, direction=IN
              err: type=CPP/ErrCode, direction=OUT
          CrypGet_Data  # Get obj_name such as ECU ID stored in HSE or Secure Storage(TEE).
            4 x arg:
              obj_name: type=ByteArray, direction=IN
              err: type=CPP/ErrCode, direction=OUT
              data: type=ByteArray, direction=OUT
              data_len: type=uint32_t, direction=OUT
          CrypGet_PBKDF2  # 주어진 salt를 기반으로 Key를 유도해 돌려줍니다.
            8 x arg:
              salt: type=ByteArray, direction=IN
              salt_len: type=uint32_t, direction=IN
              err: type=CPP/ErrCode, direction=OUT
              enckey_name: type=ByteArray, direction=OUT
              enckey_name_len: type=uint32_t, direction=OUT
              cmackey_name: type=ByteArray, direction=OUT
              cmackey_name_len: type=uint32_t, direction=OUT
              slot_id: type=uint8_t, direction=OUT
          CrypGet_RandomNumber  # 요청한 길이의 랜덤넘버를 발생합니다.
            4 x arg:
              in_data_len: type=uint32_t, direction=IN
              err: type=CPP/ErrCode, direction=OUT
              data: type=ByteArray, direction=OUT
              out_data_len: type=uint32_t, direction=OUT
          CrypImport_aes_key_from_ss_to_hse  # Secure Storage에서 key_name 키를 읽어 hse slot에 넣습니다.
            arg key_name: type=ByteArray, direction=IN
            arg key_name_len: type=uint32_t, direction=IN
            arg err: type=CPP/ErrCode, direction=OUT
          CrypKeyDelete
            5 x arg:
              keyName: type=ByteArray, direction=IN
              key_name_len: type=uint32_t, direction=IN
              key_type: type=uint8_t, direction=IN  # 대칭, 비대칭키 구분 / AES = 0, ECDSA = 1
              key_size: type=uint32_t, direction=IN
              err: type=CPP/ErrCode, direction=OUT
          CrypKeyImport
            5 x arg:
              keyName: type=ByteArray, direction=IN
              key_name_len: type=uint32_t, direction=IN
              key_type: type=uint8_t, direction=IN  # 대칭, 비대칭키 구분 / AES = 0, ECDSA = 1
              key_size: type=uint32_t, direction=IN
              err: type=CPP/ErrCode, direction=OUT
          CrypLoad_Data  # 불용 api
            4 x arg:
              obj_name: type=ByteArray, direction=IN
              err: type=CPP/ErrCode, direction=OUT
              data: type=ByteArray, direction=OUT
              data_len: type=uint32_t, direction=OUT
          CrypSave_Data  # 불용 api
            4 x arg:
              obj_name: type=ByteArray, direction=IN
              data: type=ByteArray, direction=IN
              data_len: type=uint32_t, direction=IN
              err: type=CPP/ErrCode, direction=OUT
          CrypShaDigest
            5 x arg:
              inData: type=ByteArray, direction=IN
              inDataLen: type=uint32_t, direction=IN
              err: type=CPP/ErrCode, direction=OUT
              sha256digest: type=ByteArray, direction=OUT
              len: type=uint32_t, direction=OUT
          CrypVerify_Buf
            12 x arg:
              proxy_id: type=uint8_t, direction=IN
              algo: type=uint8_t, direction=IN  # RSA=1
              key_name: type=ByteArray, direction=IN
              key_name_len: type=uint32_t, direction=IN
              inText: type=ByteArray, direction=IN
              len: type=uint32_t, direction=IN
              DigestMode: type=uint8_t, direction=IN
              sign: type=ByteArray, direction=IN
              sign_len: type=uint32_t, direction=IN
              key_size: type=uint32_t, direction=IN
              purpose: type=uint8_t, direction=IN
              err: type=CPP/ErrCode, direction=OUT
          CrypVerify_CMAC  # cmac_to_verify 값을 검증합니다.
            6 x arg:
              cmackey_name: type=ByteArray, direction=IN
              cmackey_name_len: type=uint32_t, direction=IN
              enckey_name: type=ByteArray, direction=IN
              enckey_name_len: type=uint32_t, direction=IN
              cmac_to_verify: type=ByteArray, direction=IN
              err: type=CPP/ErrCode, direction=OUT
          CrypVerify_File
            11 x arg:
              proxy_id: type=uint8_t, direction=IN
              algo: type=uint8_t, direction=IN  # RSA=1
              key_name: type=ByteArray, direction=IN
              key_name_len: type=uint32_t, direction=IN
              inFileName: type=String, direction=IN
              DigestMode: type=uint8_t, direction=IN
              sign: type=ByteArray, direction=IN
              sign_len: type=uint32_t, direction=IN
              key_size: type=uint32_t, direction=IN
              purpose: type=uint8_t, direction=IN
              err: type=CPP/ErrCode, direction=OUT
          CrypVerify_Sign  # 인증서에있는 sign 내용을 검증합니다.
            8 x arg:
              algo: type=uint8_t, direction=IN
              key_name: type=ByteArray, direction=IN
              key_name_len: type=uint32_t, direction=IN
              data: type=ByteArray, direction=IN
              data_len: type=uint32_t, direction=IN
              sign: type=ByteArray, direction=IN
              sign_len: type=uint32_t, direction=IN
              err: type=CPP/ErrCode, direction=OUT
    EngineeringMode: major-version=2, minor-version=1
      namespaces:
        symbol props DCU
        symbol props Telephony
        symbol props EngineeringMode
      methods:
        operation GetProperty  # Get the value to be used for Engineering Mode. If delimiter exists, there are several Values.
          arg keyinfo: type=String, direction=IN
          arg valueinfo: type=String, direction=OUT
          arg delimiter: type=String, direction=OUT
        operation SetProperty  # Set a value to be used for Engineering Mode.
          arg keyinfo: type=String, direction=IN
          arg valueinfo: type=String, direction=IN
          arg error_of_CommonAPI: type=CPP/SetPropertyError, direction=OUT
    EngineeringMode: major-version=2, minor-version=0
      namespaces:
        symbol props Info
        symbol props System
        symbol props EngineeringMode
      field ActionLists: type=ActionLists_VECTOR, has-getter=true, has-notifier=true, has-setter=false  # In the Engineering Mode screen, possible to select the target to collect logs and select the log level. When the user clicks the log request button on the device, a new LogAction object is created and the subscribers are receives and performs the that request. If the user cancel the request on UI or changes to a system error state(network file transfer fail, usb file transfer fail, timeouts, removed USB media from system) cases, the LogStatus value of the object also changes to Failure.
      methods:
        operation StartLogTransfer  # When the subscriber returns the log file transfer request, the endpoint ECU should invoke this method to information that it is in a transfer state with total file size and count arguments.The Host will check with this information the availability of usb storage. If the storage is not enough to store, NOT_READY error will return and LogStatus of LogAction will changed to Failed.
          4 x arg:
            action: type=CPP/LogAction, direction=IN
            fileTotalSize: type=uint32_t, direction=IN
            fileTotalCounts: type=uint16_t, direction=IN
            error_of_CommonAPI: type=CPP/LogTransferError, direction=OUT
        operation StopLogTransfer  # When the subscriber finished the log file transfer request, the endpoint ECU should invoke this method to inform that it is in a process Success/Failure state.Subscribers send multiple log files by sequentially.If an error occurs while transferring a file, subscriber have to send it again after 5 seconds up to 5 times. And if reach to 5 times fails, call the StopLogTransfer command to notify host that boolean success field as false. Normally, boolean success field is 'true' when transmission is successful.
          arg action: type=CPP/LogAction, direction=IN
          arg success: type=bool, direction=IN
          arg error_of_CommonAPI: type=CPP/LogTransferError, direction=OUT
        operation TransferLogFile  # This method is used to transfer each file to a host. Invoke the method with the requested LogAction object, blobs for file and file's meta information. If an error occurs while transferring a file, subscriber have to send it again after 5 seconds up to 5 times. And if reach to 5 times fails, call the StopLogTransfer command to notify host.
          7 x arg:
            action: type=CPP/LogAction, direction=IN
            fileName: type=String, direction=IN
            fileSize: type=uint32_t, direction=IN
            fileCount: type=uint16_t, direction=IN
            fileTotalCounts: type=uint16_t, direction=IN
            blob: type=ByteArray, direction=IN
            error_of_CommonAPI: type=CPP/TransferError, direction=OUT
    EngineeringMode: major-version=2, minor-version=2
      namespaces:
        symbol props Info
        symbol props Cloud
        symbol props EngineeringMode
      4 x field, all with has-getter=true, has-notifier=true, has-setter=false:
        Environments: type=CPP/InfrastructureEnvironments  # Indicates the information on the service environment. The users able to change the operating environments transition from engineering mode. That case the Environments field is changed. This field is changed to the "Default" if the override is no longer performed.
        EnvironmentsAddress: type=CPP/KeyValue  # This information represents the override basic connection information for connecting connections. Permitted Key Lists on Provisioning Table -CCS.host -CCS.port
        TestIdentifiers: type=CPP/KeyValue  # The values of this data structure are applied first as a vehicle identifier when connecting a connected car service. If an identifier value has been overridden in engineering mode, overridden full list is kepted. removed field will not listed. Permitted Key Lists on Test Identifiers -VIN
        TimeStamp: type=String  # Indicates the timestamp that field is updated when the engineering mode item renewed. The format is following to "YYYY/MM/DD HH:MM:SS"
      methods:
        13 x operation:
          GetProvisioningStatus  # Get Provisioning Status that was overridden in Engineering Mode.
            arg status: type=CPP/ProvisioningStatus, direction=OUT
          GetTestICCID  # Get a Test ICCID Number (Dummy ICCID)
            arg iccid: type=String, direction=OUT
          GetTestIMSI  # Get a Test IMSI Number (Dummy IMSI)
            arg imsi: type=String, direction=OUT
          GetTestMDN  # Get a Test MDN Number. (Dummy MDN)
            arg mdn: type=String, direction=OUT
          GetTestMSISDN  # Get a Test MSISDN Number (Dummy MSISDN)
            arg msisdn: type=String, direction=OUT
          GetTestVIN  # Get a Test VIN Number (Dummy VIN)
            arg vin: type=String, direction=OUT
          ResetProvisioningStatus  # Reset the override provisioning status.
            arg status: type=CPP/ProvisioningStatus, direction=OUT
          SetProvisioningStatus  # Force override the provisioning status manually Field ProvisioningStatus of Info.Cloud.ProvisioningTable will be effected.
            arg status: type=CPP/ProvisioningStatus, direction=IN
          SetTestICCID  # Set the Test ICCID Number (Dummy ICCID)
            arg iccid: type=String, direction=IN
          SetTestIMSI  # Set the Test IMSI Number (Dummy IMSI)
            arg imsi: type=String, direction=IN
          SetTestMDN  # Set the Test MDN Number. (Dummy MDN)
            arg mdn: type=String, direction=IN
          SetTestMSISDN  # Set the Test MSISDN Number (Dummy MSISDN)
            arg msisdn: type=String, direction=IN
          SetTestVIN  # Set the Test VIN Number (Dummy VIN)
            arg vin: type=String, direction=IN
    EngineeringMode: major-version=1, minor-version=0
      namespaces:
        symbol props CCU
        symbol props System
        symbol props EngineeringMode
      methods:
        operation GetProperty  # Get property value(s) for System's Engineering Mode. Value field is defined as an array of strings. Since it is a string array, can handle all of cases where there is no value, one and more values with single interface.
          arg keyinfo: type=String, direction=IN
          arg error_of_CommonAPI: type=PropertyError, direction=OUT
          arg valueinfo: type=GetProperty_valueinfo_VECTOR, direction=OUT
        operation SetProperty  # Set property value(s) for System's Engineering Mode.
          arg keyinfo: type=String, direction=IN
          arg valueinfo: type=String, direction=IN
          arg error_of_CommonAPI: type=PropertyError, direction=OUT
    EthernetSwitchMgr: major-version=1, minor-version=1
      namespaces:
        symbol props Vehicle
        symbol props EthHandler
        symbol props EthernetSwitchMgr
      field EmtLinkUp: type=bool, has-getter=true, has-notifier=true, has-setter=false
      methods:
        31 x operation:
          DownloadImage  # This function download the switch image to the switch flash
            arg imageFilePath: type=String, direction=IN
            arg error: type=EthOtaError, direction=OUT
          EnableERTLogging  # Control ERT port VLAN / True : on, False : Off / option : reserved
            arg onOff: type=bool, direction=IN
            arg option: type=uint32_t, direction=IN
          FinishImage
            arg error: type=EthOtaError, direction=OUT
          GetConfigurationVersion  # This function returns the current running switch configuration version
            arg version: type=String, direction=OUT
            arg error: type=EthOtaError, direction=OUT
          GetLinkStatus
            arg ports: type=GetLinkStatus_ports_VECTOR, direction=IN
            arg linkStatus: type=PortLinkStatus, direction=OUT
            arg error: type=EthernetError, direction=OUT
          GetOtpStatus  # 스위치 키(MVK, DUK, MCK)주입 상태 확인용 RDBI $0C0C 대응 API EthernetError No_ERROR -> RDBI OK, EthernetError UNKNOWN-> RDBI Not Configured
            arg Error: type=EthernetError, direction=OUT
          GetPartitionVersion
            arg partition: type=uint8_t, direction=IN  # Get Ethernet switch partition version info
            arg version: type=String, direction=OUT
            arg error: type=EthOtaError, direction=OUT
          GetSQI
            arg ports: type=GetSQI_ports_VECTOR, direction=IN
            arg sqi: type=PortSqi, direction=OUT
            arg error: type=EthernetError, direction=OUT
          GetSwitchException
            arg exception: type=EthSwitchException, direction=OUT
          GetSwitchIVD
            arg switchIVD: type=GetSwitchIVD_switchIVD_VECTOR, direction=OUT
          GetSwitchRecoveryCount
            arg currentSwitchRecoveryCount: type=uint16_t, direction=OUT
            arg historicSwitchRecoveryCount: type=uint16_t, direction=OUT
          GetSwitchStats
            arg config: type=SwitchStatsConfig, direction=IN
            arg stats: type=SwitchStats, direction=OUT
          GetSwitchStatus
            arg status: type=EthSwitchStatus, direction=OUT
          GetSwitchTemp  # Get ESW temp
            arg temp: type=uint8_t, direction=OUT
          GetWireStatus
            arg ports: type=GetWireStatus_ports_VECTOR, direction=IN
            arg status: type=PortWireConnectionStatus, direction=OUT
            arg error: type=EthernetError, direction=OUT
          GetWorstSQI
            arg ports: type=GetWorstSQI_ports_VECTOR, direction=IN
            arg sqi: type=PortSqi, direction=OUT
            arg error: type=EthernetError, direction=OUT
          InitializeUpdate
            arg error: type=EthOtaError, direction=OUT
          RequestSleep
            arg error: type=EthernetError, direction=OUT
          RequestWakeup
            arg error: type=EthernetError, direction=OUT
          RevertImage
            arg error: type=EthOtaError, direction=OUT
          RollbackImage
            arg error: type=EthOtaError, direction=OUT
          SleepRemotePhys
            arg ports: type=SleepRemotePhys_ports_VECTOR, direction=IN
            arg error: type=EthernetError, direction=OUT
          StartETHMirroring  # Start ETH Port Mirroring
            arg ingressPort: type=StartETHMirroring_ingressPort_VECTOR, direction=IN
            arg egressPort: type=StartETHMirroring_egressPort_VECTOR, direction=IN
          StartIDSMirroring
            arg error: type=EthernetError, direction=OUT
          StartVCRMMirroring
            arg error: type=EthernetError, direction=OUT
          StopETHMirroring  # Stop ETH Port Mirroring
          StopIDSMirroring
            arg error: type=EthernetError, direction=OUT
          StopVCRMMirroring
            arg error: type=EthernetError, direction=OUT
          UpdateImage  # This function execute the switch image update
            arg error: type=EthOtaError, direction=OUT
          UpdatePhys
            arg ports: type=UpdatePhys_ports_VECTOR, direction=IN
            arg onOff: type=bool, direction=IN
            arg error: type=EthernetError, direction=OUT
          WakeupRemotePhys
            arg ports: type=WakeupRemotePhys_ports_VECTOR, direction=IN
            arg error: type=EthernetError, direction=OUT
