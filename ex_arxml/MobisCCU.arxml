[part 4 of 9: package /PortInterface/Service]
AUTOSAR XML (schema 00049)
package /PortInterface/Service  (continued)
  114 x service interface:  (continued)
    Extended: major-version=1, minor-version=4
      namespaces:
        symbol props Vehicle
        symbol props SOAAdaptor
        symbol props Extended
      events:
        14 x data:
          FR_CMR_FRSD_{01..05}_00ms: type=FR_CMR_FRSD_{01..05}_00ms_EventData
          FR_CMR_RSD_{01..08}_00ms: type=FR_CMR_RSD_{01..08}_00ms_EventData
          IMU_01_10ms: type=IMU_01_10ms_EventData
      191 x field, all with has-getter=true, has-notifier=true, has-setter=false:
        AcnECompCnsmptPwrVal: type=CPP/SignalInfo_UInt16  # DATC_AcnECompCnsmptPwrVal_W
        AirCleaningOptionInfo: type=CPP/SignalInfo_UInt8  # DATC_Opt1Typ
        AirCleaningState: type=CPP/SignalInfo_UInt8  # DATC_ArClnIND
        AirCleaningStepColor: type=CPP/SignalInfo_UInt8  # DATC_ArClnStepClr
        AirConditioningOperationState: type=CPP/SignalInfo_UInt8  # DATC_BlwSta
        AirbagCrashActiveState: type=CPP/SignalInfo_UInt8  # ACU_CrshActvSta
        AirconElectricCompressorFaultState: type=CPP/SignalInfo_UInt8  # DATC_AcnCompFltSta
        BattCompPwrCnsmptn: type=CPP/SignalInfo_UInt16  # DATC_BattCompPwrCnsmptn_W2
        DATCIntakeSta: type=CPP/SignalInfo_UInt8  # DATC_IntakeSta
        DATCOptSys: type=CPP/SignalInfo_UInt32  # DATC_Opt_Sys
        DATCTypAll: type=CPP/SignalInfo_UInt16  # DATC_Typ_All_1
        DATC_3rdAutoDis: type=CPP/SignalInfo_UInt8
        DATC_3rdRowBlowerDisplay: type=CPP/SignalInfo_UInt8  # DATC_3rdBlwDis
        DATC_3rdSysOnOffDis: type=CPP/SignalInfo_UInt8
        DATC_AUTOStep: type=CPP/SignalInfo_UInt8
        DATC_AUTOStep3rd: type=CPP/SignalInfo_UInt8
        DATC_AUTOStepPS: type=CPP/SignalInfo_UInt8
        DATC_AUTOStepRR: type=CPP/SignalInfo_UInt8
        DATC_AUTOStepRRPass: type=CPP/SignalInfo_UInt8
        DATC_BlwrLvl: type=CPP/SignalInfo_UInt8
        DATC_DriverOnly: type=CPP/SignalInfo_UInt8  # DATC_DrvOnlyDis
        DATC_DrvAutoDis: type=CPP/SignalInfo_UInt8
        DATC_FrSysOnOffDis: type=CPP/SignalInfo_UInt8
        DATC_FragStrhDis: type=CPP/SignalInfo_UInt8
        DATC_FrtAstEVntModeSet_Disp: type=CPP/SignalInfo_UInt8
        DATC_FrtDrvEVntModeSet_Disp: type=CPP/SignalInfo_UInt8
        DATC_PsAutoDis: type=CPP/SignalInfo_UInt8
        DATC_RrAstEVntModeSet_Disp: type=CPP/SignalInfo_UInt8
        DATC_RrAutoDis: type=CPP/SignalInfo_UInt8
        DATC_RrBlowerDisplay: type=CPP/SignalInfo_UInt8  # DATC_RrBlwDis
        DATC_RrDrvEVntModeSet_Disp: type=CPP/SignalInfo_UInt8
        DATC_RrPassAutoDis: type=CPP/SignalInfo_UInt8
        DATC_RrSysOnOffDis: type=CPP/SignalInfo_UInt8
        DATC_SyncDisplay: type=CPP/SignalInfo_UInt8
        DATC_Typ_All_{2..5}: type=CPP/SignalInfo_UInt16
        DriverBlowState: type=CPP/SignalInfo_UInt8  # DATC_FrDrvBlwDis
        DriverTemperature_C: type=CPP/SignalInfo_Float  # DATC_DrvTempCDis
        DriverTemperature_F: type=CPP/SignalInfo_UInt16  # DATC_DrvTempFDis
        DrivingModeState: type=CPP/SignalInfo_UInt8  # CLU_DrvngModSwSta
        Drv3rdTempCDis: type=CPP/SignalInfo_Float  # DATC_3rdDrvTempCDis
        Drv3rdTempFDis: type=CPP/SignalInfo_UInt16  # DATC_3rdDrvTempFDis
        FRSD_Buffer: type=CPP/SignalInfo_UInt8
        FRSD_CRC16: type=CPP/SignalInfo_UInt16  # FRSD_crc16
        FRSD_MSGID: type=CPP/SignalInfo_UInt8  # FRSD_msgId
        FRSD_MSGType: type=CPP/SignalInfo_UInt8  # FRSD_msgType
        FRSD_PayloadSeg1_{1..4}: type=CPP/SignalInfo_UInt64  # FRSD_PldSeg1_{1..4}
        FRSD_PayloadSeg2_{1..4}: type=CPP/SignalInfo_UInt64  # FRSD_PldSeg2_{1..4}
        FRSD_PayloadSeg3_{1..4}: type=CPP/SignalInfo_UInt64  # FRSD_PldSeg3_{1..4}
        FRSD_PayloadSeg4_{1..4}: type=CPP/SignalInfo_UInt64  # FRSD_PldSeg4_{1..4}
        FRSD_Size: type=CPP/SignalInfo_UInt32  # FRSD_size
        FRSD_Zero: type=CPP/SignalInfo_UInt8  # FRSD_zero
        FineDustSensorOptionInfo: type=CPP/SignalInfo_UInt16  # DATC_Typ2
        FineDustSensorValue: type=CPP/SignalInfo_UInt16  # DATC_FnDstSnsrVal
        FineDustStep: type=CPP/SignalInfo_UInt8  # DATC_FnDstStp
        FragKindDis: type=CPP/SignalInfo_UInt8  # DATC_FragKindDis
        FrontDefogLEDState: type=CPP/SignalInfo_UInt8  # DATC_FrDfgSta
        FuelLevelState: type=CPP/SignalInfo_UInt8  # CLU_FuelLvlSta
        LowFuelWarningState: type=CPP/SignalInfo_UInt8  # CLU_LoFuelWrngSta
        OutTempOption: type=CPP/SignalInfo_UInt8  # DATC_OutTempOpt
        OutTempSensorValue: type=CPP/SignalInfo_Float  # DATC_OutTempSnsrVal
        OutsideTemperature_C: type=CPP/SignalInfo_Float  # DATC_OutTempDispC
        OutsideTemperature_F: type=SignalInfo_Int16  # DATC_OutTempDispF
        PassTempCDis: type=CPP/SignalInfo_Float  # DATC_PassTempCDis
        PassTempFDis: type=CPP/SignalInfo_UInt16  # DATC_PassTempFDis
        PtcFaultState: type=CPP/SignalInfo_UInt8  # DATC_PtcFltSta
        RRSyncDis: type=CPP/SignalInfo_UInt8  # DATC_RRSyncDis
        RSD2nd_CRC16: type=CPP/SignalInfo_UInt16  # RSD_2nd_crc16
        RSD2nd_CyclicPacketCount: type=CPP/SignalInfo_UInt8  # RSD_2nd_pCount
        RSD2nd_FirstPacketIndicate: type=CPP/SignalInfo_UInt8  # RSD_2nd_bFirst
        RSD2nd_LastPacketIndicate: type=CPP/SignalInfo_UInt8  # RSD_2nd_bLast
        RSD2nd_MSGID: type=CPP/SignalInfo_UInt8  # RSD_2nd_msgId
        RSD2nd_MSGType: type=CPP/SignalInfo_UInt8  # RSD_2nd_msgType
        RSD2nd_PayloadSeg1_{1..3}: type=CPP/SignalInfo_UInt64  # RSD_2nd_PldSeg1_{1..3}
        RSD2nd_PayloadSeg2_{1..4}: type=CPP/SignalInfo_UInt64  # RSD_2nd_PldSeg2_{1..4}
        RSD2nd_PayloadSeg3_{1..4}: type=CPP/SignalInfo_UInt64  # RSD_2nd_PldSeg3_{1..4}
        RSD2nd_PayloadSeg4_1: type=CPP/SignalInfo_UInt64  # RSD_2nd_PldSeg4_1
        RSD2nd_PayloadSeg4_2: type=CPP/SignalInfo_UInt64  # RSD_2nd_PldSeg4_2
        RSD2nd_PayloadSeg4_3: type=CPP/SignalInfo_UInt8  # RSD_2nd_PldSeg4_3
        RSD2nd_Size: type=CPP/SignalInfo_UInt32  # RSD_2nd_size
        RSD2nd_SizeReferIndicate: type=CPP/SignalInfo_UInt8  # RSD_2nd_bSent
        RSD2nd_WaitIndicate: type=CPP/SignalInfo_UInt8  # RSD_2nd_bWait
        RSD2nd_Zero: type=CPP/SignalInfo_UInt8  # RSD_2nd_zero
        RSD_CRC16: type=CPP/SignalInfo_UInt16  # RSD_crc16
        RSD_CyclicPacketCount: type=CPP/SignalInfo_UInt8  # RSD_pCount
        RSD_FirstPacketIndicate: type=CPP/SignalInfo_UInt8  # RSD_bFirst
        RSD_LastPacketIndicate: type=CPP/SignalInfo_UInt8  # RSD_bLast
        RSD_MSGID: type=CPP/SignalInfo_UInt8  # RSD_msgId
        RSD_MSGType: type=CPP/SignalInfo_UInt8  # RSD_msgType
        RSD_PayloadSeg1_{1..3}: type=CPP/SignalInfo_UInt64  # RSD_PldSeg1_{1..3}
        RSD_PayloadSeg2_{1..4}: type=CPP/SignalInfo_UInt64  # RSD_PldSeg2_{1..4}
        RSD_PayloadSeg3_{1..4}: type=CPP/SignalInfo_UInt64  # RSD_PldSeg3_{1..4}
        RSD_PayloadSeg4_1: type=CPP/SignalInfo_UInt64  # RSD_PldSeg4_1
        RSD_PayloadSeg4_2: type=CPP/SignalInfo_UInt64  # RSD_PldSeg4_2
        RSD_PayloadSeg4_3: type=CPP/SignalInfo_UInt8  # RSD_PldSeg4_3
        RSD_Size: type=CPP/SignalInfo_UInt32  # RSD_size
        RSD_SizeReferIndicate: type=CPP/SignalInfo_UInt8  # RSD_bSent
        RSD_WaitIndicate: type=CPP/SignalInfo_UInt8  # RSD_bWait
        RSD_Zero: type=CPP/SignalInfo_UInt8  # RSD_zero
        RrDrvTempCDis: type=CPP/SignalInfo_Float  # DATC_RrDrvTempCDis
        RrDrvTempFDis: type=CPP/SignalInfo_UInt16  # DATC_RrDrvTempFDis
        RrPassTempCDis: type=CPP/SignalInfo_Float  # DATC_RrPassTempCDis
        RrPassTempFDis: type=CPP/SignalInfo_UInt16  # DATC_RrPassTempFDis
        SeatBeltDriverBuckleFaultStatus: type=CPP/SignalInfo_UInt8  # SeatBelt_DrvrBcklFltSta
        SeatBeltDriverBuckleStatus: type=CPP/SignalInfo_UInt8  # SeatBelt_DrvrBcklSta
        SeatBeltPassengerBuckleFaultStatus: type=CPP/SignalInfo_UInt8  # SeatBelt_PassBcklFltSta
        SeatBeltPassengerBuckleStatus: type=CPP/SignalInfo_UInt8  # SeatBelt_PassBcklSta
        TemperatureStatus: type=CPP/SignalInfo_UInt8  # DATC_TempDispSta
        TemperatureUnitState: type=CPP/SignalInfo_UInt8  # DATC_TempDispUnitSta
        VAPI_2ndAstAuto_Res: type=CPP/SignalInfo_UInt8
        VAPI_2ndAstBlr_Res: type=CPP/SignalInfo_UInt8
        VAPI_2ndAstEvntOpSta_Res: type=CPP/SignalInfo_UInt8
        VAPI_2ndAstMod_Res: type=CPP/SignalInfo_UInt8
        VAPI_2ndAstMtAutoBlr_Res: type=CPP/SignalInfo_UInt8
        VAPI_2ndAstTmpVal_Res: type=CPP/SignalInfo_UInt8
        VAPI_2ndDrvAuto_Res: type=CPP/SignalInfo_UInt8
        VAPI_2ndDrvBlr_Res: type=CPP/SignalInfo_UInt8
        VAPI_2ndDrvEvntOpSta_Res: type=CPP/SignalInfo_UInt8
        VAPI_2ndDrvMod_Res: type=CPP/SignalInfo_UInt8
        VAPI_2ndDrvMtAutoBlr_Res: type=CPP/SignalInfo_UInt8
        VAPI_2ndDrvTmpVal_Res: type=CPP/SignalInfo_UInt8
        VAPI_3rdDrvAuto_Res: type=CPP/SignalInfo_UInt8
        VAPI_3rdDrvBlr_Res: type=CPP/SignalInfo_UInt8
        VAPI_3rdDrvMod_Res: type=CPP/SignalInfo_UInt8
        VAPI_3rdDrvMtAutoBlr_Res: type=CPP/SignalInfo_UInt8
        VAPI_3rdDrvTmpVal_Res: type=CPP/SignalInfo_UInt8
        VAPI_AllSeatCtrl_Res: type=CPP/SignalInfo_UInt8
        VAPI_AstAuto_Res: type=CPP/SignalInfo_UInt8
        VAPI_AstBlr_Res: type=CPP/SignalInfo_UInt8
        VAPI_AstEvntOpSta_Res: type=CPP/SignalInfo_UInt8
        VAPI_AstMod_Res: type=CPP/SignalInfo_UInt8
        VAPI_AstMtAutoBlr_Res: type=CPP/SignalInfo_UInt8
        VAPI_AstTmpVal_Res: type=CPP/SignalInfo_UInt8
        VAPI_BlrPrio_Res: type=CPP/SignalInfo_UInt8
        VAPI_Def_Res: type=CPP/SignalInfo_UInt8
        VAPI_DrvAuto_Res: type=CPP/SignalInfo_UInt8
        VAPI_DrvBlr_Res: type=CPP/SignalInfo_UInt8
        VAPI_DrvEvntOpSta_Res: type=CPP/SignalInfo_UInt8
        VAPI_DrvMod_Res: type=CPP/SignalInfo_UInt8
        VAPI_DrvMtAutoBlr_Res: type=CPP/SignalInfo_UInt8
        VAPI_DrvTmpVal_Res: type=CPP/SignalInfo_UInt8
        VAPI_FragCartKind_Res: type=CPP/SignalInfo_UInt8
        VAPI_FragCartStrh_Res: type=CPP/SignalInfo_UInt8
        VAPI_HVAC2ndExtSwLck_Res: type=CPP/SignalInfo_UInt8
        VAPI_HVAC2ndSwLck_Res: type=CPP/SignalInfo_UInt8
        VAPI_HVAC2ndSysSta_Res: type=CPP/SignalInfo_UInt8
        VAPI_HVAC3rdExtSwLck_Res: type=CPP/SignalInfo_UInt8
        VAPI_HVAC3rdSwLck_Res: type=CPP/SignalInfo_UInt8
        VAPI_HVAC3rdSysSta_Res: type=CPP/SignalInfo_UInt8
        VAPI_HVACExtSwLck_Res: type=CPP/SignalInfo_UInt8
        VAPI_HVACSwLck_Res: type=CPP/SignalInfo_UInt8
        VAPI_HVACSysSta_Res: type=CPP/SignalInfo_UInt8
        VAPI_IntakePrio_Res: type=CPP/SignalInfo_UInt8
        VAPI_Intake_Res: type=CPP/SignalInfo_UInt8
        VAPI_ModPrio_Res: type=CPP/SignalInfo_UInt8
        VAPI_Sync_Res: type=CPP/SignalInfo_UInt8
        VehicleDistancetoEmpty: type=CPP/SignalInfo_UInt16  # CLU_DTEVal
        VehicleDistancetoEmptyUnit: type=CPP/SignalInfo_UInt8  # CLU_TripUnitSta
        VehicleOdometer: type=CPP/SignalInfo_Float  # CLU_OdoVal
        VehicleSpeed: type=CPP/SignalInfo_Float  # CLU_DisSpdVal
        VehicleSpeedUnit: type=CPP/SignalInfo_UInt8  # CLU_SpdUnitTyp
    FunctionGroupState: major-version=1, minor-version=0
      namespaces:
        symbol props ara
        symbol props sm
      field FunctionGroupState: type=FunctionGroupStateInfo, has-getter=true, has-notifier=true, has-setter=false
      methods:
        operation ReleaseRequest: possible-ap-error=[Delay, Failed, Invalid]
        operation RequestState: possible-ap-error=[Delay, Failed, Invalid]
          arg FunctionGroup: type=String, direction=IN
          arg State: type=String, direction=IN
    GNSS: major-version=1, minor-version=0
      namespaces:
        symbol props Info
        symbol props Location
        symbol props GNSS
      11 x field, all with has-getter=true, has-notifier=true, has-setter=false:
        DGPSAge: type=uint8_t  # This property indicates the elapsed time since from DGPS time to current time(in seconds). - DGPSAge = 0 - 254 : age in seconds, 255 : overage or invalid
        DOP: type=DOP  # This field indicates the GNSS Dilution of Prevention (DOP) values.
        FixStatus: type=uint8_t  # This property indicates the GNSS fix status. - FixStatus = 0x00 : Doing position fixes, 0x02 : Need time, 0x03 : PDOP too high, 0x05 : No usable SVs, 0x06 : One usable SV, 0x07 : Two Usable SVs, 0x08 : Three Usable SVs.
        LocationAccuracy: type=LocationAccuracyData  # Location Accuracy.
        LocationFix: type=LocationFixData  # Location Fix Status. - fix_source(0 = No Fix, 17 = Fix Valid) - fix_2D_indicator : Field valid only if Fix Source is 17(0 = 3D Fix, 1 = 2D Fix)
        LocationGNSSData: type=LocationData  # [Periodic Event 200ms] Location GNSS Data This field is periodically updated every 200ms.
        LocationStatus: type=LocationStatusData  # This function will be invoked when the location status infomation is changed.
        SVCount: type=uint8_t  # Number of Visible SV(Space Vehicle)s Counts
        SearchMode: type=uint8_t  # This property indicates the health status of GPS. - SearchMode = 0 : None, 1 : Blind, 2 : Anywhere.
        Validity: type=uint32_t  # This field indicates for Validity Bitmap with GNSS validity flags.
        ValidityError: type=ValidityError  # This field indicates GNSS error statistics. The value of Validity bitsmap is a combination of the values below. - latitude_error : The error of latitude. Standard deviation of latitude error (1 sigma). unit : m - longitude_error : The error of longitude. Standard deviation of longitude error (1 sigma). unit : m - altitude_error : The error of altitude. Standard deviation of altitude error (1 sigma). unit : m - horizontalSpeed_error : The error of horizontal speed. Standard deviation of horizontal speed error (1 sigma). unit : m/s - verticalSpeed_error : The error of vertical speed. Standard deviation of vertical speed error (1 sigma). unit : m/s - heading_error : The error of heading. Standard deviation of heading error (1 sigma). unit : deg
    GeneralSettings: major-version=1, minor-version=9
      namespaces:
        symbol props Info
        symbol props Setup
        symbol props GeneralSettings
      5 x field, all with has-getter=true, has-notifier=true, has-setter=false:
        AvailableLanguages: type=AvailableLanguages_VECTOR  # Provides a list of user selectable languages to an external system. The values are cast to Int32 and sent.
        GeneralSettings: type=CPP/KeyValue  # Provides a list of general settings to an external system. The Key-Value table follows the specification for each item. Provides the list of general settings below to an external system. LanguageType: value list references the enum class ccos::HLanguageType. DefaultLanguageType: value references the default setting from the enum class ccos::HLanguageType. The typical value is US_ENGLISH.. DistanceUnit: value list references theenum class ccos::HDistanceUnit. TemperatureUnit: value list references the enum class ccos::HTemperatureUnit. TimeFormat: value list references the enum class ccos::clock::HDateFormatType. FontSize: value list references the ccos::system::HFontSize. KnobType: An enum representing the type of knob, with options for NOT_SUPPORT=0, SINGLE_KNOB_TYPE_VOLUME=1, SINGLE_KNOB_TYPE_TUNE=2, DUAL_KNOB_TYPE_VOLUME=3, DUAL_KNOB_TYPE_TUNE=4, and INVALID=5. NaviVolumeControlSetting : An enum representing the setting of navigation volume control with options for VOLUME_BUTTON_IN_MAP = 0, VOLUME_BUTTON_IN_MAP_AND_VOLUME_KNOB = 1.
        RearGeneralSettings: type=KeyValueString  # Provides a list of general settings of the rear seat system. The Key-Value table follows the specification for each item. Provides the list of general settings below to an external system. - "NetworkSubscribeState" - "SIMState"
        Themes: type=Themes_VECTOR  # Provides a list of themes available in the system. Allowed keys for each theme: - "ThemeName": Represents the name of the theme. - "Activate": Indicates whether the theme is active or not. It can be either "TRUE" or "FALSE".
        VersionInfo: type=KeyValueString  # Provides a list of system version information to an external system. The Key-Value table follows the specification for each item. Provides the list of general settings below to an external system. "SYSTEM_MAIN_SW_VER" "CLU_AP_SW_VER" "CLU_MCU_SW_VER" "HUD_SW_VER" "CCRC_SW_VER" "BLTN_CAM_SW_VER" "CCUAPP_{APP_NAME}_SW_VER" The CCU APP version displays the {APP_NAME} variable as its name. If the sw_Version field is "", delete the corresponding {APP_NAME} from the version information.
      methods:
        operation SetRearGeneralSettings  # Collects the general settings status of the rear seat system. The KeyItem is allowed to use the keyword in the list below. For more specifications, contact your vehicle specification reponsible. - "NetworkSubscribeState" - "SIMState"
          arg keyItem: type=String, direction=IN
          arg valueItem: type=String, direction=IN
          arg error_of_CommonAPI: type=CPP/SetError, direction=OUT
        operation SetVersionInfo  # Collect controller software versions that belong to the infotainment domain. The unit is allowed to use the keyword in the list below. For more specifications, contact your vehicle specification reponsible. "CLU_AP_SW_VER" "CLU_MCU_SW_VER" "HUD_SW_VER" "CCRC_SW_VER" "BLTN_CAM_SW_VER"
          arg unit: type=String, direction=IN
          arg sw_Version: type=String, direction=IN
          arg error_of_CommonAPI: type=CPP/SetError, direction=OUT
    HTTP: major-version=1, minor-version=2
      namespaces:
        symbol props Vehicle
        symbol props Telemanager
        symbol props HTTP
      events:
        data RequestCompletion: type=RequestCompletion_EventData
        data ResponseMessage: type=ResponseMessage_EventData
      methods:
        operation CancelRequest
          arg requestID: type=String, direction=IN
          arg result: type=CPP/CCResult, direction=OUT
        operation Request
          arg request: type=CPP/CCHTTPRequest, direction=IN
          arg result: type=CPP/CCResult, direction=OUT
          arg requestID: type=String, direction=OUT
        operation RequestSimple  # 미사용 api
          arg request: type=CPP/CCHTTPRequest, direction=IN
          arg result: type=CPP/CCHTTPResponse, direction=OUT
          arg error: type=CPP/CCHTTPError, direction=OUT
    HTTPSimple: major-version=1, minor-version=1
      namespaces:
        symbol props Vehicle
        symbol props Telemanager
        symbol props HTTP_Simple
      methods:
        operation RequestSimple  # KsingleThread 방식 유지를 위한 HTTP Request sync method
          arg request: type=CPP/CCHTTPRequest, direction=IN
          arg error: type=CPP/CCHTTPError, direction=OUT
          arg response: type=CPP/CCHTTPResponse, direction=OUT
    IOManager: major-version=1, minor-version=0
      namespaces:
        symbol props Vehicle
        symbol props ApSysMgr
        symbol props IOManager
      field PwrStatus: type=CPP/PowerState, has-getter=true, has-notifier=true, has-setter=false
      field WireInput: type=CPP/ExtWireInput, has-getter=true, has-notifier=true, has-setter=false
      methods:
        operation SetWireOutput
          arg out: type=CPP/WireOutput, direction=IN
        operation WireOutput
          arg key: type=CPP/WireOutputKey, direction=IN
          arg state: type=bool, direction=OUT
    IVPA: major-version=1, minor-version=0
      namespaces:
        symbol props Vehicle
        symbol props Security
        symbol props IVPA
      methods:
        operation RequestDID  # SDE에서 IVPA로 DID 요청 메시지 전달 및 응답 전달 isRDBI True : Read Data / False : Write Data
          6 x arg:
            requestData: type=ByteArray, direction=IN
            requestDataLen: type=uint32_t, direction=IN
            isRDBI: type=bool, direction=IN
            err: type=CPP/ErrCode, direction=OUT
            responseData: type=ByteArray, direction=OUT
            responseDataLen: type=uint32_t, direction=OUT
        operation RequestRID  # SDE에서 IVPA로 RID 요청 메시지 전달 및 응답 전달
          5 x arg:
            requestData: type=ByteArray, direction=IN
            requestDataLen: type=uint32_t, direction=IN
            err: type=CPP/ErrCode, direction=OUT
            responseData: type=ByteArray, direction=OUT
            responseDataLen: type=uint32_t, direction=OUT
    InformationProvider: major-version=2, minor-version=4
      namespaces:
        symbol props Info
        symbol props Cluster
        symbol props InformationProvider
      16 x field, all with has-getter=true, has-notifier=true, has-setter=false:
        AverageFuelEconomy: type=AverageFuelEconomy_VECTOR  # Indicates the average fuel economy of the vehicle. The Average Fuel Economy Type is: - Drive : The data provided by vehicle driving cycle. - AfterRefuel : The data calculated from after refueling. - Accumulated : The data that provides cumulative. - Term : The data calculated every 2.5 minutes.
        AverageFuelEconomyStr: type=AverageFuelEconomyStr_VECTOR  # Indicates the average fuel economy of the vehicle.
        DTE: type=DTEInfo  # Indicates the remaining mileage of the vehicle.
        DTEStr: type=DistanceStrInfo  # Indicates the remaining mileage of the vehicle.
        DrivingModes: type=DrivingModes_VECTOR  # Provides the list of selected driving mode and selectable driving modes in the cluster. -There is only one selected item in the list. -Driving modes that are not supported by the cluster are not included in the list. -And if the driving mode selection is not supported, an empty list is displayed. Below is a reference to the driving mode list. For more detail information, please refer to the ES specification. -ECO -NORMAL(COMFORT) -SPORT -SMART -MY_DRIVE -CUSTOM_SNOWT -TERRAIN_SNOW -TERRAIN_MUD -TERRAIN_SAND -TERRAIN_AUTO -TERRAIN_DEEP_SNOW -N -N_CUSTOM1 -N_CUSTOM2
        DynamicModePopupInfo: type=String  # Inform the pop up information related dynamic mode control
        FuelStatusInfo: type=FuelStatusInfo  # This interface indicates that the current fuel level values in % and low fuel warning status FuelLevel indicates that fuel level value in % for a vehicle. LowFuelStatus indicates that current low fuel warning stats for a vehicle. depending on fuel level and fuel status LowFuelStatus has a string value below. low fuel level - LowFuelStatus: "LOW_LEVEL" calculation error - LowFuelStatus: "ERROR" other case - LowFuelStatus: "OFF"
        JourneyDistance: type=JourneyDistance_VECTOR  # Indicates the distance information of the vehicle. The Journey Distance Type is: - Drive : The data provided by vehicle driving cycle. - AfterRefuel : The data calculated from after refueling. - Accumulated : The data that provides cumulative.
        JourneyDistanceStr: type=JourneyDistanceStr_VECTOR  # Indicates the distance information of the vehicle.
        JourneyTime: type=JourneyTime_VECTOR  # Indicates the driving period information of the vehicle. The Journey Time Type is: - Drive : The data provided by vehicle driving cycle. - AfterRefuel : The data calculated from after refueling. - Accumulated : The data that provides cumulative.
        LanguageStatus: type=LanguageStatusInfo  # Provides current language status of the cluster.
        PreviousTripInformation: type=PreviousTripInfo  # Driving Information from the time of reset to the last drving end point
        ProviderOptions: type=CPP/KeyValue  # Indicates a list of features that supported by the cluster information provider. The ProviderOptions will inform that whether it is "Support"/"NotSupport" for the following items. -DTE -AverageFuelEconomy -JourneyDistance -JourneyTime -Telltale -DrivingModes
        SpeedUnitDefault: type=uint8_t  # It is used to give default speed unit value to HU for judging speed unit before area data input It has same information with CLU_SpdUnitTyp_Def_MM(MM-CAN) Data is written as decimal value which match the hex value of the CAN DB Descriptions for DisplaySpeedDefaultUnit Factor of signal is 1 Offset of signal is 0 0:Default 1:kph,kmph 2:mph 3:Invalid
        Telltale: type=Telltale_VECTOR  # Provides a list of the cluster's warning lights and it's status as a service. Below is a reference to the DID list. And the status code may vary for each node. For more detail information, please refer to the ES specification. - "4WDDIAG", "ABS", "AFS", "AIRBAG", "AUTO_HOLD", "AWDLOCK", "BATTERY_CHARGE", "CHECK_ENGINE", "DBC_LIMOUSINE", "DBC_SEDAN", "DMS", "DPFGPF", "DRIFT_MODE", "ECALL", "ECC", "ECC_CHINA", "EPB", "ESC", "ESC_OFF", "FCA", "HBA", "HDA2", "HIGHBEAM", "ICEWARNING", "IMMOBILIZER_SEDAN", "IPEDAL", "ISG", "LDWLKA", "LEDLAMPFAIL", "LFAHDA", "LOWBATTERY", "LOWBEAM", "LOWFUELWARN", "MASTERSYMBOL", "MDPS", "OILPRESS", "OVERSPEEDWARN", "PARKING_BRAKE", "POWERDOWN", "RBS", "READY", "REARFOG", "RSBR_CENTER", "RSBR_LEFT", "RSBR_RIGHT", "SEATBELT", "SERVICE", "SERVICE_CHINA", "TAILLAMP", "TPMS", "TPMS_CHINA", "TURNSIGNAL", "UTIL_MODE"
        TripRawData: type=KeyValueFloat  # Indicates the total accumulated driving history data calculated in the cluster. The Key data as follows: Distance FuelConsumption (Not used) HydrogenConsumption (Not used) EletricityConsumption (Not used) The units of value data mapped to each key are as follows: Distance : km FuelConsumption : l HydrogenConsumption : kg EletricityConsumption : kwh
      methods:
        operation SetDrivingMode  # Set the driving mode you want to change.
          arg desireMode: type=String, direction=IN
          arg error_of_CommonAPI: type=CPP/SetError, direction=OUT
        operation TermAverageFuelEconomyReset  # Request to reset 2.5 minute fuel economy data
    InteractionManager: major-version=2, minor-version=2
      namespaces:
        symbol props Info
        symbol props Update
        symbol props InteractionManager
      9 x field, all with has-getter=true, has-notifier=true, has-setter=false:
        InteractionContents: type=CPP/KeyValueMap  # This field contains content items for performing user interactions regarding update consent and update progress. The contents information passed through the Method RequestInteractionUI is updated in this field. - Key: Update Information Key - Value: The message to be displayed For detailed Key-Value items definition of InteractionContents, please refer to the ES specification and UX specification.
        InteractionReady: type=String  # This field indicates the state in which AVNT can display the screen. (This Field use the same purpose as OTAUIStatus in CAN DB) "0" : Not ready "1" : Ready
        RequestUpdateInfoToCCU: type=String  # This field is used for Headunit to request action from the CCU. The value of this field can be set as one of the key values in UpdateInfoMap. When the method TransferUpdateInfoValue is completed, the value of the field is set to "". "UpdateCheck" : Request UpdateCheck. "OTAReset" : Request OTA reset to CCU.
        ScheduleUpdateMap: type=CPP/KeyValueMap  # This Field is used for the purpose of managing sheduled update information in HeadUnit. The information includes the activating of scheduled update status and scheduled update time information. The list of keys defined in the KeyValueMap props is as follows: "IsUpdateScheduled" : TRUE/FALSE "ScheduledUpdateTime" : "YYMMDDhhmm" (ex, "2504071310")
        ScreenIndex: type=String  # This field contains content items for performing user interactions regarding update consent and update progress. The ScreenIndex information passed through the Method RequestInteractionUI is updated in this field. For detailed value item definition of ScreenIndex, please refer to the ES specification and UX specification.
        SettingsContents: type=CPP/KeyValueMap  # This field contains the content items necessary for the composition of the Software Update information menu under the General Settings menu. The contents information passed through the Method UpdateSettingsContentsMap is updated in this field. - Key: Update Information Key - Value: The message to be displayed For detailed Key-Value items definition of SettingsContents, please refer to the ES specification and UX specification.
        SoftwareReleaseApprovals: type=SoftwareReleaseApprovals_VECTOR  # This field contains the results of user interactions such as their agreement to download and install the software release items. When an item in the Field SoftwareReleaseLists is added/deleted, the items in this field will also be added/deleted accordingly. However, when a new item is added, the user has not agreed yet, so the String ReleaseID is valid but the contents of the KeyValueMap prop for the item are empty. ReleaseID is a unique identifier for the software release expressed as a string. The list of keys defined in the KeyValueMap props is as follows: 1. "download" : contains the information of the user's agreement to download. "OK" / "NOK" / "LATER" / "UNRECOGNIZED_REJECT 2. "install": contains the information of the user's agreement to install. "OK" / "NOK" / "LATER" / "UNRECOGNIZED_REJECT" 3. "donotshowagain": contains the user's preference not to show again. "TRUE" / "FALSE" 4. "reason": contains the information of unrecongnized reject reason. 001 : Valet mode 002 : Force Update 003 : AVNT OTA 004 : Power State Change (ACC ON, IGN ON) 005 : ADM logic off 006 : Screen Transition 007 : SOS Call 008 : SVR (Stolen Vehicle Recovery) 009 : ACN Call (Automated Collision Notification)
        SoftwareReleaseLists: type=SoftwareReleaseLists_VECTOR  # This field contains information about the software release for the controller update service. The contents of the field can be added or changed through the Method UpdateReleaseInfo, and deleted through the Method DeleteReleaseInfo. ReleaseID is a unique identifier for the software release expressed as a string. The list of keys defined in the KeyValueMap props is as follows: 1. "UpdateState": Indicates the status of a software release The value of the "UpdateState" key is as follows: - "NewUpdate": The state of receiving new version information and description information from the server - "DownloadApprovalWaiting": Display of the download consent popup - "DownloadReady": Approval of downloading by agreeing - "Downloading": Download in progress - "DownloadDone": Download complete - "BackgroundTransferring": Background transfer in progress - "BackgroundTransferDone": Background transfer complete - "UpdateApprovalWaiting": Display of the update consent popup - "UpdateReady": Approval of update by agreeing - "Updating": Update in progress - "UpdateCanceled" : Update is canceled - "UpdateDone": Update complete (including rollback/failure)
        UpdateInfoMap: type=CPP/KeyValueMap  # This Field is used for the purpose of managing update information in HeadUnit. The information includes the update status and broadcasting to CCU when the update status is changed. The list of keys defined in the KeyValueMap props is as follows: - "CCUUIVersion" : Current version infomation of the CCU update software. - "HeadUnitUIVersion" : Current version infomation of the Headunit update software. - "SourceEventVersion" : Current Vehicle version information. - "UpdateCheck" : Value ranges from "C1"~"C7". For detailed information, refer to the specification. - "HeadUnitPlatform" : "ccNC" / "ccNC_Basic" / "ccIC" / "ccIC27" / "PI" / "CW" / "CS" / "CL"
      methods:
        9 x operation:
          DeleteReleaseInfo  # This method is used when the consumer wants to delete the information about the software release for the controller update to the producer. The result of the addition or modification is immediately reflected in the Field SoftwareReleaseLists and SoftwareReleaseApprovals, which are received by the producer.
            arg ReleaseID: type=String, direction=IN
            arg error_of_CommonAPI: type=CPP/SetError, direction=OUT
          InitializeInteractionUI  # This Method is used to clear the screen requested by "RequestInteractionUI". In response to this request, the producer clear the displayed screen in AVNT and return result.
            arg error_of_CommonAPI: type=CPP/SetError, direction=OUT
          RequestInteractionUI  # This method is used to request the display of a screen for the interaction of the controller update service, and to update the display content. The items defined in the KeyValueMap NewContents will be added or updated, while the keys that are not defined will be immediately deleted from the Field InteractionContents. ScreenIndex is the screen index value that you want to display. The interaction screen will be configured based on the layout and scenario defined for the corresponding screen index. - "ScreenIndex": (ex) "R001", for detailed display format, please refer to the ES specification. - "ReleaseIDList" is a list of Software Release IDs associated with the screen index for display purposes. The detailed Key-Value item definition of KeyValueMap NewContents can be found in the ES specification and UX specification. The errorReason item is returned when it is difficult to perform a proper request. - "errorReason": (ex,) "001", "002", for detailed specifications, please refer to the ES specification.
            5 x arg:
              ReleaseIDList: type=RequestInteractionUI_ReleaseIDList_VECTOR, direction=IN
              ScreenIndex: type=String, direction=IN
              NewContents: type=CPP/KeyValueMap, direction=IN
              error_of_CommonAPI: type=CPP/SetError, direction=OUT
              errorReason: type=String, direction=OUT
          RequestKeepScreenOn  # This method is used to request that the screen be maintained in an IGN OFF situation to proceed with CCU update. In response to this update request, the creator does not exit the screen in the IGN OFF situation, Hold and wait for CCU's RequestInteractionUI request. When the requester no longer needs to hold the screen, the method can be called back and it passes the FALSE value. "TRUE" : Keep screen "FALSE" : Do not keep screen
            arg KeepScreenOn: type=String, direction=IN
            arg error_of_CommonAPI: type=CPP/SetError, direction=OUT
          TransferUpdateInfoValue  # This method is used for the purpose of delivering the UpdateInfoMap. When the value of the RequestUpdateInfoToCCU changes, CCU will pass the requested key and the corresponding value as arguments through the TransferUpdateInfoValue method. - "CCUUIVersion" : Current version infomation of the CCU update software. - "SourceEventVersion" : Current Vehicle version information. - "UpdateCheck" : Value ranges from "C1"~"C7". For detailed information, refer to the specification. - "OTAReset" : "START"/"COMPLETE"
            arg KeyInfo: type=String, direction=IN
            arg ValueInfo: type=String, direction=IN
            arg error_of_CommonAPI: type=CPP/SetError, direction=OUT
          TransferWhatsNewContents  # This Method is used by the CCU to transfer What's new content to HU. For this request, the producer saves What's new content as a file and displays it according to the update scenario. The transmitted what's new contents must contain all languages.
            arg AllContents: type=TransferWhatsNewContents_AllContents_VECTOR, direction=IN
            arg error_of_CommonAPI: type=CPP/SetError, direction=OUT
          TransferWhatsNewContentsCCUApp  # This Method is used by the CCU to transfer CCU App What's new content to HU. For this request, the producer saves What's new content as a file and displays it according to the update scenario. The transmitted what's new contents must contain all languages.
            arg AllContents: type=TransferWhatsNewContentsCCUApp_AllContents_VECTOR, direction=IN
            arg error_of_CommonAPI: type=CPP/SetError, direction=OUT
          UpdateReleaseInfo  # This method is used when the consumer wants to add or modify the information about the software release for the controller update to the producer. The result of the addition or modification is immediately reflected in the Field SoftwareReleaseLists and SoftwareReleaseApprovals, which are received by the producer.
            arg ReleaseID: type=String, direction=IN
            arg NewState: type=String, direction=IN
            arg error_of_CommonAPI: type=CPP/SetError, direction=OUT
          UpdateSettingsContentsMap  # This method updates the software release information displayed to the user through the General Settings menu. In response to this update request, the producer replaces the list of items defined in the Field SettingsContents with the defined list of items in the Field SettingsContents. However, if a Key is not defined, it means deletion, and it is immediately deleted from the Field SettingsContents. - Key: Update Information Key - Value: The message to be displayed For detailed Key-Value item definitions of Field SettingsContents, please refer to the ES specification and UX specification.
            arg NewContents: type=CPP/KeyValueMap, direction=IN
            arg error_of_CommonAPI: type=CPP/SetError, direction=OUT
    Location: major-version=1, minor-version=0
      namespaces:
        symbol props Vehicle
        symbol props SOAAdaptor
        symbol props Location
      8 x field, all with has-getter=true, has-notifier=true, has-setter=false:
        AntennaStatus: type=GPSAntenaStatusType
        CurrentLocation: type=LocationInfo
        LocationMapmatching: type=MapMatchingInfo
        MapMatchingDataType: type=uint8_t
        Time: type=CPP/TimeInfo
        TimeDST: type=uint8_t
        TimeOffset: type=int8_t
        TimeValidity: type=bool
    Log: major-version=1, minor-version=0
      namespaces:
        symbol props Vehicle
        symbol props TraceEngine
        symbol props Log
      methods:
        operation requestBackupLogs
          arg startTime: type=uint64_t, direction=IN
          arg result: type=CPP/Result, direction=OUT
    Logging: major-version=1, minor-version=2
      namespaces:
        symbol props Vehicle
        symbol props LogCollection
        symbol props StartLogging
      methods:
        4 x operation:
          ControlCANStreamingRT  # Control CAN Streaming RealTime / False : Off, True : On
            arg onOff: type=bool, direction=IN
            arg option: type=uint32_t, direction=IN
          ControlCanStreaming  # LogCollection이 CAN 로그 파일을 eMMC에 실시간 저장할 수 있도록 요청하는 메소드 action 0 : Stop, 1 : Start
            4 x arg:
              appId: type=String, direction=IN
              action: type=bool, direction=IN
              timeout_min: type=int8_t, direction=IN
              retVal: type=int8_t, direction=OUT
          StartLogging
            arg appId: type=String, direction=IN
            arg option: type=int8_t, direction=IN  # 0: ETH/CAN off, 1: ETH only, 2: CAN only, 3: BOTH
            arg retVal: type=int8_t, direction=OUT  # 0: OK, 1: GENERAL_FAILURE
          StopLogging
            arg appId: type=String, direction=IN
            arg retVal: type=int8_t, direction=OUT  # 0: OK, 1: GENERAL_FAILURE
    MQTT: major-version=1, minor-version=0
      namespaces:
        symbol props Vehicle
        symbol props Telemanager
        symbol props MQTT
      events:
        data MqttRequestStatus: type=MqttRequestStatus_EventData
        data TopicMessage: type=TopicMessage_EventData
        data TopicMessageV5: type=TopicMessageV5_EventData
      field ConnectionState: type=CCConnectionState, has-getter=true, has-notifier=true, has-setter=false
      methods:
        8 x operation:
          GetExtraPropertyInfo
            arg result: type=CPP/CCResult, direction=OUT
            arg extra_properties: type=CCMQTTExtraPropertyInfo, direction=OUT
          GetTopicInformation
            arg result: type=CPP/CCResult, direction=OUT
            arg topics: type=GetTopicInformation_topics_VECTOR, direction=OUT
          Publish
            8 x arg:
              topic: type=String, direction=IN
              payload: type=ByteArray, direction=IN
              length: type=uint32_t, direction=IN
              retry: type=uint32_t, direction=IN
              interval: type=uint32_t, direction=IN
              timeout: type=uint32_t, direction=IN
              result: type=CPP/CCResult, direction=OUT
              mid: type=uint32_t, direction=OUT
          PublishV5
            9 x arg:
              topic: type=String, direction=IN
              properties: type=String, direction=IN
              payload: type=ByteArray, direction=IN
              length: type=uint32_t, direction=IN
              retry: type=uint32_t, direction=IN
              interval: type=uint32_t, direction=IN
              timeout: type=uint32_t, direction=IN
              result: type=CPP/CCResult, direction=OUT
              mid: type=uint32_t, direction=OUT
          Subscribe
            4 x arg:
              topic: type=String, direction=IN
              protocolID: type=String, direction=IN
              result: type=CPP/CCResult, direction=OUT
              mid: type=uint32_t, direction=OUT
          SubscribeV5
            4 x arg:
              topic: type=String, direction=IN
              protocolID: type=String, direction=IN
              result: type=CPP/CCResult, direction=OUT
              mid: type=uint32_t, direction=OUT
          Unsubscribe
            4 x arg:
              topic: type=String, direction=IN
              protocolID: type=String, direction=IN
              result: type=CPP/CCResult, direction=OUT
              mid: type=uint32_t, direction=OUT
          UnsubscribeV5
            4 x arg:
              topic: type=String, direction=IN
              protocolID: type=String, direction=IN
              result: type=CPP/CCResult, direction=OUT
              mid: type=uint32_t, direction=OUT
    Manager: major-version=1, minor-version=0
      namespaces:
        symbol props BltnCam
        symbol props DrivingEvent
        symbol props Manager
      field DEVInfo: type=DEVInfo_VECTOR, has-getter=true, has-notifier=true, has-setter=false  # Provides metadata for recorded driving event video and its status.
      methods:
        operation FinishTransmitting  # Notifies that the transmission of the corresponding driving event video has been completed.
          arg eventID: type=String, direction=IN
          arg error_of_CommonAPI: type=CPP/RequestError, direction=OUT
        operation RequestFile  # Request to Download the recorded driving event video with hash code and file name. Information of Thumbnail (or video) is requested and responsed asynchronously
          5 x arg:
            eventID: type=String, direction=IN
            fileName: type=String, direction=IN
            error_of_CommonAPI: type=CPP/RequestError, direction=OUT
            size: type=uint32_t, direction=OUT
            blob: type=ByteArray, direction=OUT
    Manager: major-version=1, minor-version=1
      namespaces:
        symbol props Vehicle
        symbol props Vcc
        symbol props Manager
      events:
        data svcGroupConnectionStatus: type=svcGroupConnectionStatus_EventData
      field EndpointConfigInformation: type=EndpointConfigInformation_VECTOR, has-getter=true, has-notifier=true, has-setter=false
      methods:
        operation isDataAvailable
          arg svcGroup: type=CPP/GroupTypes, direction=IN
          arg status: type=CPP/ConnectionStatus, direction=OUT
    Manager: major-version=1, minor-version=1
      namespaces:
        symbol props BltnCam
        symbol props System
        symbol props Manager
      14 x field, all with has-getter=true, has-notifier=true, has-setter=false:
        FrontIspConfigInfo: type=String  # Provides the front camera ISP configuration version of the built-in cam system. Front camera ISP configuration Version Example : "01.02.03.04"
        FrontIspFwInfo: type=String  # Provides the front camera ISP Firmware version of the built-in cam system. Front camera ISP Firmware Version Example : "0D.00.00.01"
        HwInfo: type=String  # Provides the hardware version of the built-in cam system. HW Version Example : “D.00"
        OtherInfo: type=String  # Provides the other information of the built-in cam system. Other information Example : "SDK : LV20-5p1-R8, InfoUpdateProcess : 4.02, BltnCamCameraInfoManager : 1.0, BltnCamParkingEventManager 3.0"
        PlatformInfo: type=String  # Provides the platform version of the built-in cam system. Platform Version Example : “BLTN_CAM_2.0"
        PlatformSwInfo: type=String  # Provides the platform software version of the built-in cam system. Platform SW Version Example : “1.00"
        RearIspConfigInfo: type=String  # Provides the rear camera ISP configuration version of the built-in cam system. Rear camera ISP configuration Version Example : "01.02.03.04"
        RearIspFwInfo: type=String  # Provides the rear camera ISP Firmware version of the built-in cam system. Rear camera ISP Firmware Version Version Example : "0D.00.00.01"
        Region: type=String  # Provides the region of the built-in cam system. Region Example : “KOR"
        Status: type=BltnCamStatus  # Provides operational status of the built-in cam system.
        SwBuildDate: type=String  # Provides the software build date of the built-in cam system. Software build date Example : “20220826"
        SwInfo: type=String  # Provides the software version of the built-in cam system. -Use-Case : DIM-C, Whenever IGN is turned on, S/W Version infomations should be collected and uploaded. -SW Version Example : "01.02.03.04"
        SwInfoMcu: type=String  # Provides the MCU software version of the built-in cam system. MCU SW Version Example : "0D.00.00.01"
        VehicleModel: type=String  # Provides the vehicle model of the built-in cam system. Vehicle model Example : “GN7"
    Manager: major-version=3, minor-version=0
      namespaces:
        symbol props BltnCam
        symbol props ParkingEvent
        symbol props Manager
      field PEVInfo: type=PEVInfo_VECTOR, has-getter=true, has-notifier=true, has-setter=false  # Provides metadata for recorded parking event video and its status.
      field PEVOprableTime: type=PrkOprableTime, has-getter=true, has-notifier=true, has-setter=false  # Provide operating time of the parking event monitoring functionality. The value table for (Prk_Oprable_Time, Prk_Oprable_Time_Max) is as follows. -0x00~0xFB: the hours of Park Mode Operatable -0xFC: Park Mode is not set. (Aux. Bat. Is connected) -0xFD: Auxiliary Battery is not connected. Auxiliary Battery applicable on this vehicle model. -0xFE: Auxiliary Battery is not connected. Auxiliary Battery not applicable on this vehicle model. -0xFF: Invalid
      methods:
        operation FinishTransmitting  # Notifies that the transmission of the corresponding parking event video has been completed.
          arg eventID: type=String, direction=IN
          arg error_of_CommonAPI: type=CPP/RequestError, direction=OUT
        operation RequestFile  # Request to Download the recorded parking event video with hash code and file name. It is provided after being encoded in the optimized format for smartphone requirement. Information of Thumbnail (or video) is requested and responsed asynchronously
          5 x arg:
            eventID: type=String, direction=IN
            fileName: type=String, direction=IN
            error_of_CommonAPI: type=CPP/RequestError, direction=OUT
            size: type=uint32_t, direction=OUT
            blob: type=ByteArray, direction=OUT
    Manager2: major-version=1, minor-version=1
      namespaces:
        symbol props CCU
        symbol props ExternalNetwork
        symbol props Manager2
      field Activity: type=Activity_VECTOR, has-getter=true, has-notifier=true, has-setter=false  # PE 1 second. This signal indicates a change in the counter values for the service groups. It is updated once a second and if it is same as previous value, it is not updated. rx_bytes : Total bytes received per service group. tx_bytes : Total bytes sent per service group.
      field ServiceGroups: type=ServiceGroups_VECTOR, has-getter=true, has-notifier=true, has-setter=false  # Gets the all Service Group's list and its property on the system. Description of String grouptype "DEFAULT" : SERVICE_GROUP_DEFAULT "CCS" : SERVICE_GROUP_CCS "FOTA" : SERVICE_GROUP_FOTA "USERPAID" : SERVICE_GROUP_USERPAID "OEMPAID" : SERVICE_GROUP_OEMPAID "STREAMING_STANDARD" : SERVICE_GROUP_STREAMING_STANDARD "STREAMING_PREMIUM" : SERVICE_GROUP_STREAMING_STANDARD "VCRM" : SERVICE_GROUP_VCRM "CANIDS" : SERVICE_GROUP_CANIDS Description of enumeration ConnectionStatus DISCONNECTED : Associated APN is not activated to the mobile network, or connecting status. CONNECTED : Associated APN is activated to the mobile network ONLINE : Verified that the state of the connected network is able to communicate with the remote host. Description of String endpointtype "Headunit" : Headunit family such as ccIC and ccNC "Headunit_RSE" : Standalone Rear Seat Infotainment System such as ccRC "CCU" : Central Communication Unit Description of struct EndpointConfiguration[] ipconfig Network configuration for Endpoint ECU's Source IP network. Endpoint ECU have to setting up the network environment using IP suitable for EndpointType. Description of String[] nameservers IP address of the local in-vehicle dns server (which located in CCU VCC owned) for the EXTNET. Local nameserver support IPv4, IPv6 together from same DNS instance. Description of struct ARLTableItem[] ipv4_arl_tables, ipv6_arl_tables For activate the ARP cache on the endpoint, A pair of MAC addresses and IP addresses are should be provided. ipv4_arl_tables contains that ipv4 addresses, ipv4 gateway address, nameservers lists for ipv4. ipv6_arl_tables contains that ipv6 addresses, ipv6 gateway address, nameservers lists for ipv6.
      field TetheringService: type=TetheringService, has-getter=true, has-notifier=true, has-setter=false  # Gets the Tethering Service property on the VCC system. Description of enumeration ConnectionStatus -DISCONNECTED : Associated APN (for tethering) is not activated to the mobile network, or connecting status. -CONNECTED : Associated APN (for tethering) is activated to the mobile network -ONLINE : Verified that the state of the connected network is able to communicate with the remote host. Description of EndpointConfiguration[] ipconfig -Network configuration for Endpoint ECU's Source IP network. Only support Headunit. -Endpoint ECU have to setting up the network environment using IP suitable for EndpointType.
      methods:
        operation TetheringActivate  # Activate Tethering PDP Context Request
          arg error_of_CommonAPI: type=CPP/ContextError, direction=OUT
          arg result: type=bool, direction=OUT
        operation TetheringDeactivate  # Deactivate Tethering PDP Context Request
          arg error_of_CommonAPI: type=CPP/ContextError, direction=OUT
    MapMatching: major-version=1, minor-version=1
      namespaces:
        symbol props Info
        symbol props Location
        symbol props MapMatching
      field MapMatchingData: type=MapmatchingData, has-getter=true, has-notifier=true, has-setter=false  # [Periodic Event 1s] Transmit Mapmatching Data of current location information of vehicle. -The value of longitude and latitude format is the coordination x 1,000,000 in WGS84 format -The value of altitude format is in centimeter (value x 100) -The value of speed format is in km/h (KPH) -The value of heading between 0.0 ~ 360.0 based on magnetic variation
      field MapMatchingType: type=CPP/MapmatchingType, has-getter=true, has-notifier=true, has-setter=false  # Transmit Mapmatching Type of current location information of vehicle.
    MassProc: major-version=1, minor-version=1
      namespaces:
        symbol props Vehicle
        symbol props Security
        symbol props MassProc
      methods:
        operation FactoryKeyProv
          arg err: type=CPP/ErrCode, direction=OUT
          arg KeyProvResult: type=ByteArray, direction=OUT  # RID 03E1 요청 시 SDE가 해당 API 콜,
        operation FactoryKeyProvStatus  # return key provision result RDBI 0E02, 0E03 대응 API
          arg mem: type=MemType, direction=IN
          arg err: type=CPP/ErrCode, direction=OUT
          arg KeyProvResult: type=ByteArray, direction=OUT
        operation GetAllKeyProvisioningStatus  # 개발사 공정에서 전체 Key Provisioning 유무 Treu: OK, False: Not OK
          arg result: type=bool, direction=OUT
    MessageManager: major-version=2, minor-version=0
      namespaces:
        symbol props DCU
        symbol props Telephony
        symbol props MessageManager
      events:
        data ReceiveMessageAdded: type=ReceiveMessageAdded_EventData  # This event indicates that a new message has been received from the network.
        data ReceiveMessageRemoved: type=ReceiveMessageRemoved_EventData  # This event indicates that a message has been removed from the list.
        data SendMessageResult: type=CPP/SendMessageResult_EventData  # This event informs the result of the message transmission to client.
      methods:
        4 x operation:
          GetAllReceiveMessages  # Get a list of messages being receiving or received.
            arg item: type=GetAllReceiveMessages_item_VECTOR, direction=OUT
          GetReceiveMessage  # Get Message Item received
            arg msgID: type=String, direction=IN
            arg error_of_CommonAPI: type=CPP/MessageError, direction=OUT
            arg item: type=MessageItem, direction=OUT
          RemoveReceiveMessages  # This event requests to remove stored MessageItem in DCU
            arg msgID: type=String, direction=IN
            arg error_of_CommonAPI: type=CPP/MessageError, direction=OUT
          SendMessage  # Send a message to recipient. Send Result will be reported by SendMessageResult event.
            6 x arg:
              recipient: type=String, direction=IN
              length: type=uint32_t, direction=IN
              pdu: type=String, direction=IN
              dcs: type=uint32_t, direction=IN
              error_of_CommonAPI: type=CPP/MessageError, direction=OUT
              msgID: type=String, direction=OUT
    MessageManager: major-version=1, minor-version=0
      namespaces:
        symbol props Vehicle
        symbol props MSM
        symbol props MessageManager
      events:
        data OnNotifyReceiveMessage: type=OnNotifyReceiveMessage_EventData
        data SendMessageResult: type=CPP/SendMessageResult_EventData
      field BootReason: type=CPP/SystemBootReason, has-getter=true, has-notifier=true, has-setter=false
      methods:
        operation GetReceiveMessage
          arg msgID: type=GetReceiveMessage_msgID_VECTOR, direction=IN
          arg smsinfo: type=GetReceiveMessage_smsinfo_VECTOR, direction=OUT
        operation RemoveReceivedMessages
          arg msgID: type=String, direction=IN
          arg result: type=CPP/Result, direction=OUT
        operation SendSMS
          5 x arg:
            recipient: type=String, direction=IN
            length: type=int32_t, direction=IN
            pdu: type=String, direction=IN
            result: type=CPP/Result, direction=OUT
            msgID: type=String, direction=OUT
    MobileMessage: major-version=1, minor-version=0
      namespaces:
        symbol props Vehicle
        symbol props Telemanager
        symbol props MobileMessage
      events:
        data SendSMSMessageCompletion: type=SendSMSMessageCompletion_EventData
      field SMSValidity: type=SMSValidityStatus, has-getter=true, has-notifier=true, has-setter=false
      methods:
        operation SendSMSMessage
          arg request: type=CPP/CCHTTPRequest, direction=IN
          arg result: type=CPP/CCResult, direction=OUT
          arg msgID: type=String, direction=OUT
    Mode: major-version=1, minor-version=0
      namespaces:
        symbol props Vehicle
        symbol props VAM
        symbol props Mode
      field ModeStatusField: type=ModeStatus, has-getter=true, has-notifier=true, has-setter=false  # Mode 실행 상태
      methods:
        operation IsApplied  # modeName에 해당하는 Policy의 적용 여부를 반환
          arg modeName: type=String, direction=IN
          arg applied: type=bool, direction=OUT
        operation SetExternalContext  # VAM에게 Parameter를 전달하는 함수
          arg externalContext: type=ExternalContext, direction=IN
          arg result: type=CPP/Result, direction=OUT
    ModemManager: major-version=1, minor-version=0
      namespaces:
        symbol props Vehicle
        symbol props MSM
        symbol props ModemManager
      field IMEI: type=String, has-getter=true, has-notifier=true, has-setter=false
      methods:
        5 x operation:
          DcuReset
          GetRemoteControlWaitingTime
            arg min: type=uint32_t, direction=OUT
          GetVoLTEMode
            arg bOn: type=bool, direction=OUT
          SetAirplaneMode
            arg airplanemode: type=AirplaneModeType, direction=IN
            arg result: type=CPP/Result, direction=OUT
          SetVoLTEMode
            arg bOn: type=bool, direction=IN
            arg result: type=CPP/Result, direction=OUT
    ModemManager: major-version=2, minor-version=1
      namespaces:
        symbol props DCU
        symbol props Telephony
        symbol props ModemManager
      12 x field, all with has-getter=true, has-notifier=true, has-setter=false:
        AirplaneMode: type=AirplaneMode  # Representing the modem's Airplane mode.
        ECallStatus: type=ECallStatus  # Representing the eCall Status. The ECALL_ state can only be changed if the ECall key can be found in the result of GetVariation method from DCU.System.Variation. ResetModem can only be performed in CCS mode. CCS : DCU stanby on CCS capability ECALL : DCU is on the ECALL status ECALL_TEST : DCU is on the ECALL_TEST status ECALL_CALLBACK : DCU is on the ECALL_CALLBACK status
        IMEI: type=String  # Representing the IMEI of the modem device.
        Manufacturer: type=String  # String representing the manufacturer of the modem device.
        MobileCommProtoType: type=MobileCommProtoType  # Indicates that Mobile Communication Protocol Type. 3GPP/3GPP2
        Model: type=String  # String representing the model of the modem device.
        ModemAvailability: type=bool  # Modem Communication Interface like QMI, AT command is working properly (for Diagnostic)
        ModemFOTAStatus: type=ModemFOTAStatus  # For North American OTA Feature. Representing the NAD FOTA status. The UPDATE_READY state is waiting for user selection on the HMI. Proceed to next step by calling RequestFOTA method with INSTALL_START or INSTALL_CANCEL argument.
        Powered: type=bool  # Boolean representing the power state of the modem device.
        Revision: type=String  # String representing the revision of the modem device.
        SoftwareVersionNumber: type=String  # String representing the software version number of the modem device.
        VoLTEMode: type=VoLTEMode  # Indicates whether to use the VoLTE preference. If the ModemManager failed to read status of VoLTE preference from modem on while system initializing, This field could be response with "Unknown" state. And then the initialization is complete, the setting status is changed to right state.
      methods:
        5 x operation:
          GetAntennaConnectionStatus  # Check the antenna connection state of the modem.
            arg main: type=AntennaConnection, direction=OUT
            arg sub: type=AntennaConnection, direction=OUT
          RequestModemFOTA  # For North American OTA Feature. The UPDATE_READY state for DCU is waiting for user selection on the HMI. Proceed to next step by calling RequestFOTA method with INSTALL_START or INSTALL_CANCEL argument.
            arg modemFOTA: type=RequestModemFOTA, direction=IN
            arg error_of_CommonAPI: type=ModemFOTAError, direction=OUT
          ResetModem  # Perform Modem Reset by user. Asynchronus call only
          SetAirplaneMode  # Depending on the CCS operation scenario, switch Airplane mode to temporary radio-off mode or permanent radio-off mode through SetAirplaneMode method. Of course there is also NORMAL_MODE for radio-on..
            arg airplaneMode: type=AirplaneMode, direction=IN
          SetVoLTEMode  # Updating the VoLTE preference configuration. If DCU is on a call, the settings apply from the next call. Depending on the network status or condition, the desired VoLTE preference may not be applied.
            arg volte: type=bool, direction=IN
            arg error_of_CommonAPI: type=VoLTEModeError, direction=OUT
    Monitoring: major-version=1, minor-version=0
      namespaces:
        symbol props Vehicle
        symbol props CCS
        symbol props Monitoring
      methods:
        operation EventTrigger  # CCU 내부 Module이 특정 Event를 CCS로 trigger하여 관제 서버로 Event 정보 및 로그를 전달하기 위한 API
          arg eventInfo: type=String, direction=IN
          arg result: type=CPP/Result, direction=OUT
        operation InternalData  # 각 App에서 사전에 정의된 data를 CCS로 전달하는 api
          arg currentData: type=String, direction=IN
          arg result: type=CPP/Result, direction=OUT
    MultiMedia: major-version=2, minor-version=1
      namespaces:
        symbol props Vehicle
        symbol props SOAAdaptor
        symbol props MultiMedia
      events:
        data GNSS_07_100ms: type=GNSS_07_100ms_EventData
      10 x field, all with has-getter=true, has-notifier=true, has-setter=false:
        AverageFuelConsumptionUnit: type=CPP/SignalInfo_UInt8  # CLU_AvgFuelCnsmptnUnitSta_MM
        AverageFuelConsumptionValue: type=CPP/SignalInfo_Float  # CLU_AvgFuelCnsmptnVal_MM
        DrivingModeState: type=CPP/SignalInfo_UInt8  # CLU_DrvngLampChgnSta_MM
        EVDteInfo: type=CPP/SignalInfo_UInt16  # CLU_EVDTEDisp_MM
        HULanguageInfo: type=CPP/SignalInfo_UInt8  # HU_LanguageInfo
        OTAUIStatus: type=CPP/SignalInfo_UInt8
        PetModeReq: type=CPP/SignalInfo_UInt8  # HU_PetModeReq
        PetTempSetVal: type=CPP/SignalInfo_UInt8  # HU_PetTempSetVal
        PetTempUnit: type=CPP/SignalInfo_UInt8  # HU_PetTempUnit
        UserApproval: type=CPP/SignalInfo_UInt8  # HU_UserApproval
    NM: major-version=1, minor-version=0
      namespaces:
        symbol props Vehicle
        symbol props EthNM
        symbol props NM
      field NetworkStatusInfo: type=CPP/NetworkStatus, has-getter=true, has-notifier=true, has-setter=false
      field UpdateExternalPncInfo: type=UpdateExternalPncInfo_VECTOR, has-getter=true, has-notifier=true, has-setter=false
      field UpdatePncInfo: type=UpdatePncInfo_VECTOR, has-getter=true, has-notifier=true, has-setter=true
      methods:
        4 x operation:
          AcquireWakeLock
            arg error: type=CPP/Error, direction=OUT
          GetActiveEcuList
            arg ecuStatus: type=EcuStatus, direction=OUT
          ReleaseWakeLock
            arg error: type=CPP/Error, direction=OUT
          TriggerNodeDetection
            arg error: type=CPP/Error, direction=OUT
    NetManager: major-version=1, minor-version=0
      namespaces:
        symbol props Vehicle
        symbol props TAD
        symbol props NetManager
      methods:
        operation GetTADStatus
          arg result: type=TADStatusResult, direction=OUT
    NetManager: major-version=2, minor-version=0
      namespaces:
        symbol props Vehicle
        symbol props ApSysMgr
        symbol props NetManager
      events:
        data ChangePartialNetworkInfo: type=ChangePartialNetworkInfo_EventData
      5 x field, all with has-getter=true, has-notifier=true, has-setter=false:
        AppMode: type=AppModeType
        ExternalPnCluster: type=ExternalPnCluster_VECTOR
        InternalPnCluster: type=InternalPnCluster_VECTOR
        NetLoad: type=NetworkLoad
        NetStatus: type=CPP/NetworkStatus
      methods:
        6 x operation:
          ClearPnCluster
            arg setter: type=PNISetter, direction=IN
          SetCrankInhibit
            arg in: type=CPP/CrankInhibitStatus, direction=IN
          SetFodMode
            arg fodMode: type=FodModeType, direction=IN
          SetNetRequestInfo  # SM → ASM Network Request 전송을 위한 API
            arg netReq: type=CPP/NetworkRequest, direction=IN
          SetOtaMode
            arg otaMode: type=OtaModeType, direction=IN
          SetPnCluster
            arg pnMap: type=SetPnCluster_pnMap_VECTOR, direction=IN
            arg setter: type=PNISetter, direction=IN
    NetworkInformation: major-version=3, minor-version=0
      namespaces:
        symbol props DCU
        symbol props Telephony
        symbol props NetworkInformation
      9 x field, all with has-getter=true, has-notifier=true, has-setter=false:
        DataNetRegStatus: type=RegisterationStatus  # The current Data Registration status of a modem.
        MCC: type=String  # Contains the Mobile Country Code (MCC). This is repeated here for convenience. When Remote SIM Provisioning has been performed, the MVNO information (MCC / MNC value) also changed.
        MNC: type=String  # Contains the Mobile Network Code (MNC). This is repeated here for convenience. When Remote SIM Provisioning has been performed, the MVNO information (MCC / MNC value) also changed.
        Name: type=String  # Contains the current operator name, suitable for display on the idle screen or an empty string if not registered to a network.
        SignalStrengthGSM: type=SignalStrengthGSM  # Field for the signal metrics measured on GSM network This field is valid only if SignalStrengtType is TYPE_GSM and if SignalStrengtType is not TYPE_GSM type, the value for all field filled are invalid.
        SignalStrengthLTE: type=SignalStrengthLTE  # Field for the signal metrics measured on LTE network. This field is valid only if SignalStrengtType is TYPE_LTE. and if SignalStrengtType is not TYPE_LTE type, the value for all field filled are invalid.
        SignalStrengthType: type=CPP/SignalStrengthType  # Contains the Radio Access Technology of the signal metrics.
        SignalStrengthWCDMA: type=SignalStrengthWCDMA  # Field for the signal metrics measured on WCDMA network. This field is valid only if SignalStrengtType is TYPE_WCDMA. and if SignalStrengtType is not TYPE_WCDMA type, the value for all field filled are invalid.
        VoiceNetRegStatus: type=RegisterationStatus  # The current Voice Registration status of a modem.
    NetworkManager: major-version=1, minor-version=1
      namespaces:
        symbol props Vehicle
        symbol props MSM
        symbol props NetworkManager
      events:
        data OnDataRegistrationChanged: type=OnDataRegistrationChanged_EventData
      methods:
        operation GetDataRegistrationStatus
          arg status: type=RegistrationStatus, direction=OUT
        operation GetSignalStrength
          arg type: type=CPP/SignalStrengthType, direction=OUT
          arg signalStrength: type=double, direction=OUT
          arg noise: type=double, direction=OUT
    NetworkStatistics: major-version=1, minor-version=0
      namespaces:
        symbol props Vehicle
        symbol props Vcc
        symbol props NetworkStatistics
      methods:
        operation GetNetworkStatistics  # get network statistics for a network statistic type
          arg stat_type: type=NetworkVccStatisticsType, direction=IN
          arg stat: type=NetworkVccStatistics, direction=OUT
        operation GetNetworkStatisticsAll  # get all network statistics
          arg stat: type=GetNetworkStatisticsAll_stat_VECTOR, direction=OUT
    NonSleep: major-version=1, minor-version=1
      namespaces:
        symbol props Vehicle
        symbol props NSD
        symbol props NonSleep
      events:
        data NonSleepEvent: type=NonSleepEvent_EventData  # 미슬립 제어기 이벤트 발생시 Noti api
      methods:
        operation GetNonSleepData
          arg DID: type=uint16_t, direction=IN
          arg data: type=GetNonSleepData_data_VECTOR, direction=OUT
          arg result: type=CPP/DiagResponseType, direction=OUT
        operation GetNonSleepInfo  # 감지된 미슬립 제어기 명 획득 api
          arg NonSleepEthECUs: type=String, direction=OUT
          arg NonSleepCANECUs: type=String, direction=OUT
    OEUK: major-version=1, minor-version=0
      namespaces:
        symbol props Vehicle
        symbol props Security
        symbol props OEUK
      methods:
        operation Check_OEUK_Key
          arg key_status: type=OEUKSTATUS, direction=OUT  # Check if OEUK private key has been provisioned on secure storage.
          arg err: type=OEUKERR, direction=OUT
        operation Get_OEUK_Sign256
          arg seed: type=ByteArray, direction=IN
          arg sign256: type=ByteArray, direction=OUT
          arg err: type=OEUKERR, direction=OUT
    OTA: major-version=1, minor-version=0
      namespaces:
        symbol props Vehicle
        symbol props CM
        symbol props OTA
      methods:
        9 x operation:
          ActivateNewImage
            arg error: type=CmOtaError, direction=OUT
          BuildContainerImage
            arg capPath: type=String, direction=IN
            arg error: type=CmOtaError, direction=OUT
          FinishUpdate
            arg error: type=CmOtaError, direction=OUT
          GetContainers
            arg error: type=CmOtaError, direction=OUT
          GetImages
            arg error: type=CmOtaError, direction=OUT
          GetVersion
            arg version: type=String, direction=OUT
            arg error: type=CmOtaError, direction=OUT
          InitUpdate
            arg error: type=CmOtaError, direction=OUT
          RevertBack
            arg error: type=CmOtaError, direction=OUT
          RollingBack
            arg error: type=CmOtaError, direction=OUT
    PackageManagement: major-version=1, minor-version=2
      namespaces:
        symbol props Vehicle
        symbol props CM
        symbol props PackageManagement
      field CurrentStatus: type=CPP/PackageManagerStatusType, has-getter=true, has-notifier=true, has-setter=false  # The current status of UCM.
      field RollbackResult: type=CPP/RollbackResultType, has-getter=true, has-notifier=true, has-setter=false  # The result of rollback
      methods:
        21 x operation:
          Activate: possible-ap-error=[ActivatingUpdateFailed, ConditionNotCorrect, LowerVersionDownloadAttempt, MissingDependencies, OperationNotPermitted, PreActivationFailed, SecurityAccessDenied, UpdateSessionRejected, VerificationFailed]  # This method activates the processed components.
          Cancel: possible-ap-error=[CancelFailed, InvalidTransferId, OperationNotPermitted]  # This method aborts an ongoing processing of a Software Package.
            arg id: type=CPP/TransferIdType, direction=IN  # The Transfer ID.
          DeleteTransfer: possible-ap-error=[InvalidTransferId, OperationNotPermitted]  # Delete a transferred Software Package.
            arg id: type=CPP/TransferIdType, direction=IN  # Transfer ID of the currently running request.
          Finish: possible-ap-error=[OperationNotPermitted, SyncAbFailed]  # This method finishes the processing for the current set of processed Software Packages. It does a cleanup of all data of the processing including the sources of the Software Packages.
          GetAppIVDHash  # Application S/W의 IVD Hash를 structure vector 형태로 전달
            arg appIVDHash: type=CPP/AppIVDHashVectorType, direction=OUT
          GetHistory  # Getter method to retrieve all actions that have been performed by UCM.
            arg timestampGE: type=uint64_t, direction=IN  # Earliest timestamp (inclusive)
            arg timestampLT: type=uint64_t, direction=IN  # Latest timestamp (exclusive)
            arg history: type=CPP/GetHistoryVectorType, direction=OUT  # The history of all actions that have been performed by UCM.
          GetId  # Get the UCM Instance Identifier.
            arg id: type=CPP/UCMIdentifierType, direction=OUT  # UCM Module Instantiation Identifier.
          GetSwClusterChangeInfo  # This method returns a list pending changes to the set of SoftwareClusters on the adaptive platform. The returned list includes all SoftwareClusters that are to be added updated or removed. The list of changes is extended in the course of processing Software Packages.
            arg SwInfo: type=CPP/SwClusterInfoVectorType, direction=OUT  # List of SoftwareClusters that are in state kAdded kUpdated or kRemoved.
          GetSwClusterDescription  # This method returns the general information of the Software Clusters present in the platform
            arg SwCluster: type=CPP/SwDescVectorType, direction=OUT  # List of SoftwareClusters present in the platform.
          GetSwClusterInfo  # This method returns a list of SoftwareClusters that are in state kPresent
            arg SwInfo: type=CPP/SwClusterInfoVectorType, direction=OUT  # List of installed SoftwareClusters that are in state kPresent.
          GetSwPackages  # This method returns the Software Packages that available in UCM.
            arg Packages: type=CPP/SwPackageInfoVectorType, direction=OUT  # List of Software Packages.
          GetSwProcessProgress: possible-ap-error=InvalidTransferId  # Get the progress (0 - 100%) of the currently processed Software Package.
            arg id: type=CPP/TransferIdType, direction=IN  # The Transfer ID of the Software Package.
            arg progress: type=uint8_t, direction=OUT  # The progress of the current package processing (0% - 100%). 0x00 ... 0x64 0xFF for "’No information available"’
          Initialize: possible-ap-error=InitializeFailed  # Remove all the software packages and transfer to Idle state.
          ProcessSwPackage: possible-ap-error=[AlreadyInstalledVersion, AuthenticationFailed, ConditionNotCorrect, IncompatibleDelta, IncompatiblePackageVersion, InsufficientComputationPower, InsufficientMemory, InvalidPackageManifest, InvalidTransferId, OperationNotPermitted, ProcessSwPackageCancelled, ProcessedSoftwarePackageInconsistent, SecurityAccessDenied, SecurityError, ServiceBusy, SourceVerificationFailed, StartSelfUpdateFailed, TargetVerificationFailed, UpdateError]  # Process a previously transferred Software Package.
            arg id: type=CPP/TransferIdType, direction=IN  # The Transfer ID of the Software Package which should be processed.
          RemoveAppSwPackage: possible-ap-error=[ConditionNotCorrect, RemoveSwPackageFailed, SecurityAccessDenied]  # Application S/W의 삭제 요청
            arg AppID: type=String, direction=IN
          RevertProcessedSwPackages: possible-ap-error=[NotAbleToRevertPackages, OperationNotPermitted, RevertUpdateFailed]  # Revert the changes done by processing (ProcessSwPackage) of one or several software packages.
          Rollback: possible-ap-error=[ConditionNotCorrect, LowerVersionDownloadAttempt, NotAbleToRollback, OperationNotPermitted, RollingbackUpdateFailed, SecurityAccessDenied]  # Rollback the system to the state before the packages were processed.
          TransferData: possible-ap-error=[AuthenticationFailed, BlockInconsistent, ConditionNotCorrect, IncompatiblePackageVersion, IncorrectBlock, IncorrectBlockSize, IncorrectSize, InsufficientComputationPower, InsufficientMemory, InvalidTransferId, OperationNotPermitted, PackageInconsistent, SecurityAccessDenied, TransferInterrupted]  # Block-wise transfer of a Software Package to UCM.
            arg id: type=CPP/TransferIdType, direction=IN  # Transfer ID.
            arg data: type=ByteVectorType, direction=IN  # Data block of the Software Package.
            arg blockCounter: type=uint64_t, direction=IN  # Block counter value of the current block.
          TransferExit: possible-ap-error=[AuthenticationFailed, ConditionNotCorrect, IncompatiblePackageVersion, InsufficientData, InvalidPackageManifest, InvalidTransferId, MissingDependencies, OldVersion, OperationNotPermitted, PackageInconsistent, SecurityAccessDenied]  # Finish the transfer of a Software Package to UCM.
            arg id: type=CPP/TransferIdType, direction=IN  # Transfer ID of the currently running request.
          TransferFilePath: possible-ap-error=[ConditionNotCorrect, InvalidFilePath, InvalidTransferId, OperationNotPermitted, PackageInconsistent, SecurityAccessDenied]  # Software Package가 위치한 File Path를 전달
            arg id: type=CPP/TransferIdType, direction=IN  # Transfer ID of the currently running request.
            arg FilePath: type=String, direction=IN
          TransferStart: possible-ap-error=[ConditionNotCorrect, InsufficientComputationPower, InsufficientMemory, SecurityAccessDenied]  # Start the transfer of a Software Package. The size of the Software Package to be transferred to UCM must be provided. UCM will generate a Transfer ID for subsequent calls to TransferData TransferExit ProcessSwPackage DeleteTransfer.
            arg size: type=uint64_t, direction=IN  # Size (in bytes) of the Software Package to be transferred.
            arg id: type=CPP/TransferIdType, direction=OUT  # Return TransferId.
            arg BlockSize: type=uint32_t, direction=OUT  # Size of the blocks to be received with TransferData method.
    PackageManagement: major-version=1, minor-version=3
      namespaces:
        symbol props ara
        symbol props ucm
        symbol props pkgmgr
      field CurrentStatus: type=CPP/PackageManagerStatusType, has-getter=true, has-notifier=true, has-setter=false  # The current status of UCM.
      field PreInstallRequiredAppsInfo: type=PreInstallAppInfoVectorType, has-getter=true, has-notifier=true, has-setter=false  # notify preinstall app to UpdateMaster
      field RollbackResult: type=CPP/RollbackResultType, has-getter=true, has-notifier=true, has-setter=false  # The result of rollback
      methods:
        22 x operation:
          Activate: possible-ap-error=[ActivatingUpdateFailed, ConditionNotCorrect, LowerVersionDownloadAttempt, MissingDependencies, OperationNotPermitted, PreActivationFailed, SecurityAccessDenied, UpdateSessionRejected, VerificationFailed]  # This method activates the processed components.
          Cancel: possible-ap-error=[CancelFailed, InvalidTransferId, OperationNotPermitted]  # This method aborts an ongoing processing of a Software Package.
            arg id: type=CPP/TransferIdType, direction=IN  # The Transfer ID.
          DeleteTransfer: possible-ap-error=[InvalidTransferId, OperationNotPermitted]  # Delete a transferred Software Package.
            arg id: type=CPP/TransferIdType, direction=IN  # Transfer ID of the currently running request.
          Finish: possible-ap-error=[OperationNotPermitted, SyncAbFailed]  # This method finishes the processing for the current set of processed Software Packages. It does a cleanup of all data of the processing including the sources of the Software Packages.
          GetAppIVDHash  # Application S/W의 IVD Hash를 structure vector 형태로 전달
            arg appIVDHash: type=CPP/AppIVDHashVectorType, direction=OUT
          GetHistory  # Getter method to retrieve all actions that have been performed by UCM.
            arg timestampGE: type=uint64_t, direction=IN  # Earliest timestamp (inclusive)
            arg timestampLT: type=uint64_t, direction=IN  # Latest timestamp (exclusive)
            arg history: type=CPP/GetHistoryVectorType, direction=OUT  # The history of all actions that have been performed by UCM.
          GetId  # Get the UCM Instance Identifier.
            arg id: type=CPP/UCMIdentifierType, direction=OUT  # UCM Module Instantiation Identifier.
          GetSwClusterChangeInfo  # This method returns a list pending changes to the set of SoftwareClusters on the adaptive platform. The returned list includes all SoftwareClusters that are to be added updated or removed. The list of changes is extended in the course of processing Software Packages.
            arg SwInfo: type=CPP/SwClusterInfoVectorType, direction=OUT  # List of SoftwareClusters that are in state kAdded kUpdated or kRemoved.
          GetSwClusterDescription  # This method returns the general information of the Software Clusters present in the platform
            arg SwCluster: type=CPP/SwDescVectorType, direction=OUT  # List of SoftwareClusters present in the platform.
          GetSwClusterInfo  # This method returns a list of SoftwareClusters that are in state kPresent
            arg SwInfo: type=CPP/SwClusterInfoVectorType, direction=OUT  # List of installed SoftwareClusters that are in state kPresent.
          GetSwPackages  # This method returns the Software Packages that available in UCM.
            arg Packages: type=CPP/SwPackageInfoVectorType, direction=OUT  # List of Software Packages.
          GetSwProcessProgress: possible-ap-error=InvalidTransferId  # Get the progress (0 - 100%) of the currently processed Software Package.
            arg id: type=CPP/TransferIdType, direction=IN  # The Transfer ID of the Software Package.
            arg progress: type=uint8_t, direction=OUT  # The progress of the current package processing (0% - 100%). 0x00 ... 0x64 0xFF for "’No information available"’
          Initialize: possible-ap-error=InitializeFailed  # Remove all the software packages and transfer to Idle state.
          ProcessSwPackage: possible-ap-error=[AlreadyInstalledVersion, AuthenticationFailed, ConditionNotCorrect, IncompatibleDelta, IncompatiblePackageVersion, InsufficientComputationPower, InsufficientMemory, InvalidPackageManifest, InvalidTransferId, OperationNotPermitted, ProcessSwPackageCancelled, ProcessedSoftwarePackageInconsistent, SecurityAccessDenied, SecurityError, ServiceBusy, SourceVerificationFailed, StartSelfUpdateFailed, TargetVerificationFailed, UpdateError]  # Process a previously transferred Software Package.
            arg id: type=CPP/TransferIdType, direction=IN  # The Transfer ID of the Software Package which should be processed.
          RemoveAppSwPackage: possible-ap-error=[ConditionNotCorrect, RemoveSwPackageFailed, SecurityAccessDenied]  # Application S/W의 삭제 요청
            arg AppID: type=String, direction=IN
          RequestRDBI: possible-ap-error=RequestRDBIFailed  # SelfDiag 중 UCM에서 처리하는 데이터를 얻기 위한 범용적 RDBI method
            arg DID: type=uint16_t, direction=IN
            arg ack: type=bool, direction=OUT
            arg res: type=ByteArray, direction=OUT
          RevertProcessedSwPackages: possible-ap-error=[NotAbleToRevertPackages, OperationNotPermitted, RevertUpdateFailed]  # Revert the changes done by processing (ProcessSwPackage) of one or several software packages.
          Rollback: possible-ap-error=[ConditionNotCorrect, LowerVersionDownloadAttempt, NotAbleToRollback, OperationNotPermitted, RollingbackUpdateFailed, SecurityAccessDenied]  # Rollback the system to the state before the packages were processed.
          TransferData: possible-ap-error=[AuthenticationFailed, BlockInconsistent, ConditionNotCorrect, IncompatiblePackageVersion, IncorrectBlock, IncorrectBlockSize, IncorrectSize, InsufficientComputationPower, InsufficientMemory, InvalidTransferId, OperationNotPermitted, PackageInconsistent, SecurityAccessDenied, TransferInterrupted]  # Block-wise transfer of a Software Package to UCM.
            arg id: type=CPP/TransferIdType, direction=IN  # Transfer ID.
            arg data: type=ByteVectorType, direction=IN  # Data block of the Software Package.
            arg blockCounter: type=uint64_t, direction=IN  # Block counter value of the current block.
          TransferExit: possible-ap-error=[AuthenticationFailed, ConditionNotCorrect, IncompatiblePackageVersion, InsufficientData, InvalidPackageManifest, InvalidTransferId, MissingDependencies, OldVersion, OperationNotPermitted, PackageInconsistent, SecurityAccessDenied]  # Finish the transfer of a Software Package to UCM.
            arg id: type=CPP/TransferIdType, direction=IN  # Transfer ID of the currently running request.
          TransferFilePath: possible-ap-error=[ConditionNotCorrect, InvalidFilePath, InvalidTransferId, OperationNotPermitted, PackageInconsistent, SecurityAccessDenied]  # Software Package가 위치한 File Path를 전달
            arg id: type=CPP/TransferIdType, direction=IN  # Transfer ID of the currently running request.
            arg FilePath: type=String, direction=IN
          TransferStart: possible-ap-error=[ConditionNotCorrect, InsufficientComputationPower, InsufficientMemory, SecurityAccessDenied]  # Start the transfer of a Software Package. The size of the Software Package to be transferred to UCM must be provided. UCM will generate a Transfer ID for subsequent calls to TransferData TransferExit ProcessSwPackage DeleteTransfer.
            arg size: type=uint64_t, direction=IN  # Size (in bytes) of the Software Package to be transferred.
            arg id: type=CPP/TransferIdType, direction=OUT  # Return TransferId.
            arg BlockSize: type=uint32_t, direction=OUT  # Size of the blocks to be received with TransferData method.
    PackageManagement: major-version=1, minor-version=3
      namespaces:
        symbol props Vehicle
        symbol props FlashingAdaptor
        symbol props PackageManagement
      methods:
        25 x operation:
          Activate  # This method activates the processed components.
            arg TransferIdList: type=TransferIdVectorType, direction=IN  # Transfer ID List of the Software Packages which should be processed.
            arg ResultList: type=ReprogrammingResultVectorType, direction=OUT  # 각 TransferID(S/W Unit)에 대한 처리 결과
          CheckOTAReady  # 수행제어기로 OTA Ready 상태를 확인
            arg CanIdList: type=CanIdVectorType, direction=IN  # OTA Ready check 대상 제어기 CAN ID List
            arg Result: type=bool, direction=OUT  # 수행 결과
          CheckSwPackageIntegrity  # SW Package의 무결성 검사 진행
            4 x arg:
              filePath: type=String, direction=IN
              canId: type=String, direction=IN
              nodeId: type=String, direction=IN
              result: type=bool, direction=OUT
          ConfirmReset
          DeleteTransfer: possible-ap-error=[InvalidTransferId, OperationNotPermitted]  # Delete a transferred Software or Main Configuration.
            arg id: type=CPP/TransferIdType, direction=IN  # Transfer ID of the currently running request.
          Finish: possible-ap-error=OperationNotPermitted  # S/W Release에 대한 Software Update가 모두 완료되었음을 알림
          GetEcuCode  # UpdateMaster가 USS에 security access이전에 sendkey계산을 위해 ecu code값을 얻을 목적으로 호출한다.
            arg filePath: type=String, direction=IN
            arg ecuCode: type=ByteVectorType, direction=OUT
          GetSwClusterInfo  # This method returns a list of SoftwareClusters that are in state kPresent.
            arg SwInfo: type=CPP/SwClusterInfoVectorType, direction=OUT  # List of installed SoftwareClusters that are in state kPresent.
          Initialize: possible-ap-error=InitializeFailed
          ProcessSwPackage  # Process a previously transferred Software Package.
            arg TransferIdList: type=TransferIdVectorType, direction=IN  # Transfer ID List of the Software Packages which should be processed.
            arg ResultList: type=ReprogrammingResultVectorType, direction=OUT  # 각 TransferID(S/W Unit)에 대한 처리 결과
          RequestBackgroundTransfer  # Background Transfer 요청
            arg transferIdList: type=TransferIdVectorType, direction=IN  # Background transfer 대상 SWP에 대한 Tranfer ID List
            arg busLoadInfo: type=BusLoadInfoType, direction=IN  # Background transfer가 처리될 bus에 대한 정보
            arg ResultList: type=ReprogrammingResultVectorType, direction=OUT  # 각 TransferID(S/W Unit)에 대한 처리 결과
          RequestENMT  # 업데이트에 CCU가 포함된 경우 activation진행전에 RequestENMT method를 호출한다
            arg Result: type=bool, direction=OUT
          RequestFinishUpdate  # FinishUpdate 요청을 physical로 요청하기 위한 method
            arg canIdList: type=CanIdVectorType, direction=IN
            arg resultList: type=UdsResultTypeVector, direction=OUT
          RequestPostProcess  # 사후절차 수행 요청
            arg Result: type=bool, direction=OUT  # 수행 결과
          RequestPreProcess  # 사전절차 수행 요청
            arg CanIdList: type=CanIdVectorType, direction=IN  # 사전절차 대상 제어기 CAN ID List
            arg Result: type=bool, direction=OUT  # 수행 결과
          RequestProcessingRulePreparation
            arg TransferIdList: type=TransferIdVectorType, direction=IN  # Transfer ID List of the Software Packages which should be processed.
            arg filepath: type=String, direction=OUT
          RequestSessionControl
            arg CanIdList: type=CanIdVectorType, direction=IN
            arg SessionType: type=CPP/DiagSessionType, direction=IN
          RequestTPStart  # UpdateMaster에서 TP전송 요청을하기 위한 method (diagHandle 1:OTABS 2: OTA)
            arg diagHandle: type=uint8_t, direction=IN
          RequestTPStop  # UpdateMaster에서 TP전송 멈춤을 요청을하기 위한 method (diagHandle 1:OTABS 2: OTA)
            arg diagHandle: type=uint8_t, direction=IN
          Rollback  # Rollback 요청
            arg TransferIdList: type=TransferIdVectorType, direction=IN  # Transfer ID List of the Software Packages which should be processed.
            arg ResultList: type=ReprogrammingResultVectorType, direction=OUT  # 각 TransferID(S/W Unit)에 대한 처리 결과
          StopBackgroundTransfer  # Background Transfer 중단 요청
            arg TransferIdList: type=TransferIdVectorType, direction=IN
          TransferData: possible-ap-error=[BlockInconsistent, IncorrectBlock, IncorrectBlockSize, InsufficientMemory, InvalidTransferId, OperationNotPermitted, TransferInterrupted]  # Block-wise transfer of a Software Package to UCM.
            arg id: type=CPP/TransferIdType, direction=IN  # Transfer ID
            arg data: type=ByteVectorType, direction=IN  # Data block of the Software Package.
            arg blockCounter: type=uint64_t, direction=IN  # Block counter value of the current block.
          TransferExit: possible-ap-error=[AuthenticationFailed, IncompatiblePackageVersion, InsufficientData, InvalidPackageManifest, InvalidTransferId, OldVersion, OperationNotPermitted, PackageInconsistent]  # Finish the transfer of a Software Package to Flashing Adaptor
            arg id: type=CPP/TransferIdType, direction=IN  # Transfer ID of the currently running request.
          TransferFilePath: possible-ap-error=[InvalidFilePath, InvalidTransferId, OperationNotPermitted, PackageInconsistent]  # Software Package가 위치한 File Path를 전달
            arg id: type=CPP/TransferIdType, direction=IN  # Transfer ID of the currently running request.
            arg FilePath: type=String, direction=IN
          TransferStart: possible-ap-error=[InsufficientComputationPower, InsufficientMemory]  # Start the transfer of a Software Package.
            7 x arg:
              swUnitName: type=String, direction=IN
              swUnitVersion: type=String, direction=IN
              size: type=uint64_t, direction=IN  # Size (in bytes) of the Software Package to be transferred.
              canid: type=String, direction=IN  # Transfer할 Software Package가 설치될 ECU 정보
              clientType: type=CPP/ClientType, direction=IN
              Id: type=CPP/TransferIdType, direction=OUT  # Return TransferId
              BlockSize: type=uint32_t, direction=OUT  # Size of the blocks to be received with TransferData method.
    PackageManagement: major-version=1, minor-version=2
      namespaces:
        symbol props Vehicle
        symbol props UpdateMaster
        symbol props PackageManagement
      events:
        6 x data:
          AsyncServerReportRequested: type=AsyncServerReportRequested_EventData  # 비동기적 case에 대해 서버 보고를 위한 event
          MobileOriginateRequested: type=MobileOriginateRequested_EventData  # MO 요청에 대한 인터페이스
          MobileServerInfoReportRequested: type=MobileServerInfoReportRequested_EventData  # Mobile App으로의 업데이트 정보 전송을 위해 Server로의 Report가 필요함을 알리는 Event
          MobileServerResultReportRequested: type=MobileServerResultReportRequested_EventData  # Mobile App으로의 업데이트 결과 전송을 위해 Server로의 Report가 필요함을 알리는 Event
          ResetPrepareRequested: type=ResetPrepareRequested_EventData
          ServerReportRequested: type=ServerReportRequested_EventData  # Server로의 Report가 필요함을 알리는 Event
      6 x field, all with has-getter=true, has-notifier=true:
        InitializeRequested: type=bool, has-setter=false  # Initialize 발생 시 True로 세팅
        OtaFeatureInfo: type=StringMap, has-setter=true  # Status of Available OTA Feature
        SwReleaseResultReport: type=SwReleaseResultReportVectorType, has-setter=false  # Software 업데이트 결과 Report를 위한 Field
        UpdateClientInfo: type=CPP/ClientType, has-setter=false  # UpdateMaster가 현재 진행중인 업데이트의 Client 정보를 제공
        UpdateMasterState: type=UpdateMasterStateType, has-setter=false  # UpdateMaster의 State상태
        UpdateProgressReport: type=UpdateProgressReportType, has-setter=false  # SwRelease의 Update 및 Rollback 진행률
      methods:
        29 x operation:
          CancelUpdate: possible-ap-error=[CancelFailed, OperationNotPermitted]
            arg SwReleaseId: type=String, direction=IN
          ConfirmReset
          ConfirmSessionInactive  # OTA Client에서 Session이 종료되었음을 알리기 위한 method
          DeleteTransfer: possible-ap-error=[InvalidTransferId, OperationNotPermitted]
            arg id: type=CPP/TransferIdType, direction=IN
          FinishSoftwarePackageTransfer
            arg id: type=CPP/TransferIdType, direction=IN
          GetOtaConditions
            arg result: type=String, direction=OUT  # 엔지니어링모드에서 OTA 조건 확인하기 위한 인터페이스
          GetPhoneUpdateAvailable  # 폰앱 업데이트 가능 상태 제공 api
            arg status: type=uint8_t, direction=OUT
            arg reason: type=uint16_t, direction=OUT
          GetProcessingRulePreparationResult
            arg filepath: type=String, direction=OUT
            arg result: type=ProcessingRulePreparationResultType, direction=OUT
          GetSwClusterInfo: possible-ap-error=DiagPriviligeFailed
            arg SwInfo: type=CPP/SwClusterInfoVectorType, direction=OUT
          GetVehicleVersion  # FoD 상품 식별을 위해 필요한 차량 내 시스템 버전 제공
            arg vehicleVersion: type=String, direction=OUT
          Initialize: possible-ap-error=InitializeFailed
          MobileOriginateResponse
            arg resposneMessage: type=MobileTransferReportType, direction=IN  # MO 응답에 대한 인터페이스
            arg responseType: type=MOResponseType, direction=IN
          MobileTerminateRequest
            arg requestMessage: type=MobileTransferReportType, direction=IN  # MT 요청 및 응답에 대한 인터페이스
            arg responseMessage: type=MobileTransferReportType, direction=OUT
          RemoveApplicationSoftware: possible-ap-error=[ConditionNotCorrect, InitializeFailed, RemoveSwPackageFailed, SecurityAccessDenied]  # Application S/W의 삭제 요청
            arg AppID: type=String, direction=IN
            arg ecuCode: type=String, direction=IN
          ReportResetReady
            arg Result: type=bool, direction=IN
          RequestRDBI
            arg LID: type=uint16_t, direction=IN
            arg res: type=ByteVectorType, direction=OUT
            arg ack: type=bool, direction=OUT
          RequestRDBIfilepath
            arg LID: type=uint16_t, direction=IN
            arg filepath: type=String, direction=OUT
            arg ack: type=bool, direction=OUT
          RequestRoutineControl
            arg RID: type=uint16_t, direction=IN
            arg res: type=uint16_t, direction=OUT
            arg ack: type=bool, direction=OUT
          SetPhoneUpdateClientStatus  # 폰앱 업데이트 가능 상태를 Set하는 API
            arg status: type=uint8_t, direction=IN
          SetUmaEOUStatus  # EOU 상태값 Set하는 api
            arg status: type=uint8_t, direction=IN
          SwPackageInventory
            arg AvailableSoftwarePackages: type=CPP/SwNameVersionVectorType, direction=IN
            arg RequiredSoftwarePackages: type=CPP/SwNameVersionVectorType, direction=OUT
          TransferData: possible-ap-error=[AuthenticationFailed, BlockInconsistent, ConditionNotCorrect, IncompatiblePackageVersion, IncorrectBlock, IncorrectBlockSize, IncorrectSize, InsufficientComputationPower, InsufficientMemory, InvalidTransferId, OperationNotPermitted, PackageInconsistent, SecurityAccessDenied, TransferInterrupted]
            arg id: type=CPP/TransferIdType, direction=IN
            arg data: type=ByteVectorType, direction=IN
            arg blockCounter: type=uint64_t, direction=IN
          TransferExit: possible-ap-error=[AuthenticationFailed, ConditionNotCorrect, IncompatiblePackageVersion, InsufficientData, InvalidPackageManifest, InvalidTransferId, MissingDependencies, OldVersion, OperationNotPermitted, PackageInconsistent, SecurityAccessDenied]
            arg id: type=CPP/TransferIdType, direction=IN
          TransferFilePath: possible-ap-error=[ConditionNotCorrect, InvalidFilePath, InvalidTransferId, OperationNotPermitted, PackageInconsistent, SecurityAccessDenied]
            arg id: type=CPP/TransferIdType, direction=IN
            arg FilePath: type=String, direction=IN
          TransferStart: possible-ap-error=[ConditionNotCorrect, InsufficientComputationPower, InsufficientMemory, SecurityAccessDenied]
            5 x arg:
              swUnitName: type=String, direction=IN
              swUnitVersion: type=String, direction=IN
              size: type=uint64_t, direction=IN
              Id: type=CPP/TransferIdType, direction=OUT
              BlockSize: type=uint32_t, direction=OUT
          TransferVehiclePackage: possible-ap-error=[AuthenticationFailed, InsufficientMemory, InvalidPackageManifest, InvalidUpdateClientType, PackageInconsistent]
            6 x arg:
              clientType: type=CPP/ClientType, direction=IN
              size: type=uint64_t, direction=IN
              swReleaseId: type=String, direction=IN
              executeType: type=UpdateExecuteType, direction=IN
              targetVersionName: type=String, direction=IN
              id: type=CPP/TransferIdType, direction=OUT
          UpdateCCUConfig
            arg EcuInfo: type=CCUConfigVectorType, direction=IN
          UpdateVehicleVersion  # 현재 차량 버전 설정
            arg vehicleVersionId: type=String, direction=IN
            arg vehicleVersionName: type=String, direction=IN
          ValidateFinish  # This method delivers the results of the SW release validity review to UpdateMaster
            arg SwReleaseId: type=String, direction=IN
            arg Valid: type=bool, direction=IN
    Policy: major-version=1, minor-version=0
      namespaces:
        symbol props Vehicle
        symbol props DPM
        symbol props Policy
      events:
        11 x data:
          CIDSLogRetrieve: type=CIDSLogRetrieve_EventData
          CIDSPolicyDownloaded: type=CIDSPolicyDownloaded_EventData
          CmPolicyDownloaded: type=CmPolicyDownloaded_EventData
          EIDSLogRetrieve: type=EIDSLogRetrieve_EventData
          EIDSPolicyDownloaded: type=EIDSPolicyDownloaded_EventData
          KvsPolicyDownloaded: type=KvsPolicyDownloaded_EventData
          NssPolicyDownloaded: type=NssPolicyDownloaded_EventData
          TePolicyDownloaded: type=TePolicyDownloaded_EventData
          VamRecipeDownloaded: type=VamRecipeDownloaded_EventData
          VccPolicyDownloaded: type=VccPolicyDownloaded_EventData
          VdcPolicyDownloaded: type=VdcPolicyDownloaded_EventData
      methods:
        operation PolicyUpdateComplete
          arg updateData: type=ModuleUpdateData, direction=IN
          arg result: type=uint32_t, direction=OUT
    Policy: major-version=1, minor-version=3
      namespaces:
        symbol props Vehicle
        symbol props Vcc
        symbol props Policy
      methods:
        12 x operation:
          AllowCANStreaming  # Control Vcc firewall rule for CAN streaming / False : Off, True : On
            arg onOff: type=bool, direction=IN
            arg option: type=uint32_t, direction=IN
          AllowDLTStreaming  # Control Vcc firewall rule for DLT streaming / False : Off, True : On
            arg onOff: type=bool, direction=IN
            arg option: type=uint32_t, direction=IN
          ChangeIVNRule  # Service interface method to request for turning on/off specific IVN rules from consumers request. This method will have string aliases to mapping string to port like the following. NSS_RPC_BIND : 111 NSS_SSH_TUNNEL : 2048 NSS_NFS : 2049 NSS_MOUND : 54263 NSS_STATD : 54264 NSS_LOCKD : 54265 NSS_LOCKD_UDP : 54266 It will be used in parameter “types” and if “onOff” is true, this method will allow rules and if it is false, this method will remove rules.
            4 x arg:
              types: type=ChangeIVNRule_types_VECTOR, direction=IN
              onOff: type=bool, direction=IN
              option: type=uint32_t, direction=IN
              result: type=ErrorCode, direction=OUT
          GetAPNStatus
            arg apn_idx: type=uint64_t, direction=IN
            arg status: type=CPP/ConnectionStatus, direction=OUT
          GetAllAPNStatus
            arg all_status: type=ConnectionStatusMap, direction=OUT
          GetAllServiceGroupsAPN
            arg all_status: type=ApnTypeMap, direction=OUT
          GetCumulativeVccStats
            arg vcc_stats_config: type=VccStatsMask, direction=IN
            arg stats: type=Data, direction=OUT
          GetPolicyStatus
            arg status: type=CPP/PolicyStatus, direction=OUT
          GetRegionStatus
            arg region: type=RegionInfo, direction=OUT
          GetServiceGroupAPN
            arg svcGroup: type=CPP/GroupTypes, direction=IN
            arg status: type=ApnType, direction=OUT
          GetVccStats
            arg vcc_stats_config: type=VccStatsMask, direction=IN
            arg stats: type=Data, direction=OUT
          SetContainerRules  # Service interface method to request applying iptables rules for docker daemon and containers configuration. This is to avoid letting docker daemon set the rules on its own.
            4 x arg:
              rules: type=SetContainerRules_rules_VECTOR, direction=IN
              onOff: type=bool, direction=IN
              option: type=uint32_t, direction=IN
              result: type=ErrorCode, direction=OUT
    PowerManagement: major-version=2, minor-version=2
      namespaces:
        symbol props DCU
        symbol props System
        symbol props PowerManagement
      field ModemPowerStatus: type=CPP/ModemPowerStatus, has-getter=true, has-notifier=true, has-setter=false  # Notification of power management events due to power state changes.
      field SystemBootReason: type=CPP/SystemBootReason, has-getter=true, has-notifier=true, has-setter=false  # SystemBootReason indicates the booting reason of the DCU system.
      methods:
        operation GetRemoteControlWaitingTime  # Waiting time (min) for switching to a system sleep state.
          arg min: type=uint32_t, direction=OUT
        operation SetRemoteControlWaitingTime  # Change the waiting time (min) for switching to a system sleep state.
          arg min: type=uint32_t, direction=IN
          arg error_of_CommonAPI: type=CPP/SetPropertyError, direction=OUT
        operation SetWakeupPinStatus  # When performing a remote standby shutdown notification scenario, the CCU notifies the DCU that it is performing a reporting procedure. This process allows the DCU to lower the WAKEUP PIN. It's like clearing a message in an SMS MT scenario.
          arg error_of_CommonAPI: type=CPP/SetPropertyError, direction=OUT
    PowerTrain1: major-version=1, minor-version=1
      namespaces:
        symbol props Vehicle
        symbol props SOAAdaptor
        symbol props PowerTrain1
      events:
        data VCU_01_10ms: type=VCU_01_10ms_EventData
      25 x field, all with has-getter=true, has-notifier=true, has-setter=false:
        ACInputPower: type=CPP/SignalInfo_Float  # V2LC_AcPwrDis
        AutoPowerOffInfo: type=CPP/SignalInfo_UInt8  # ENG_PwrAutoOffInfo
        AutoPowerOffTimerInfo: type=CPP/SignalInfo_UInt8  # ENG_AutoShutOffTimerMin
        CCSLeakNotification: type=CPP/SignalInfo_UInt8  # HMU1_CcsLeakNoti
        CO2ReductionAmount: type=CPP/SignalInfo_Float  # FCU_CO2Rdc
        CO2ReductionTripDistance: type=CPP/SignalInfo_UInt16  # FCU_CO2RdcTripDist
        ChargeAlarmState: type=CPP/SignalInfo_UInt8  # V2LC_ChgAlarm_Stat
        ChargeAlarmSubcode: type=CPP/SignalInfo_UInt8  # V2LC_ChgAlarm_Subcode
        EngineOilLevelLampState: type=CPP/SignalInfo_UInt8  # ENG_OilLvlSta
        EngineRPM: type=CPP/SignalInfo_Float  # ENG_EngSpdVal
        FuelH2State: type=CPP/SignalInfo_Float  # HMU1_Sof
        GearPosition: type=CPP/SignalInfo_UInt8  # TCU_GearSlctDis
        H2Status: type=CPP/SignalInfo_Float  # HMU1_SofClu
        HEVEngineOilLevelLampState: type=CPP/SignalInfo_UInt8  # HEV_OilLvlSta
        HEVEngineRPM: type=CPP/SignalInfo_Float  # HEV_EngSpdVal
        HeadsBreathingbyPurAir: type=CPP/SignalInfo_UInt8  # FCU_PurAirHead
        HydrogenLeakStatus: type=CPP/SignalInfo_UInt8  # HMU1_SnsH2Leak
        ParkingReleaseState: type=CPP/SignalInfo_UInt8  # SBW_PrkngReleaseSta
        PurifiedAirAmount: type=CPP/SignalInfo_Float  # FCU_PurAir
        SCU_FF_IG3WakeUpStatus: type=CPP/SignalInfo_UInt8  # SCU_FF_IG3WakeUp_Sta
        SCU_FF_PositionActStatus: type=CPP/SignalInfo_UInt8  # SCU_FF_PosActSta
        UREALevel: type=CPP/SignalInfo_Float  # SCR_UreaLvlSta
        V2LRemainTime: type=CPP/SignalInfo_UInt16  # V2LC_V2LEstDischgRmnTime
        V2XDisplayOptionFlag: type=CPP/SignalInfo_UInt8  # V2LC_V2XDisOpFlag
        WCCUReadyState: type=CPP/SignalInfo_UInt8  # WCCU_Rdy
    PowerTrain2: major-version=2, minor-version=1
      namespaces:
        symbol props Vehicle
        symbol props SOAAdaptor
        symbol props PowerTrain2
      355 x field, all with has-getter=true, has-notifier=true, has-setter=false:
        ACChargingStatus: type=CPP/SignalInfo_UInt8  # OBC_AcChrgSta
        ACNPermissionPower: type=CPP/SignalInfo_UInt16  # FCU_AcnPrmPwr
        AVNDTECorrelationFactorValue: type=CPP/SignalInfo_Float  # VCU_AvnDteCorFacVal
        AirconditionerActivation: type=CPP/SignalInfo_UInt8  # HCU_AirconCtrReq
        AirconditionerControlStatus: type=CPP/SignalInfo_UInt8  # HCU_SchedRmtClimate_OpSta
        AirconditioningFinishAlarmStatus: type=CPP/SignalInfo_UInt8  # HCU_AirconFinishAlmSta
        AutoPowerOff: type=CPP/SignalInfo_UInt8  # HCU_PwrAutoOffInfo
        AutoShutOffTime: type=CPP/SignalInfo_UInt8  # HCU_AutoShutOffTimerMin
        AuxiliaryBattChargeInhibitCauseType: type=CPP/SignalInfo_UInt8  # VCU_AuxBattChgInhbtCauseTyp
        AvailableEnergyValue: type=CPP/SignalInfo_UInt32  # EV_AvlblEnrgVal
        BMSSWversion: type=CPP/SignalInfo_UInt16  # VCRM_SwVerVal
        BatChllrTgtRpm: type=CPP/SignalInfo_UInt32  # VCU_BatChllrTgtRpm
        BatWcsHeaterOnReq: type=CPP/SignalInfo_UInt8  # VCU_BatWcsHeaterOnReq
        BattCell{10..19}VoltVal: type=CPP/SignalInfo_UInt16  # VCRM_BattCell{10..19}VoltVal
        BattCell1VoltVal: type=CPP/SignalInfo_UInt16  # VCRM_BattCell1VoltVal
        BattCell1_Index: type=CPP/SignalInfo_UInt8  # VCRM_BattCell1_Index
        BattCell{20..29}VoltVal: type=CPP/SignalInfo_UInt16  # VCRM_BattCell{20..29}VoltVal
        BattCell2VoltVal: type=CPP/SignalInfo_UInt16  # VCRM_BattCell2VoltVal
        BattCell2_Index: type=CPP/SignalInfo_UInt8  # VCRM_BattCell2_Index
        BattCell{30..39}VoltVal: type=CPP/SignalInfo_UInt16  # VCRM_BattCell{30..39}VoltVal
        BattCell3VoltVal: type=CPP/SignalInfo_UInt16  # VCRM_BattCell3VoltVal
        BattCell3_Index: type=CPP/SignalInfo_UInt8  # VCRM_BattCell3_Index
        BattCell{40..49}VoltVal: type=CPP/SignalInfo_UInt16  # VCRM_BattCell{40..49}VoltVal
        BattCell4VoltVal: type=CPP/SignalInfo_UInt16  # VCRM_BattCell4VoltVal
        BattCell4_Index: type=CPP/SignalInfo_UInt8  # VCRM_BattCell4_Index
        BattCell{50..59}VoltVal: type=CPP/SignalInfo_UInt16  # VCRM_BattCell{50..59}VoltVal
        BattCell5VoltVal: type=CPP/SignalInfo_UInt16  # VCRM_BattCell5VoltVal
        BattCell5_Index: type=CPP/SignalInfo_UInt8  # VCRM_BattCell5_Index
        BattCell{60..69}VoltVal: type=CPP/SignalInfo_UInt16  # VCRM_BattCell{60..69}VoltVal
        BattCell6VoltVal: type=CPP/SignalInfo_UInt16  # VCRM_BattCell6VoltVal
        BattCell6_Index: type=CPP/SignalInfo_UInt8  # VCRM_BattCell6_Index
        BattCell{70..79}VoltVal: type=CPP/SignalInfo_UInt16  # VCRM_BattCell{70..79}VoltVal
        BattCell7VoltVal: type=CPP/SignalInfo_UInt16  # VCRM_BattCell7VoltVal
        BattCell7_Index: type=CPP/SignalInfo_UInt8  # VCRM_BattCell7_Index
        BattCell{80..89}VoltVal: type=CPP/SignalInfo_UInt16  # VCRM_BattCell{80..89}VoltVal
        BattCell8VoltVal: type=CPP/SignalInfo_UInt16  # VCRM_BattCell8VoltVal
        BattCell{90..98}VoltVal: type=CPP/SignalInfo_UInt16  # VCRM_BattCell{90..98}VoltVal
        BattCell9VoltVal: type=CPP/SignalInfo_UInt16  # VCRM_BattCell9VoltVal
        BattConditioActState: type=CPP/SignalInfo_UInt8  # VCU_BattCondActSta
        BattCurrVal: type=CPP/SignalInfo_Float  # xEV_BattCurrVal
        BattTempMainMaxVal: type=CPP/SignalInfo_Int8  # xEV_BattTempMainMaxVal
        BattTempMainMinVal: type=CPP/SignalInfo_Int8  # xEV_BattTempMainMinVal
        BattTemperatureValue: type=CPP/SignalInfo_Float  # BAT_TempVal
        BatteryConditioningApply: type=CPP/SignalInfo_UInt8  # VCU_BattCondApply
        BatteryConditioningState: type=CPP/SignalInfo_UInt8  # VCU_BattCondIndSta
        BatteryEmergencyState: type=CPP/SignalInfo_UInt8  # xEV_BatEvtAlarm
        BatteryHeaterInputPower: type=CPP/SignalInfo_UInt16  # xEV_BatHeatPwrMonCon_W
        BatteryOptionValue: type=CPP/SignalInfo_UInt8  # BAT_AuxBattOpt
        BatteryPackVoltage: type=CPP/SignalInfo_Float  # xEV_BattPckVoltVal
        BatteryPopupMessage: type=CPP/SignalInfo_UInt8  # VCU_BattCondPopupApp
        BatterySpecInfo: type=CPP/SignalInfo_UInt16  # EV_BatterySpecInfo
        BatteryTemperatureState: type=CPP/SignalInfo_UInt8  # VCU_BattCondTempSta
        Bms_H_avg_max: type=CPP/SignalInfo_UInt8  # xEV_Bms_H_avg_max
        Bms_H_ocv_max: type=CPP/SignalInfo_UInt8  # xEV_Bms_H_ocv_max
        Bms_Vmax_dec: type=CPP/SignalInfo_UInt16  # xEV_Bms_Vmax_dec
        Bms_Vmin_dec: type=CPP/SignalInfo_UInt16  # xEV_Bms_Vmin_dec
        CCMContCertChnStatus: type=CPP/SignalInfo_UInt8  # CCM_ContCert_ChnSta
        CCMContCertInstNumber: type=CPP/SignalInfo_UInt8  # CCM_ContCert_InstNum
        CCM_ContCert_ChnDel_Result: type=CPP/SignalInfo_UInt8
        CCM_PnCModeStatus: type=CPP/SignalInfo_UInt8
        CertificateReceiveOptionFlag: type=CPP/SignalInfo_UInt8  # CCM_CertRecvOpt
        CertificateReceiveStatus: type=CPP/SignalInfo_UInt8  # CCM_CertRecvSta
        ChargeCurrentMode_NoVCMS: type=CPP/SignalInfo_UInt8  # OBC_ChgInCurrModSta
        ChargeCurrentMode_VCMS: type=CPP/SignalInfo_UInt8  # VCMS_ChgInCurrModSta
        ChargeRemainedTime: type=CPP/SignalInfo_UInt16  # CHRG_RealStndChrgRmnTimeVal
        ChargeRemainedTime120: type=CPP/SignalInfo_UInt16  # CHRG_StndChrgRmnTime120Val
        ChargeRemainedTime240: type=CPP/SignalInfo_UInt16  # CHRG_StndChrgRmnTime240Val
        ChargeRemainedTime240_VCRM: type=CPP/SignalInfo_UInt16  # VCRM_StndChrgRmnTime240Val
        ChargeRemainedTimeValue: type=CPP/SignalInfo_UInt16  # CHRG_StndChrgRmnTimeVal
        ChargeSOCValue: type=CPP/SignalInfo_Float  # CHRG_ScChgTargetSOCSync
        ChargeStartStatus: type=CPP/SignalInfo_UInt8  # CCM_ChgEntSta
        ChargeStateforAlarm: type=CPP/SignalInfo_UInt8  # VCMS_ChgAlarm_Stat
        ChargeStateforAlarm_Subcode: type=CPP/SignalInfo_UInt8  # VCMS_ChgAlarm_Subcode
        ChargingFinishReason: type=CPP/SignalInfo_UInt8  # VCRM_NorChgFnshSta
        ChargingFinishState: type=CPP/SignalInfo_UInt8  # VCRM_ChrgFnshSta
        ChargingPowerDerating: type=CPP/SignalInfo_UInt8  # VCMS_ChgPwrDerating
        ChargingState: type=CPP/SignalInfo_UInt8  # CHRG_ChrgSta
        ChgEnergyDis: type=CPP/SignalInfo_UInt8  # VCMS_ChgEnergyDis
        ChrgInletTyp: type=CPP/SignalInfo_UInt8  # VCMS_ChrgInletTyp
        ClimateControlState: type=CPP/SignalInfo_UInt8  # VCU_SchedRmtClimate_OpSta
        ContractCertificate{1..5}Status: type=CPP/SignalInfo_UInt8  # CCM_ContCert_Sta{1..5}
        ContractCertificateCompanyInfo{1..5}: type=CPP/SignalInfo_UInt8  # CCM_ContCert_Info{1..5}_ExcSta
        ContractCertificateSelectionStatus: type=CPP/SignalInfo_UInt8  # CCM_ContCert_SelectSta
        ContractCertificateUserInfo1: type=CPP/SignalInfo_UInt64  # CCM_ContCert_Info1
        ContractCertificateUserInfo2: type=CPP/SignalInfo_UInt64  # CCM_ContCert_Info2
        ContractCertificateUserInfo3_1: type=CPP/SignalInfo_UInt32  # CCM_ContCert_Info3_1
        ContractCertificateUserInfo3_2: type=CPP/SignalInfo_UInt16  # CCM_ContCert_Info3_2
        ContractCertificateUserInfo4: type=CPP/SignalInfo_UInt64  # CCM_ContCert_Info4
        ContractCertificateUserInfo5: type=CPP/SignalInfo_UInt64  # CCM_ContCert_Info5
        DcChargingStatus: type=CPP/SignalInfo_UInt8  # OBC_DcChrgSta
        DepartSet1EnableState: type=CPP/SignalInfo_UInt8  # VCU_DepartSet1_EnSta
        DepartSet1_Fri: type=CPP/SignalInfo_UInt8  # VCU_DepartSet1_Fri
        DepartSet1_Hour: type=CPP/SignalInfo_UInt8  # VCU_DepartSet1_HrVal
        DepartSet1_Min: type=CPP/SignalInfo_UInt8  # VCU_DepartSet1_MinVal
        DepartSet1_Mon: type=CPP/SignalInfo_UInt8  # VCU_DepartSet1_Mon
        DepartSet1_Sat: type=CPP/SignalInfo_UInt8  # VCU_DepartSet1_Sat
        DepartSet1_Sun: type=CPP/SignalInfo_UInt8  # VCU_DepartSet1_Sun
        DepartSet1_Thu: type=CPP/SignalInfo_UInt8  # VCU_DepartSet1_Thu
        DepartSet1_Tue: type=CPP/SignalInfo_UInt8  # VCU_DepartSet1_Tue
        DepartSet1_Wed: type=CPP/SignalInfo_UInt8  # VCU_DepartSet1_Wed
        DepartSet2EnableState: type=CPP/SignalInfo_UInt8  # VCU_DepartSet2_EnSta
        DepartSet2_Fri: type=CPP/SignalInfo_UInt8  # VCU_DepartSet2_Fri
        DepartSet2_Hour: type=CPP/SignalInfo_UInt8  # VCU_DepartSet2_HrVal
        DepartSet2_Min: type=CPP/SignalInfo_UInt8  # VCU_DepartSet2_MinVal
        DepartSet2_Mon: type=CPP/SignalInfo_UInt8  # VCU_DepartSet2_Mon
        DepartSet2_Sat: type=CPP/SignalInfo_UInt8  # VCU_DepartSet2_Sat
        DepartSet2_Sun: type=CPP/SignalInfo_UInt8  # VCU_DepartSet2_Sun
        DepartSet2_Thu: type=CPP/SignalInfo_UInt8  # VCU_DepartSet2_Thu
        DepartSet2_Tue: type=CPP/SignalInfo_UInt8  # VCU_DepartSet2_Tue
        DepartSet2_Wed: type=CPP/SignalInfo_UInt8  # VCU_DepartSet2_Wed
        DisplayOperationFlag: type=CPP/SignalInfo_UInt8  # VCMS_DisOpFlag
        DomesticChargeRemainedTime: type=CPP/SignalInfo_UInt16  # VCRM_DomStndChrgRmnTimeVal
        DteBaseValue: type=CPP/SignalInfo_UInt16  # VCU_DteBaseVal
        DteOffDisplayState: type=CPP/SignalInfo_UInt8  # VCU_DteOffDispSta
        DteOffDisplayState_HCU: type=CPP/SignalInfo_UInt8  # HCU_DteOffDis
        DteV2LValue: type=CPP/SignalInfo_UInt16  # VCU_DteV2LVal
        EVBatteryConditioningState: type=CPP/SignalInfo_UInt8  # EV_BatteryConditioning
        EVModeDTEKmValue: type=CPP/SignalInfo_UInt16  # HCU_EVModDTEKmVal
        EVModeDTEMileValue: type=CPP/SignalInfo_UInt16  # HCU_EVModDTEMileVal
        ElectricDrivingReadyState: type=CPP/SignalInfo_UInt8  # VCU_EvDrvRdySta
        ElectricSupplyStandReadyState: type=CPP/SignalInfo_UInt8  # VCMS_EvseRdyStat
        EnergyCapacityValue: type=CPP/SignalInfo_UInt32  # EV_EnrgCapVal
        EstimatedRamainTime: type=CPP/SignalInfo_UInt16  # VCMS_V2LEstDischgRmnTime
        EuroChargeRemainedTime: type=CPP/SignalInfo_UInt16  # VCRM_EuroStndChrgRmnTimeVal
        EvseReadyStatus: type=CPP/SignalInfo_UInt8  # OBC_EvseRdySta
        ExpiredMonth{1..5}ofCertificate: type=CPP/SignalInfo_UInt8  # CCM_ContCert_ExpireMon{1..5}
        Expiredyear{1..5}ofCertificate: type=CPP/SignalInfo_UInt8  # CCM_ContCert_ExpireYear{1..5}
        FCU_H2LkLmp: type=CPP/SignalInfo_UInt8
        FCU_H2LkSte: type=CPP/SignalInfo_UInt8
        FCU_HeatCoopRspn: type=CPP/SignalInfo_UInt8
        FastChargeSOCValue: type=CPP/SignalInfo_Float  # CHRG_QcChgTargetSOCSync
        FastChargingState: type=CPP/SignalInfo_UInt8  # EV_FstChrgSta
        FatcPowerUseValue: type=CPP/SignalInfo_UInt16  # VCU_FatcPwrUseVal
        Fcu_WkuFncFailInfo: type=CPP/SignalInfo_UInt8
        FlatTowModeChargePowerUsmState: type=CPP/SignalInfo_UInt8  # VCU_FlatTowModeChgPwrUsmSta
        FlatTowModeCondtionState: type=CPP/SignalInfo_UInt8  # VCU_FlatTowModeConIndSta
        FlatTowModeEquipmentState: type=CPP/SignalInfo_UInt8  # VCU_FlatTowModeEquip
        FlatTowModeTargetSocUsmState: type=CPP/SignalInfo_UInt8  # VCU_FlatTowModeTargetSocUsmSta
        FlatTowModeUsmState: type=CPP/SignalInfo_UInt8  # VCU_FlatTowModeUsmSta
        FuelCellColdStartUp: type=CPP/SignalInfo_UInt8  # FCU_FcCsuDp
        GearPosition: type=CPP/SignalInfo_UInt8  # VCU_GearPosSta
        HCU_ChrgCtrlModStayus: type=CPP/SignalInfo_UInt8
        HCU_DptEnaSet1FriStatus: type=CPP/SignalInfo_UInt8
        HCU_DptEnaSet1MonStatus: type=CPP/SignalInfo_UInt8
        HCU_DptEnaSet1SatStatus: type=CPP/SignalInfo_UInt8
        HCU_DptEnaSet1Status: type=CPP/SignalInfo_UInt8
        HCU_DptEnaSet1SunStatus: type=CPP/SignalInfo_UInt8
        HCU_DptEnaSet1ThuStatus: type=CPP/SignalInfo_UInt8
        HCU_DptEnaSet1TueStatus: type=CPP/SignalInfo_UInt8
        HCU_DptEnaSet1WedStatus: type=CPP/SignalInfo_UInt8
        HCU_DptEnaSet2FriStatus: type=CPP/SignalInfo_UInt8
        HCU_DptEnaSet2MonStatus: type=CPP/SignalInfo_UInt8
        HCU_DptEnaSet2SatStatus: type=CPP/SignalInfo_UInt8
        HCU_DptEnaSet2Status: type=CPP/SignalInfo_UInt8
        HCU_DptEnaSet2SunStatus: type=CPP/SignalInfo_UInt8
        HCU_DptEnaSet2ThuStatus: type=CPP/SignalInfo_UInt8
        HCU_DptEnaSet2TueStatus: type=CPP/SignalInfo_UInt8
        HCU_DptEnaSet2WedStatus: type=CPP/SignalInfo_UInt8
        HCU_DptHrSet1Value: type=CPP/SignalInfo_UInt8
        HCU_DptHrSet2Value: type=CPP/SignalInfo_UInt8
        HCU_DptMinSet1Value: type=CPP/SignalInfo_UInt8
        HCU_DptMinSet2Value: type=CPP/SignalInfo_UInt8
        HCU_EcoChrgEndHrValue: type=CPP/SignalInfo_UInt8
        HCU_EcoChrgEndHrWeekendValue: type=CPP/SignalInfo_UInt8
        HCU_EcoChrgEndMinValue: type=CPP/SignalInfo_UInt8
        HCU_EcoChrgEndMinWeekendValue: type=CPP/SignalInfo_UInt8
        HCU_EcoChrgStrtHrValue: type=CPP/SignalInfo_UInt8
        HCU_EcoChrgStrtHrWeekendValue: type=CPP/SignalInfo_UInt8
        HCU_EcoChrgStrtMinValue: type=CPP/SignalInfo_UInt8
        HCU_EcoChrgStrtMinWeekendValue: type=CPP/SignalInfo_UInt8
        HCU_IG1Status: type=CPP/SignalInfo_UInt8  # HCU_Ign1Sta
        HCU_SchedChgEndDayValue: type=CPP/SignalInfo_UInt8
        HCU_SchedChgEndHrValue: type=CPP/SignalInfo_UInt8
        HCU_SchedChgEndMinValue: type=CPP/SignalInfo_UInt8
        HCU_SchedChgStrtDayValue: type=CPP/SignalInfo_UInt8
        HCU_SchedChgStrtHrValue: type=CPP/SignalInfo_UInt8
        HCU_SchedChgStrtMinValue: type=CPP/SignalInfo_UInt8
        HybridVehicleReadyState: type=CPP/SignalInfo_UInt8  # HCU_HevRdySta
        IG3RelayModeState: type=CPP/SignalInfo_UInt8  # HCU_IG3RlyModSta
        IG3RelayOnlyStatus: type=CPP/SignalInfo_UInt8  # HCU_IG3RlyOnlySta
        InletLockModeStatus: type=CPP/SignalInfo_UInt8  # VCMS_InletAutoLockMode
        InletTemperature: type=CPP/SignalInfo_Int8  # VCRM_InltTempVal
        IsolResistVal: type=CPP/SignalInfo_UInt16  # VCRM_IsolResistVal
        LDCSystemFaultState: type=CPP/SignalInfo_UInt8  # LDC_SysFltSta
        MainRelayVehicleCondition: type=CPP/SignalInfo_UInt8  # VCU_MainRlyVehCondi
        MainRlyOnSta: type=CPP/SignalInfo_UInt8  # xEV_MainRlyOnSta
        MaxBattCelVoltVal: type=CPP/SignalInfo_Float  # xEV_MaxBattCelVoltVal
        MaximumBatteryTemperature: type=CPP/SignalInfo_Int8  # xEV_MaxBattTempVal
        MaximumBatteryTemperature_Dec: type=CPP/SignalInfo_Float  # xEV_MaxBattTemp_Dec
        Mg1InvtCtrlRdySta: type=CPP/SignalInfo_UInt8  # MCU_Mg1InvtCtrlRdySta
        Mg2InvtRdySta: type=CPP/SignalInfo_UInt8  # MCU_Mg2InvtRdySta
        MinBattCelVoltVal: type=CPP/SignalInfo_Float  # xEV_MinBattCelVoltVal
        MinimumBatteryTemperature: type=CPP/SignalInfo_Int8  # xEV_MinBattTempVal
        MinimumBatteryTemperature_Dec: type=CPP/SignalInfo_Float  # xEV_MinBattTemp_Dec
        OBCAcPowerDisplay: type=CPP/SignalInfo_Float  # OBC_AcPwrDis
        OBCSystemFaultState: type=CPP/SignalInfo_UInt8  # OBC_SysFltSta
        OffPeakTimeEndHour: type=CPP/SignalInfo_UInt8  # VCU_OffPeakTimeEndHrVal
        OffPeakTimeEndMin: type=CPP/SignalInfo_UInt8  # VCU_OffPeakTimeEndMinVal
        OffPeakTimeStartHour: type=CPP/SignalInfo_UInt8  # VCU_OffPeakTimeStHrVal
        OffPeakTimeStartMin: type=CPP/SignalInfo_UInt8  # VCU_OffPeakTimeStMinVal
        OnBoardChargerReady: type=CPP/SignalInfo_UInt8  # VCMS_Rdy
        PdState: type=CPP/SignalInfo_UInt8  # OBC_PdSta
        PnCPCID1: type=CPP/SignalInfo_UInt32  # CCM_Cert_PCID1
        PnCPCID2: type=CPP/SignalInfo_UInt64  # CCM_Cert_PCID2
        PnCPCID3: type=CPP/SignalInfo_UInt64  # CCM_Cert_PCID3
        QuickChargeRemainedTime: type=CPP/SignalInfo_UInt16  # EV_QckChrgRmnTimeVal
        RemainBattery: type=CPP/SignalInfo_UInt8  # BAT_SocVal
        RemoteAirconOptionInfo: type=CPP/SignalInfo_UInt8  # HCU_AirconFcnOpt
        RemoteClimateState: type=CPP/SignalInfo_UInt8  # VCU_RmtClmt_Sta
        SOCValue_Dec: type=CPP/SignalInfo_Float  # xEV_SocDecVal
        SOC_V2Xdischargelimitation: type=CPP/SignalInfo_Float  # CHRG_V2XDischrgLimSocVal_SYNC
        SOC_VCMSV2Xdischargelimitation: type=CPP/SignalInfo_Float  # VCMS_V2XDischgLimSocVal_SYNC
        ScheduleRemoteFunctionState: type=CPP/SignalInfo_UInt8  # VCU_SchedRmtFcn_OpSta
        ScheduledChargeMode: type=CPP/SignalInfo_UInt8  # VCU_SchedChgSet_OpModeSta
        ScheduledCharge_EndDay: type=CPP/SignalInfo_UInt8  # VCU_SchedChg_EndDayDispSta
        ScheduledCharge_EndHour: type=CPP/SignalInfo_UInt8  # VCU_SchedChg_EndHrDispVal
        ScheduledCharge_EndMin: type=CPP/SignalInfo_UInt8  # VCU_SchedChg_EndMinDispVal
        ScheduledCharge_StartDay: type=CPP/SignalInfo_UInt8  # VCU_SchedChg_StDayDispSta
        ScheduledCharge_StartHour: type=CPP/SignalInfo_UInt8  # VCU_SchedChg_StHrDispVal
        ScheduledCharge_StartMin: type=CPP/SignalInfo_UInt8  # VCU_SchedChg_StMinDispVal
        ScheduledClimateDefrostEnableState: type=CPP/SignalInfo_UInt8  # VCU_SchedClimateSet_DefrostEnSta
        ScheduledClimateEnableState: type=CPP/SignalInfo_UInt8  # VCU_SchedClimateSet_EnSta
        ScheduledClimateState: type=CPP/SignalInfo_UInt8  # VCU_SchedClmt_Sta
        ScheduledClimateTemperature: type=CPP/SignalInfo_UInt8  # VCU_SchedClimateSet_TempVal
        ScheduledClimateTemperatureUnit: type=CPP/SignalInfo_UInt8  # VCU_SchedClimateSet_TempUnitTyp
        StandardChargeConnectState: type=CPP/SignalInfo_UInt8  # VCRM_StndChrgConnSta
        StandardChargingState: type=CPP/SignalInfo_UInt8  # CHRG_StndChrgSta
        StateOfChargeDisplay: type=CPP/SignalInfo_Float  # xEV_SocDis
        StateOfChargeValue: type=CPP/SignalInfo_Float  # xEV_SocVal
        TargetSocDteAcChargerValue: type=CPP/SignalInfo_UInt16  # VCU_TgSocDteAcChgVal
        TargetSocDteDcChargerValue: type=CPP/SignalInfo_UInt16  # VCU_TgSocDteDcChgVal
        USMState: type=CPP/SignalInfo_UInt8  # VCU_BattCondUsmSta
        USMStatus_RestModeFunction: type=CPP/SignalInfo_UInt8  # VCU_UtilModeUsmSta
        V2GModeInfo: type=CPP/SignalInfo_UInt8  # VCMS_V2GMode
        V2LModeInfo: type=CPP/SignalInfo_UInt8  # VCMS_V2LMode
        V2LSOCLowLimmit_FCU: type=CPP/SignalInfo_UInt8  # FCU_V2LSocLoLim
        V2LSOCLowLimmit_HCU: type=CPP/SignalInfo_UInt8  # HCU_V2LSocLoLim
        V2LSocketStatus: type=CPP/SignalInfo_UInt8  # VCMS_V2lSocketState
        VCMSConnectorStatus: type=CPP/SignalInfo_UInt8  # VCMS_PlugConnect
        VCMSConnectorStatus_forGBT: type=CPP/SignalInfo_UInt8  # VCMS_GbtPlugConnect
        VCMSFaultState: type=CPP/SignalInfo_UInt8  # VCMS_Flt
        VCMSPowerDisplay: type=CPP/SignalInfo_Float  # VCMS_PwrDis
        VCMS_InletLockStatus: type=CPP/SignalInfo_UInt8
        VCRMJapenStndChargingRemainTimeValue: type=CPP/SignalInfo_UInt16  # VCRM_JpStndChrgRmnTimeVal
        VCRMSystemFaultState: type=CPP/SignalInfo_UInt8  # VCRM_SysFltSta
        VCRM_BatMonitorFaultcode: type=CPP/SignalInfo_UInt16
        VCRM_DiagGrpVal: type=CPP/SignalInfo_UInt8
        VCRM_MaxBattTempVal: type=CPP/SignalInfo_Int8
        VCRM_MinBattTempVal: type=CPP/SignalInfo_Int8
        VCUClimateOperationState: type=CPP/SignalInfo_UInt8  # VCU_AirconCtrReq
        VCUOffClimate: type=CPP/SignalInfo_UInt8  # VCU_AirconFinishAlmSta
        VCUReadyState: type=CPP/SignalInfo_UInt8  # VCU_RdySta
        VCURemoteClimateVersion: type=CPP/SignalInfo_UInt8  # VCU_RmtClmt_Ver
        VCUscheduledclimateDefrostFlag: type=CPP/SignalInfo_UInt8  # VCU_SchedClimateSet2_DefrostEnSta
        VCUscheduledclimateEnableFlag: type=CPP/SignalInfo_UInt8  # VCU_SchedClimateSet2_EnSta
        VCUscheduledclimateTemperature: type=CPP/SignalInfo_UInt8  # VCU_SchedClimateSet2_TempVal
        WinterModeStatus: type=CPP/SignalInfo_UInt8  # xEV_WinterModeSta
        WirelessChargeRemainedTime: type=CPP/SignalInfo_UInt16  # VCRM_WirelessChrgRmnTimeVal
        XEV_DiagGrpVal: type=CPP/SignalInfo_UInt8  # xEV_DiagGrpVal
    Provisioning: major-version=1, minor-version=1
      namespaces:
        symbol props Vehicle
        symbol props Telemanager
        symbol props Provisioning
      events:
        data ProvisioningTableChanged: type=ProvisioningTableChanged_EventData  # Event occurs when provisioning table changes
        data UpdateToken: type=UpdateToken_EventData
      5 x field, all with has-getter=true, has-notifier=true, has-setter=false:
        InfrastructureEnvironments: type=Environments
        NADID: type=String
        ProvisioningContext: type=CCProvisioningContext
        ProvisioningStatus: type=CCProvisioningStatus
        TeleVIN: type=String  # Get VIN used by the TeleManager, depends on the priority of HU Engineering Mode(1st), VIMD(2nd), TeleManager Cached VIN(3rd).
      methods:
        7 x operation:
          GetAccessToken
            arg issueReq: type=bool, direction=IN
            arg scope: type=AccessTokenScope, direction=IN
            arg requestID: type=String, direction=OUT
          GetIsSHA256KeyGen  # SMS SHA256 지원여부 전달 (use SHA256, if ture)
            arg result: type=CPP/Result, direction=OUT
            arg value: type=bool, direction=OUT
          GetMOFEntryByTableAndKey
            arg tableName: type=String, direction=IN
            arg keyName: type=String, direction=IN
            arg value: type=String, direction=OUT
          GetMOFHostByKey
            arg keyName: type=String, direction=IN
            arg host: type=CPP/CCHost, direction=OUT
          GetMOFKeyListByTable
            arg tableName: type=String, direction=IN
            arg values: type=GetMOFKeyListByTable_values_VECTOR, direction=OUT
          GetMOFTableList
            arg values: type=GetMOFTableList_values_VECTOR, direction=OUT
          GetSVCHUBHostByKey
            arg host: type=CPP/CCHost, direction=OUT
    ProvisioningTable: major-version=2, minor-version=1
      namespaces:
        symbol props CCU
        symbol props Cloud
        symbol props ProvisioningTable
      5 x field, all with has-getter=true, has-notifier=true, has-setter=false:
        CallCenterNumber: type=CPP/KeyValue  # The List of phone numbers the modem accepts for MT Call Simply displays the information that received from HeadUnit. Permitted Key Lists on Provisioning Table AcnOutcallNum DTCOutcallNum InfoOutcallNum
        PrivacyOfflineMode: type=bool  # GDPR privacy mode status
        ProvisioningStatus: type=CPP/ProvisioningStatus  # Last updated service provisioning status from headunit.
        SMSCenterNumber: type=CPP/KeyValue  # The List of phone numbers the modem accepts for MT SMS Simply displays the information that received from HeadUnit. Permitted Key Lists on Provisioning Table SMSSenderNum SMSSenderNum2 SMSSenderNum3 AuthSMSNum
        TimeStamp: type=String  # Indicates the timestamp when the last provisioning information was updated from headunit.
    ProvisioningTable: major-version=3, minor-version=3
      namespaces:
        symbol props Info
        symbol props Cloud
        symbol props ProvisioningTable
      12 x field, all with has-getter=true, has-notifier=true, has-setter=false:
        CCSBrandName: type=CPP/KeyValue  # This field provides the brand name of the connected car service (CCS) in operation. The language of the brand name is specified by the key, and the value is the name of the CCS in that language. This key and its associated value provide information about the language that is the same as the language codes and names that are specified in the protocol.
        CallCenterNumber: type=CPP/KeyValue  # The List of phone numbers the modem accepts for MT Call. Permitted Key Lists on Provisioning Table: -AcnOutcallNum -DTCOutcallNum -InfoOutcallNum
        DataPlanProducts: type=DataPlanProducts_VECTOR  # This field provides information about the data plan add-on products available for connected car services and their subscription status. It will be updated whenever the product list or subscription details of the data plan change. The CCS Server will provide the service code, subscription status, purchase date, and product names. This ServiceFeatures consists of a ServiceCode attribute, which indicates the availability of each item. The list of service features is AUDIO_STANDARD, AUDIO_PREMIUM, VIDEO_PREMIUM, and FEATURE_REARSEAT. If the item is supported, the value will be set to "TRUE", and if not supported, the value will be "FALSE". In the event that the definition of the feature changes in the future, the information in the latest protocol document should be followed. This ProductNames key and its associated value provide information about the language that is the same as the language codes and names that are specified in the protocol. This OptionInfos field is reserved for the protocol scalability in the future.
        Environments: type=CPP/InfrastructureEnvironments  # Indicates the information on the service environment. This field represents the operating environment based on host information in the provisioning table. Therefore, it remains independent of manual selection behavior in engineering mode. When a device is newly provisioned (MO/MT), this field is also updated with the latest information from the server. If the device is successfully provisioned, the Default value is not available and will be changed to Development/Staging/Production state according to the specification.
        EnvironmentsAddress: type=CPP/KeyValue  # This information represents the basic connection information for connecting connections. Displays the hosts and ports of all hosts in the provisioning table. It has been defined for convenience from the provisioning table. If the table is updated, this information is also updated with re-provisioned information. Permitted Key Lists on Provisioning Table : - CCS.host - CCS.port - [ANY].host - [ANY].port
        OptionInfo: type=CPP/KeyValue  # Indicates items that require optional processing related to vehicle CCS center communication. When the Headunit needs to selectively process items according to platform classification in CCS communication, it refers to this OptionInfo. The provisioning table service stores the key-value sets internally. And stored information is always set in the OptionInfo field. Permitted Key Lists on OptionInfo "PubCert-Support"
        PrivacyOfflineMode: type=bool  # GDPR privacy mode status
        ProvisioningItems: type=ProvisioningItems_VECTOR  # Indicates the array of provisioning items.
        ProvisioningStatus: type=CPP/ProvisioningStatus  # Last updated service provisioning status from headunit.
        SMSCenterNumber: type=CPP/KeyValue  # The List of phone numbers the modem accepts for MT SMS. Permitted Key Lists on Provisioning Table -SMSSenderNum, -AuthSMSNum
        TimeStamp: type=String  # Indicates the timestamp when the last provisioning information was updated from headunit. The format is following to "YYYY/MM/DD HH:MM:SS"
        VoLTEMode: type=bool  # Indicates the state of the VoLTE configuration passed from the provisioning table.
      methods:
        operation GetAllProvisioningTable  # This method should be implemented using SOME/IP-TP. The return result of this method passes the raw value of all provisioning tables in json format.
          arg json: type=String, direction=OUT
        operation SetOptionInfo  # Set the option information related to CCS provisioning and center communication. The input of KeyInfo values listed in the description of Field OptionInfo item is allowed.
          arg KeyInfo: type=String, direction=IN
          arg ValueInfo: type=String, direction=IN
          arg error_of_CommonAPI: type=CPP/SetError, direction=OUT
    RFSManager: major-version=1, minor-version=2
      namespaces:
        symbol props Info
        symbol props Update
        symbol props RFSManager
      field ExtractArchiveResult: type=CPP/KeyValueMap, has-getter=true, has-notifier=true, has-setter=false  # Provides a result of extraction archive status to an external system. The Key-Value table follows the specification for each item. map KeyVale{ String to String } Provides the path and status as below to an external system. "path" : Extract Path "status" : Status of extract "EXTRACTING" : extracting now. "EXTRACT_COMPETE" : extract complete successfully. "EXTRACT_FAILED" : it occur fail during extracting.
      field ServerState: type=String, has-getter=true, has-notifier=true, has-setter=false  # This field contains server state to an external system. "SERVER_RUNNGING" : sshfs is running now. "SERVER_NOT_RUNNING" : sshfs is closed now.
      methods:
        4 x operation:
          ClearResources  # This field contains how to clear resources of the storage. "CLEAR_ALL" : clear all resources for update. "CLEAR_SW_PACKAGE" : clear update packages only. "CLEAR_METADATA" : clear update metadata only.
            arg Mode: type=String, direction=IN
            arg error_of_CommonAPI: type=CPP/SetError, direction=OUT
          ExtractArchive  # If there are multiple archive files, the CCU must request extract sequentially. ExtractArchive() have a path of the archive file. "path" : Archive file path
            arg Path: type=String, direction=IN
            arg error_of_CommonAPI: type=CPP/SetError, direction=OUT
          GetAvailableSpace  # The available size of the RFS storage is returned in bytes.
            arg error_of_CommonAPI: type=CPP/SetError, direction=OUT
            arg sizeInByte: type=int64_t, direction=OUT
          SyncFile  # This field contain the path to sync operation of file system of storage after storing resources. "path" : file path
            arg Path: type=String, direction=IN
            arg error_of_CommonAPI: type=CPP/SetError, direction=OUT
    RemoteFileSystemManager: major-version=1, minor-version=0
      namespaces:
        symbol props Vehicle
        symbol props RFSM
        symbol props RemoteFileSystemManager
      field requestedEcuList: type=RequestedEcuVectorType, has-getter=true, has-notifier=true, has-setter=false  # 마운트 요청한 Ecu 리스트
      methods:
        operation RemoteMount
          arg swUnitName: type=String, direction=IN  # RFS제어기 저장소를 CCU에 마운트 요청하기 위한 method
          arg mountPath: type=String, direction=IN
          arg result: type=RfsmResponseType, direction=OUT
        operation RemoteUnmount
          arg mountPath: type=String, direction=IN  # RFS제어기 저장소를 CCU에 언마운트 요청하기 위한 method
          arg result: type=RfsmResponseType, direction=OUT
        operation VerifyAccessibility
          arg filePath: type=String, direction=IN  # Consumer에서 RFS 제어기 file path 접근 가능한지 확인을 위한 method
          arg result: type=RfsmResponseType, direction=OUT
    ReportSender: major-version=1, minor-version=0
      namespaces:
        symbol props Vehicle
        symbol props CIDS
        symbol props ReportSender
      methods:
        operation SendCidsReport
          arg log: type=CPP/AlertLog, direction=OUT
    ReportSender: major-version=1, minor-version=0
      namespaces:
        symbol props Vehicle
        symbol props EIDS
        symbol props ReportSender
      methods:
        operation SendEidsReport
          arg log: type=CPP/AlertLog, direction=OUT
    Routines: major-version=3, minor-version=0
      namespaces:
        symbol props CCU
        symbol props Mode
        symbol props Routines
      events:
        data NeedToAgree: type=NeedToAgree_EventData  # Request to display popup for user agreement to HU.
        data RequestAction: type=RequestAction_EventData  # Request to execute the HU actions(DisplayPopup, App, Sound, Speaker, DimLight, PassengerTalk, Destination, WiFi).
      field RoutineStatus: type=RoutineStatus, has-getter=true, has-notifier=true, has-setter=false  # Get the Routines status.
      methods:
        9 x operation:
          ActivateRoutine  # Activate/Deactivate for the specific routine.(if routineId is 0, It is for all Routine)
            4 x arg:
              routineOwner: type=String, direction=IN
              routineId: type=uint32_t, direction=IN
              active: type=bool, direction=IN
              error_of_CommonAPI: type=RoutineError, direction=OUT
          DeleteRoutine  # Delete the Routine
            arg routineOwner: type=String, direction=IN
            arg routineId: type=uint32_t, direction=IN
            arg error_of_CommonAPI: type=RoutineError, direction=OUT
          GetRoutine  # Get the Routines configuration from CCU.
            arg routineOwner: type=String, direction=IN
            arg routine: type=Routine, direction=OUT
          SetAgreeResult  # Set the agreement result from HU.
            arg agreeId: type=uint32_t, direction=IN
            arg agreement: type=bool, direction=IN
            arg error_of_CommonAPI: type=RoutineError, direction=OUT
          SetInfoConditionStatus  # Set the conditions status from HU.
            arg routineOwner: type=String, direction=IN
            arg conditionInfo: type=CPP/KeyValueMap, direction=IN
            arg error_of_CommonAPI: type=RoutineError, direction=OUT
          SetRoutine  # Set the Routines configuration(as JSON) from HU/ccRC.
            arg routine: type=Routine, direction=IN
            arg error_of_CommonAPI: type=RoutineError, direction=OUT
          StartRoutine  # Start the specific routine manually from HU/ccRC.
            arg routineOwner: type=String, direction=IN
            arg routineId: type=uint32_t, direction=IN
            arg error_of_CommonAPI: type=RoutineError, direction=OUT
          StopRoutine  # Stop the specific routine manually from HU/ccRC.
            arg routineOwner: type=String, direction=IN
            arg routineId: type=uint32_t, direction=IN
            arg error_of_CommonAPI: type=RoutineError, direction=OUT
          UpdateRoutine  # Add/Update the Routine configuration (for one routine)
            arg routine: type=Routine, direction=IN
            arg error_of_CommonAPI: type=RoutineError, direction=OUT
    RoutingDiag: major-version=1, minor-version=1
      namespaces:
        symbol props Vehicle
        symbol props DiagMgr
        symbol props RoutingDiag
      events:
        data DiagResponseUpdated: type=DiagResponseUpdated_EventData
      field ActiveDiagHandles: type=DiagHandleStatus, has-getter=true, has-notifier=true, has-setter=false
      methods:
        9 x operation:
          AcquireDiagHandle
            arg diagClientID: type=String, direction=IN
            arg diagTargetID: type=uint32_t, direction=IN
            arg result: type=DiagResultType, direction=OUT
          AcquireDiagPrivilege
            arg diagClientID: type=String, direction=IN
            arg result: type=DiagResultType, direction=OUT
          BroadcastDiag
            arg diagClientID: type=String, direction=IN
            arg requestData: type=ByteArray, direction=IN
            arg result: type=DiagResultType, direction=OUT
          MultiDiagPrivilege  # EDT/ERT + 내부 Client 동시 권한을 지원하기 위한 API acquire : True : 권한 획득 False : 권한 해제 현재 지원 동시 권한 : EDT + IVPA
            arg diagClientID: type=String, direction=IN
            arg acquire: type=bool, direction=IN
            arg result: type=DiagResultType, direction=OUT
          ReleaseDiagHandle
            arg diagClientID: type=String, direction=IN
            arg diagTargetID: type=uint32_t, direction=IN
            arg result: type=DiagResultType, direction=OUT
          ReleaseDiagPrivilege
            arg diagClientsID: type=String, direction=IN
            arg result: type=DiagResultType, direction=OUT
          RequestDiag  # Request Diag to other ECU using the estasblished session handle. Apply greater value between RequestDiag::STmin and Response MSG FlowControl::STmin. App can set a timeout time by timeout parameter, unit is ms, temporary minimum time is 300ms (ex, 10ms : 0x0A) If timeout set to less than 300ms, it is set to 300ms. Default timeout is 2000ms, timeout = 0 set to the default time.
            7 x arg:
              diagClientID: type=String, direction=IN
              diagTargetID: type=uint32_t, direction=IN
              requestData: type=ByteArray, direction=IN
              payloadType: type=PayloadType, direction=IN
              stmin: type=uint8_t, direction=IN
              timeout: type=uint16_t, direction=IN  # min : 300ms
              result: type=DiagResultType, direction=OUT
          SetFileOrDirInfo
            arg filePath: type=String, direction=IN
            arg maxBlockLength: type=ByteArray, direction=IN
            arg result: type=bool, direction=OUT
          SetSWPackageFilePath
            arg writeFilePath: type=String, direction=IN
            arg result: type=bool, direction=OUT
    RoutingIPC: major-version=3, minor-version=0
      namespaces:
        symbol props Vehicle
        symbol props IPCHandler
        symbol props RoutingIPC
      events:
        6 x data:
          EventMcuLogData: type=EventMcuLogData_EventData
          EventNSDResetData: type=EventNSDResetData_EventData
          EventNonSleepEcuIdx: type=EventNonSleepEcuIdx_EventData
          EventPbsFirstWk: type=EventPbsFirstWk_EventData  # PBS 모드 에서 각 채널별 T_WaitBusSleep 시간동안 머무는 동안 최초 Wakeup 제어기 발생시 NSD 로 Trigger 신호 전달 0x0 : Default 0x1 : B1 채널 0x2 : B2 채널 0x3 : M 채널 0x4 : P1 채널 0x5 : P2 채널 0x6 : C 채널 0x7 : E 채널 0x8 : I 채널
          PeriodicSystemInfo: type=PeriodicSystemInfo_EventData
          PeriodicSystemInfoAdditional: type=PeriodicSystemInfoAdditional_EventData  # MCU -> AP 전달되는 시스템 정보 중 Periodic 또는 Periodic & Event 타입 데이터 전달을 위한 api / 하위호환 유지를 위한 Additional IF Byte #0 : MCU CPU Load (%) Byte #1 : LLCE Core Load PPE TX (%) Byte #2 : LLCE Core Load PPE RX (%) Byte #3 : LLCE Core Load DTE (%) Byte #4 : LLCE Core Load FRPE (%)
      field EventSystemInfo: type=EventSysInfo, has-getter=true, has-notifier=true, has-setter=false
      field EventSystemInfoAdditional: type=ByteArray, has-getter=true, has-notifier=true, has-setter=false  # MCU -> AP 전달되는 시스템 정보 중 Event 타입 데이터 전달을 위한 api / 하위호환 유지를 위한 Additional IF Byte #0 : NM_STATUS_B1 Byte #1 : NM_STATUS_B2 Byte #2 : NM_STATUS_M Byte #3 : NM_STATUS_P1 Byte #4 : NM_STATUS_P2 Byte #5 : NM_STATUS_C Byte #6 : NM_STATUS_E Byte #7 : NM_STATUS_I Byte #8 : NM_STATUS_ETH Byte #9 : REMOTE_WU_B1 Byte #10 : REMOTE_WU_B2 Byte #11 : REMOTE_WU_M Byte #12 : REMOTE_WU_P1 Byte #13 : REMOTE_WU_P2 Byte #14 : REMOTE_WU_C Byte #15 : REMOTE_WU_E Byte #16 : REMOTE_WU_I Byte #17 : REMOTE_WU_ETH Byte #18 : PNC Activated Event Byte #19 : CAN Bus Byte #20 : INH_B1 Byte #21 : INH_B2 Byte #22 : INH_M Byte #23 : INH_D NM_STATUS Value: 0:Default 1:NM_RMS_BSM 2:NM_RMS_PBSM 3:RESERVED 4:NM_NS_RMS 5~0x7:RESERVED 8:NM_NS_RSS 9~15:RESERVED 16:NM_RMS_RSS 17~31:RESERVED 32:NM_RMS_NS 33~255:RESERVED REMOTE_WU Value : 0: Not Received 1: Received PNC Activated Event, CAN Bus INH Value : 0: Low 1: High
      field TwaitBusSleepTime: type=uint32_t, has-getter=true, has-notifier=false, has-setter=true  # ASM이 EngineeringMode를 통해 NVM의 TwaitBusSleepTime를 Read/Write 대응하는 I/F
      methods:
        24 x operation:
          ASMInfoRequest  # ASM -> TM 시간 정보 전달 요청 전송
          GetOneTimeSystemInfo  # MCU -> AP 전달되는 시스템 정보 중 1회만 전달하면 되는 데이터 전달을 위한 api
            arg info: type=OneTimeSysInfo, direction=OUT
          GetOneTimeSystemInfoAdditional  # MCU -> AP 전달되는 시스템 정보 중 1회만 전달하면 되는 데이터 전달을 위한 api / 하위호환 유지를 위한 Additional IF Byte #0 : UInt8 evPowerType Byte #1~#3 : String GENERAL_VEHICLE_CODE Byte #4~#5 : String GENERAL_VEHICLE_YEAR Byte #6 : UInt8 TM_SOURCETIME_VALIDITY
            arg sysInfo: type=ByteArray, direction=OUT
          GetRdbCheckValue  # provide RDB table value to check each channel rdb receving info for Non Sleep Detection
            arg rdbTable: type=uint16_t, direction=OUT
          GetRtcWakeupTimer  # get the Timer value for presetTimer and currentCountTimer.
            arg timer: type=CPP/Timer, direction=IN
            arg err: type=uint8_t, direction=OUT
          GetSelfNmlData  # MCU->AP 로 CCU NML 데이터를 전달하기 위한 API
            arg selfNmlData: type=ByteArray, direction=OUT
          OutputControlRequest  # ASM -> IOM 출력 제어 요청 전달을 위한 api
            arg out: type=CPP/WireOutput, direction=IN
          RestorePnInfoMcu  # Update Master should call this method after finishing OTA. (Using the trigger, NCM in Mcu should restore pnc from PNC_NVM_FOR_UPDATE to AP PNC by Peridic Event)
          SetAPSystemInfo  # ASM -> MCU 전달되는 시스템 정보
            arg info: type=APSysInfo, direction=IN
          SetApEthNetworkInfo  # provide Ethernet network status info from SM to PM
            arg ethStatus: type=ApEthNetStatus, direction=IN
          SetDcuSystemTime  # AP -> MCU 로 DCU 시간 정보를 전달하기위한 api
            arg dcuTime: type=DcuSystemTime, direction=IN
          SetInfoSystemTime  # AP -> MCU 로 Info(GNSS) 시간 정보를 전달하기위한 api
            arg infoTimeStatus: type=InfoSystemTimeStatus, direction=IN
          SetNsdEventInfo  # AP -> MCU 전달되는 NSD 관련 Event 정보
            arg info: type=NsdEventInfo, direction=IN
          SetOTAInfo  # ASM -> MCU 전달되는 OTA 관련 설정 정보
            arg info: type=OTAInfo, direction=IN
          SetOneTimeSystemInfo  # AP -> MCU 전달되는 시스템 정보 중 1회만 전달하면 되는 데이터 전달을 위한 api
            arg info: type=OneTimeSysInfo, direction=IN
          SetOneTimeSystemInfoAdditional  # AP -> MCU 전달되는 시스템 정보 중 1회만 전달하면 되는 데이터 전달을 위한 api (부팅시) / 하위호환 유지를 위한 Additional IF Byte #0 : UInt8 evPowerType Byte #1~#3 : String GENERAL_VEHICLE_CODE Byte #4~#5 : String GENERAL_VEHICLE_YEAR Byte #6 : UInt8 TM_SOURCETIME_VALIDITY
            arg sysInfo: type=ByteArray, direction=IN
          SetPartialNetworkInfo  # ASM -> MCU 전달되는 Partial Network 관련 설정 정보
            arg pnMap: type=SetPartialNetworkInfo_pnMap_VECTOR, direction=IN
          SetRtcWakeupTimer  # set the timer by second and enable rtc wakeup function.
            arg presetTimerSec: type=uint64_t, direction=IN
            arg err: type=uint8_t, direction=OUT
          SetTempMonitorInfo  # 각 소자별 온도 값을 MCU로 1s 주기로 전달한다.
            arg tempInfo: type=TempMonitorInfo, direction=IN
          StopRtcWakeupTimer  # stop rtc wakeup timer
            arg err: type=uint8_t, direction=OUT
          SystemControlResponse  # SM -> PM 제어 시그널 전달을 위한 api
            arg response: type=SysCtrlResp, direction=IN
          TriggerApHeartbeat: fire-and-forget=true  # IPC → PM으로 AP_HEARTBEAT 송신
          TriggerSelfUpdateHeartbeat: fire-and-forget=true  # IPC → PM으로 SELF_UPDATE_HEARTBEAT 송신
          Update_IVP_Info  # IVP 완료 되어 SecOC key update 되었음을 MCU에 전달. IVP success(info1), fail(info2) event 개수를 MCU에 전달
            4 x arg:
              infoType: type=IVPInfoType, direction=IN
              info1: type=uint8_t, direction=IN
              info2: type=uint8_t, direction=IN
              error: type=IVPErrorType, direction=OUT
    RoutingTP: major-version=1, minor-version=0
      namespaces:
        symbol props Vehicle
        symbol props DiagMgr
        symbol props RoutingTP
      events:
        data TP_IAU_CCU: type=TP_IAU_CCU_EventData
      methods:
        operation TP_CCU_IAU
          arg tpMessage: type=ByteArray, direction=IN
          arg result: type=TPResultType, direction=OUT
    S2S: major-version=3, minor-version=9
      namespaces:
        symbol props CCU
        symbol props Vehicle
        symbol props S2S
      events:
        8 x data:
          SendBatCellInfo: type=SendBatCellInfo_EventData  # This event sends the battInfo for NemsData. The battinfo will be Voltage or Temperature of battCells according to the value of signal(NEV_BMS_GROUPSEL). CCU can get 26signals of battInfo and 2signals(NEV_BMS_GroupSel, NEV_BMS_StartNo) in 50ms, also collect these signals for 1 sec. Then CCU sends it to DCU every 1 sec. P Period : 1 second
          SendBatWarnData: type=SendBatWarnData_EventData  # This is a battery warning data for battery auto cut signal forwarding. P Period : 1 Second
          SendCommonData: type=SendCommonData_EventData  # This is the CommonData for both eCall and NEMS needed. Clu_xxxx data should be sent as the same value with the final data from CAN. PropulsionStorage data should be sent after CCU determine the propulsion type of the car. This event is included in both Eventgroup#1 and Eventgroup#2. Array data type payload is applied on event to send/receive different EthCC signals at the same time. P Period : 1 Second
          SendECallData: type=SendECallData_EventData  # This is the ECallData for eCall signal forwarding. Array data type payload is applied on event to send/receive different CAN(EthCC) signals at the same time. When a specific signal is not transmitted, the CCU fills the value with AtStartValue(0) and transmits it to the DCU. CCU transmits either signal such as below; The old signal list of seatbltValue : Warn_DrvStBltSwSta, Warn_AsstStBltSwSta, Warn_RrCtrStBltSwSta, Warn_RrLftStBltSwSta, Warn_RrRtStBltSwSta, C_3rdRCSeatBeltSW, C_3rdRLSeatBeltSW, C_3rdRRSeatBeltSW The Meaning of seatbltValue:0(unbelted), 1(belted), the other number like -1,2,3,4...(invalid) PE Period : 1 Second The new signal list of seatbltValue : SeatBeltSwSta_Drv, SeatBeltSwSta_1stCtr, SeatBeltSwSta_Asst, SeatBeltSwSta_2ndLft, SeatBeltSwSta_2ndCtr, SeatBeltSwSta_2ndRt, SeatBeltSwSta_3rdLft, SeatBeltSwSta_3rdCtr, SeatBeltSwSta_3rdRt,SeatBeltSwSta_4thLft,SeatBeltSwSta_4thCtr,SeatBeltSwSta_4thRt The Meaning of seatbltValue:0(unbelted), 1(belted), 2(not supported),3(virgin mode). the other number like -1,...(invalid) PE Period : 1 Second
          SendECallData_RealTime: type=SendECallData_RealTime_EventData  # This is the ECallData for eCall signal forwarding. Array data type payload is applied on event to send/receive different CAN(EthCC) signals at the same time. CCU relays each item in real time to DCU. ※ Acu_Dtc, Acu_FltStat, Acu_NumOfFlt signals are sent depending on whether ACU_03 message is received. Mapping information when ACU_03 message is received : ISCM_DiagTrblCodVal_3Byte, ISCM_ActvFltSta, ISCM_FltNumVal Mapping information when ACU_03 message is not received : ACU_DiagTrblCodVal, ACU_ActvFltSta, ACU_FltNumVal
          SendFCData: type=SendFCData_EventData  # P Period : 1 Second → Last Value? ? Array data type payload is applied on event to send/receive different CAN(EthCC) signals at the same time.? ? This value is sent every 1 second.? ?Each value should be sent as the last value. Initial value is 0xFFFFFFFF. ? ?Struct NemsFCSignal { NemsFCSignal_toIP SignalItem Uint32 SignalValue } ?enumeration NemsFCSignal_toIP { FSVM_VltSum FCU_FcCur FCU_AvgFuelEcoVal FCU_FcInClntTmp FCU_FcOutClntTmp HMU1_TnkTmp1 HMU1_TnkTmp2 HMU1_TnkTmp3 FCU_FpsH2Cnc FCU_FcH2Cnc HMU1_H2Sns1 HMU1_HighPrs BHDC_Ctrb }
          SendIdcCurrentData: type=SendIdcCurrentData_EventData  # P Period : 1 Second → Last Value Array data type payload is applied on event to send/receive different CAN(EthCC) signals at the same time. This value is sent every 1 second. Each value should be sent as the last value. SendIdcCurrentData transmit only when the value of VariationInfo is applicable. VariationInfo::ECALL - Not Applicable VariationInfo::NEMS - Applicable VariationInfo::ECALL_NEMS - Applicable If the SendIdcCurrentData is not initially received, the initial value is skipped. Struct NemsIdcCurrent { NemsIdcCurrent_toIP SignalItem Unit32 SignalValue } enumeration NemsIdcCurrent_toIP { MCU_Mg1IdcCurrent MCU_Mg2IdcCurrent }
          SendNemsData: type=SendNemsData_EventData  # Array data type payload is applied on event to send/receive different CAN(EthCC) signals at the same time. This value is sent every 1 second. Each value should be sent as the last value. P Period : 1 Second → Last Value
      methods:
        6 x operation:
          GetACNSignallist  # When a specific signal is not transmitted, the CCU fills the value with 0xFFFFFFFF and transmits it to the DCU.
            arg dataList: type=GetACNSignallist_dataList_VECTOR, direction=OUT
          GetBattNumInfo  # When a specific signal is not transmitted, the CCU fills the value with 0xFFFF and transmits it to the DCU.
            arg dataList: type=GetBattNumInfo_dataList_VECTOR, direction=OUT
          GetEngineStatusInfo  # This is Engine status signals forwarding. When a specific signal is not transmitted, the CCU fills the value with 0xFFFFFFFFFFFFFFFF and transmits it to the DCU.
            arg ENG_EngSta: type=uint64_t, direction=OUT
            arg HCU_HevRdySta: type=uint64_t, direction=OUT
            arg VCU_EvDrvRdySta: type=uint64_t, direction=OUT
          GetPropulsionStorage  # Indicates the PropulsionStorage of the car. Depending on the vehicle type, the output parameter is filled or not. ex) Gasoline/Diesel/LPG/Other/Unused: input engtyp2 signal and the rest of can(hcu,bms,vcu,fcu) are set to NULL. other vehicles like EV: Depending on the vehicle type, the specific can message including singal is filled and the rest of output value are set to NULL. And if an engtyp2 singal is not received, the CCU sends a 0xE(not used) value to the DCU
            5 x arg, all with direction=OUT:
              engtyp2: type=uint64_t
              hcu: type=GetPropulsionStorage_hcu_VECTOR
              bms: type=GetPropulsionStorage_bms_VECTOR
              vcu: type=GetPropulsionStorage_vcu_VECTOR
              fcu: type=GetPropulsionStorage_fcu_VECTOR
          GetPropulsionStorage_HEV  # Indicates the PropulsionStorage of the HEV car. In the case of a HEV vehicle, the HEV_EngTyp2 signal in the EMS_08_100ms MSG is transmitted. If HEV_EngTyp2 signal is not received, the CCU sends a 0xE(Not used) value to the DCU.
            arg hev_EngTyp2: type=uint64_t, direction=OUT
          SetVehicleSignal  # This method is defined to forwarding the DCU's CAN(EthCC) signal to the CCU. Value Tables of DCU_eCall Signal 0x00: No Action 0x01: eCall Mode 0x02: eCall Termination 0x03: Test Mode 0x04: Manual eCall Mode 0x05: Reserved 0x06: Reserved 0x07: Invalid
            arg signalID: type=Signal_toCAN, direction=IN
            arg valueinfo: type=uint32_t, direction=IN
    SafeStatusManagement: major-version=1, minor-version=0
      namespaces:
        symbol props Vehicle
        symbol props VSM
        symbol props SafeStatusManagement
      methods:
        operation CheckSafetyStatus
          arg safetyPolicy: type=SafetyPolicyType, direction=IN
          arg safetyResult: type=SafetyResultType, direction=OUT
          arg error: type=VSMErrorDomain, direction=OUT
    Screen: major-version=1, minor-version=4
      namespaces:
        symbol props CCU
        symbol props FoD
        symbol props Screen
      6 x field, all with has-getter=true, has-notifier=true:
        FoDExecutionProgress: type=uint8_t, has-setter=false  # [Deprecated] 추후 ProgressBar 적용 필요 시 사용 A gauge value to display progress bar when executing FoD. Possible values: 0 ~ 100
        FoDMenu: type=FoDMenu_VECTOR, has-setter=false  # [Deprecated] FOD-A 시나리오 (H/U 에서 직접 취득) It has the purpose of displaying the screen for FoD products with a history of execution in the vehicle. Permitted Key Lists on FoDMenu "FodItemName": FoD Item Name "FodPackagesType": Package Type "PreEndYear": Preview Ending Year (Year) - YYYY (1900~2100) / Optional "PreEndMonth": Preview Ending Year (Month) - MM (01~12) / Optional "PreEndDay": Preview Ending Year (Day) - DD (01~31) / Optional "SubscribeType": Subscribe Type / Optional "URL": URL link for detail information / Optional
        FoDPackage: type=FoDPackage_VECTOR, has-setter=false  # This information has the purpose of being displayed on the screen during the FoD execution process in the vehicle. It contains package information about purchased products. Permitted Key Lists on FoDPackage. "FodItemID": FoD Item ID "FodItemName": FoD Item Name "FodPackagesType": Package Type "PreStartYear": Preview Starting Date (Year) - YYYY (1900~2100) / Optional "PreStartMonth": Preview Starting Date (Month) - MM (01~12) / Optional "PreStartDay": Preview Starting Date (Day) - DD (01~31) / Optional "PreEndYear": Preview Ending Year (Year) - YYYY (1900~2100) / Optional "PreEndMonth": Preview Ending Year (Month) - MM (01~12) / Optional "PreEndDay": Preview Ending Year (Day) - DD (01~31) / Optional "PreRemainingDay": Preview Remaining Day (Day) - DD (00 ~ 99) / Optional “TutorialURL”: Tutorial URL ”ServiceCenterURL”: Service Center URL “ExecuteResult”: Execution Success, Failure Information / Optional “FoDUIReadyRequest”: FoD UI Ready Request [Deprecated] “FoDExcutionProgress”: FoD Execution rate for Progress bar
        FoDUIReadyRequest: type=uint8_t, has-setter=false  # [Deprecated] FoDPackage내 Key/Value 사용 Information to request HU to maintain screen even after IG is off. Possible Values 0: Off(Not maintain screen after IG is off) 1: On(Maintain screen after IG is off)
        IndexID: type=uint16_t, has-setter=false  # Identifier for FoD screens that displayed during the FoD execution process.
        UnrecognizedRejectReason: type=String, has-setter=true  # Indicates detailed reason for UnrecognizedReject by HU internal logic. Format : "001", "002", ~ "999" //001 : Valet mode //002 : Force Update //003 : AVNT OTA //004 : Power State Change (ACC ON, IGN ON) //005 : ADM logic off //006 : Screen Transition
      methods:
        operation SetFoDPackage  # Set FoDPackage.
          arg FoDPackages: type=SetFoDPackage_FoDPackages_VECTOR, direction=IN
          arg error_of_CommonAPI: type=CPP/SetError, direction=OUT
        operation SetIndexID  # Set IndexID.
          arg IndexID: type=uint16_t, direction=IN
          arg error_of_CommonAPI: type=CPP/SetError, direction=OUT
        operation SetUnrecognizedRejectReason  # Set UnrecognizedRejectReason.
          arg reason: type=String, direction=IN
          arg error_of_CommonAPI: type=CPP/SetError, direction=OUT
    Screen: major-version=1, minor-version=4
      namespaces:
        symbol props CCU
        symbol props Update
        symbol props Screen
      8 x field, all with has-getter=true, has-notifier=true:
        AVNVersion: type=String, has-setter=false  # Indicates the vehicle OTA HMI scenario version that applied to the AVN(Headunit).
        CCUVersion: type=String, has-setter=false  # Indicates the vehicle OTA service scenario version that applied to the CCU(Gateway).
        IndexID: type=uint16_t, has-setter=false
        InitialControllerCheckStatus: type=String, has-setter=false  # [DEPRECATED] The status of checking neighbor controller's version at the CCU initial boot time (3 min) The value is of the following format and is an uppercase string "INITIAL" "CHECKING" "DONE"
        OTAResource: type=OTAResource, has-setter=false
        OTAStatus: type=OTAStatus, has-setter=false
        UnrecognizedRejectReason: type=String, has-setter=true  # Indicates detailed reason for UnrecognizedReject by HU internal logic. Format : "001", "002", ~ "999" //001 : Valet mode //002 : Force Update //003 : AVNT OTA //004 : Power State Change (ACC ON, IGN ON) //005 : ADM logic off //006 : Screen Transition
        UpdateCheckResult: type=String, has-setter=false  # Result of the RequestUpdateCheck indicates the value of the latest update information for CCU. The value is of the following format and is an uppercase string. ease refer to the code in the specification for details. Format : "C1" ~ "C6"
      methods:
        operation RequestUpdateCheck  # Request to check if there is any latest update information for CCU. It returns OK/NOK results for metod request. ?Return value : OK, NOK
          arg error_of_CommonAPI: type=CPP/SetError, direction=OUT
          arg UpdateCheckInfo: type=String, direction=OUT
        operation SetAVNVersion  # Report the vehicle OTA HMI scenario version that applied to the AVN(Headunit).
          arg avnVersion: type=String, direction=IN
          arg error_of_CommonAPI: type=CPP/SetError, direction=OUT
    SecureFlash2: major-version=1, minor-version=0
      namespaces:
        symbol props Vehicle
        symbol props Security
        symbol props SecureFlash2
      methods:
        11 x operation:
          Decrypt_Buf
            5 x arg:
              len: type=uint32_t, direction=IN
              inText: type=ByteArray, direction=IN
              SessionHandle: type=uint64_t, direction=IN
              err: type=SF20ERR, direction=OUT
              outText: type=ByteArray, direction=OUT
          Decrypt_File
            4 x arg:
              inFIleName: type=String, direction=IN
              outFIleName: type=String, direction=IN
              SessionHandle: type=uint64_t, direction=IN
              err: type=SF20ERR, direction=OUT
          FinishDecrypt
            arg SessionHandle: type=uint64_t, direction=IN
            arg err: type=SF20ERR, direction=OUT
            arg totalLen: type=uint64_t, direction=OUT
          FinishVerify
            4 x arg:
              sign: type=ByteArray, direction=IN
              SessionHandle: type=uint64_t, direction=IN
              err: type=SF20ERR, direction=OUT
              result: type=uint32_t, direction=OUT
          SF20Version
            arg version: type=uint32_t, direction=OUT
          StartDecrypt
            5 x arg:
              fk_meta: type=ByteArray, direction=IN
              size_fk_meta: type=uint32_t, direction=IN
              en_sha256: type=uint8_t, direction=IN
              SessionHandle: type=uint64_t, direction=IN
              err: type=SF20ERR, direction=OUT
          StartTeeSession
            arg err: type=SF20ERR, direction=OUT
            arg SessionHandle: type=uint64_t, direction=OUT
          TerminateTeeSession
            arg SessionHandle: type=uint64_t, direction=IN
          VerifyStart
            arg en_sha256: type=uint8_t, direction=IN
            arg SessionHandle: type=uint64_t, direction=IN
            arg err: type=SF20ERR, direction=OUT
          VerifyUpdate
            4 x arg:
              len: type=uint32_t, direction=IN
              payload: type=ByteArray, direction=IN
              SessionHandle: type=uint64_t, direction=IN
              err: type=SF20ERR, direction=OUT
          VerifyUpdate_File
            arg inFileName: type=String, direction=IN
            arg SessionHandle: type=uint64_t, direction=IN
            arg err: type=SF20ERR, direction=OUT
    SelfDiagnosis: major-version=1, minor-version=3
      namespaces:
        symbol props Vehicle
        symbol props SDE
        symbol props SelfDiagnosis
      5 x field, all with has-getter=true, has-notifier=true, has-setter=false:
        CureentSDSAuthenticationLevel: type=CPP/CertRole  # [NE1aW] SDS 인증 대응용 API / Inform when SDS Authentication is changed userRole bitmask: Bit 0: Default/Anybody Bit 1: OEM servicing Bit 2: enhanced Bit 3: operations Bit 4: basic Bit 5: All functional Bit 6: Rollback Bit 7: reserved diagRoutingRole bitmask: Bit 0: Onboard DoIP (SDS) Bit 1: Offboard DoIP (ERT) Bit 2: Diagnostics CAN (EDT) Bit 3: Disable Flooding protection Bit 4: Airbag deployment (CCU 미사용) Bit 5~7: reserved
        CurrentAuthenticationLevel: type=CPP/AuthLevelType
        CurrentCommunicationMode: type=CommunicationState
        CurrentDiagSession: type=CPP/DiagSessionType
        CurrentSecurityLevel: type=CPP/SecurityLevelType
      methods:
        operation ExtendTestPresent
          arg error: type=TPError, direction=OUT
        operation SendDiagResponse
          arg response: type=CPP/DiagResponseType, direction=IN
          arg service: type=DiagServiceType, direction=IN
          arg data: type=ByteArray, direction=IN
        operation SetDTCStatus
          arg dtcCode: type=uint32_t, direction=IN
          arg dtcStatus: type=DTCStatusType, direction=IN
    ServiceGroup: major-version=1, minor-version=1
      namespaces:
        symbol props Vehicle
        symbol props Vcc
        symbol props ServiceGroup
      methods:
        operation RemoveServiceGroupIP
          arg endPointID: type=String, direction=IN
          arg svcGroup: type=CPP/GroupTypes, direction=IN
        operation RequestServiceGroupIP
          arg endPointID: type=String, direction=IN
          arg svcGroup: type=CPP/GroupTypes, direction=IN
          arg svcGroupIP: type=uint32_t, direction=OUT
