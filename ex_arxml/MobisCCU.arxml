[part 9 of 9: package /System/Service/Instance]
AUTOSAR XML (schema 00049)
package /System/Service/Instance
  14 x provided someip service instance, all with sd-server-config=CCU_SDConfig:
    ARA_SM_FunctionGroupState: service-interface-deployment=FunctionGroupState_Someip, service-instance-id=1
      someip provided event group Provided_NewEventGroup: event-group=FunctionGroupState_Someip/NewEventGroup, multicast-threshold=0
    ARA_SM_UpdateRequest: service-interface-deployment=UpdateRequest_Someip, service-instance-id=1
    ARA_UCM_PackageManagement: service-interface-deployment=Deployment/PackageManagement_Someip, service-instance-id=1
      someip provided event group Provided_NewEventGroup: event-group=PackageManagement_Someip/NewEventGroup, multicast-threshold=0
      someip provided event group Provided_NewEventGroup1: event-group=PackageManagement_Someip/NewEventGroup1, multicast-threshold=0
      someip provided event group Provided_NewEventGroup2: event-group=PackageManagement_Someip/NewEventGroup2, multicast-threshold=0
    CCU_Cloud_Communicator: service-interface-deployment=Deployment/Communicator_Someip, service-instance-id=6145
      someip provided event group Provided_SomeIpEventGroups: event-group=Communicator_Someip/SomeIpEventGroups, multicast-threshold=0
    CCU_Cloud_ProvisioningTable: service-interface-deployment=Deployment/ProvisioningTable_Someip, service-instance-id=6145
      someip provided event group Provided_SomeIpEventGroups: event-group=ProvisioningTable_Someip/SomeIpEventGroups, multicast-threshold=0
    CCU_ExternalNetwork_Manager2: service-interface-deployment=Manager2_Someip, service-instance-id=1
      someip provided event group Provided_SomeIpEventGroups: event-group=Manager2_Someip/SomeIpEventGroups, multicast-threshold=0
    CCU_FoD_Screen: service-interface-deployment=Deployment/Screen_Someip, service-instance-id=1
      someip provided event group Provided_SomeIpEventGroups: event-group=Screen_Someip/SomeIpEventGroups, multicast-threshold=0
    CCU_Mode_Routines: service-interface-deployment=Routines_Someip, service-instance-id=1
      someip provided event group Provided_SomeIpEventGroups: event-group=Routines_Someip/SomeIpEventGroups, multicast-threshold=0
    CCU_SharedStorage_Share: service-interface-deployment=Deployment/Share_Someip, service-instance-id=1
      someip provided event group Provided_SomeIpEventGroups: event-group=Share_Someip/SomeIpEventGroups, multicast-threshold=0
    CCU_System_EngineeringMode: service-interface-deployment=Deployment/EngineeringMode_Someip, service-instance-id=1
    CCU_Update_Screen: service-interface-deployment=Deployment/Screen_Someip, service-instance-id=1
      someip provided event group Provided_SomeIpEventGroups: event-group=Screen_Someip/SomeIpEventGroups, multicast-threshold=0
    CCU_Vehicle_DiagnosticRouting: service-interface-deployment=DiagnosticRouting_Someip, service-instance-id=6145
      someip provided event group Provided_SomeIpEventGroups: event-group=DiagnosticRouting_Someip/SomeIpEventGroups, multicast-threshold=0
    CCU_Vehicle_DiagnosticService: service-interface-deployment=DiagnosticService_Someip, service-instance-id=6146
    CCU_Vehicle_S2S: service-interface-deployment=S2S_Someip, service-instance-id=6145
      someip provided event group Provided_SomeIpEventGroups: event-group=S2S_Someip/SomeIpEventGroups, multicast-threshold=0
  360 x required someip service instance:
    R_ARA_SM_FunctionGroupState: service-interface-deployment=FunctionGroupState_Someip, required-service-instance-id=ANY, sd-client-config=R_CCU_SDConfig
      someip required event group Required_NewEventGroup: event-group=FunctionGroupState_Someip/NewEventGroup
    R_ARA_SM_UpdateRequest: service-interface-deployment=UpdateRequest_Someip, required-service-instance-id=ANY, sd-client-config=R_CCU_SDConfig
    R_ARA_UCM_PackageManagement: service-interface-deployment=Deployment/PackageManagement_Someip, required-service-instance-id=ANY, sd-client-config=R_CCU_SDConfig
      someip required event group Required_NewEventGroup: event-group=PackageManagement_Someip/NewEventGroup
      someip required event group Required_NewEventGroup1: event-group=PackageManagement_Someip/NewEventGroup1
      someip required event group Required_NewEventGroup2: event-group=PackageManagement_Someip/NewEventGroup2
    R_ARA_UCM_PackageManagement: service-interface-deployment=Deployment/PackageManagement_Someip, required-service-instance-id=ANY, sd-client-config=R_CCU_SDConfig
      someip required event group Required_NewEventGroup: event-group=PackageManagement_Someip/NewEventGroup
      someip required event group Required_NewEventGroup1: event-group=PackageManagement_Someip/NewEventGroup1
      someip required event group Required_NewEventGroup2: event-group=PackageManagement_Someip/NewEventGroup2
    R_ARA_UCM_PackageManagement: service-interface-deployment=Deployment/PackageManagement_Someip, required-service-instance-id=ANY, sd-client-config=R_CCU_SDConfig
      someip required event group Required_NewEventGroup: event-group=PackageManagement_Someip/NewEventGroup
      someip required event group Required_NewEventGroup1: event-group=PackageManagement_Someip/NewEventGroup1
      someip required event group Required_NewEventGroup2: event-group=PackageManagement_Someip/NewEventGroup2
    R_ARA_UCM_PackageManagement: service-interface-deployment=Deployment/PackageManagement_Someip, required-service-instance-id=ANY, sd-client-config=R_CCU_SDConfig
      someip required event group Required_NewEventGroup: event-group=PackageManagement_Someip/NewEventGroup
      someip required event group Required_NewEventGroup1: event-group=PackageManagement_Someip/NewEventGroup1
      someip required event group Required_NewEventGroup2: event-group=PackageManagement_Someip/NewEventGroup2
    R_BltnCam_DrivingEvent_Manager: service-interface-deployment=Deployment/Manager_Someip, required-service-instance-id=ANY, sd-client-config=R_CCU_SDConfig
      someip required event group Required_SomeIpEventGroups: event-group=Manager_Someip/SomeIpEventGroups
    R_BltnCam_ParkingEvent_Manager: service-interface-deployment=Deployment/Manager_Someip, required-service-instance-id=ANY, sd-client-config=R_CCU_SDConfig
      someip required event group Required_SomeIpEventGroups: event-group=Manager_Someip/SomeIpEventGroups
    R_BltnCam_System_Manager: service-interface-deployment=Deployment/Manager_Someip, required-service-instance-id=ANY, sd-client-config=R_CCU_SDConfig
      someip required event group Required_SomeIpEventGroups: event-group=Manager_Someip/SomeIpEventGroups
      someip required event group Required_SomeIpEventGroups2: event-group=Manager_Someip/SomeIpEventGroups2
    R_CCU_Cloud_Communicator: service-interface-deployment=Deployment/Communicator_Someip, required-service-instance-id=ANY, sd-client-config=R_CCU_SDConfig
      someip required event group Required_SomeIpEventGroups: event-group=Communicator_Someip/SomeIpEventGroups
    R_CCU_Cloud_Communicator: service-interface-deployment=Deployment/Communicator_Someip, required-service-instance-id=ANY, sd-client-config=R_CCU_SDConfig
      someip required event group Required_SomeIpEventGroups: event-group=Communicator_Someip/SomeIpEventGroups
    R_CCU_Cloud_Communicator: service-interface-deployment=Deployment/Communicator_Someip, required-service-instance-id=ANY, sd-client-config=R_CCU_SDConfig
      someip required event group Required_SomeIpEventGroups: event-group=Communicator_Someip/SomeIpEventGroups
    R_CCU_Cloud_Communicator: service-interface-deployment=Deployment/Communicator_Someip, required-service-instance-id=ANY, sd-client-config=R_CCU_SDConfig
      someip required event group Required_SomeIpEventGroups: event-group=Communicator_Someip/SomeIpEventGroups
    R_CCU_Cloud_Communicator: service-interface-deployment=Deployment/Communicator_Someip, required-service-instance-id=ANY, sd-client-config=R_CCU_SDConfig
      someip required event group Required_SomeIpEventGroups: event-group=Communicator_Someip/SomeIpEventGroups
    R_CCU_Vehicle_DiagnosticService: service-interface-deployment=DiagnosticService_Someip, required-service-instance-id=ANY, sd-client-config=R_CCU_SDConfig
    R_CCU_Vehicle_DiagnosticService: service-interface-deployment=DiagnosticService_Someip, required-service-instance-id=ANY, sd-client-config=R_CCU_SDConfig
    R_CCU_Vehicle_DiagnosticService: service-interface-deployment=DiagnosticService_Someip, required-service-instance-id=ANY, sd-client-config=R_CCU_SDConfig
    R_CCU_Vehicle_DiagnosticService: service-interface-deployment=DiagnosticService_Someip, required-service-instance-id=ANY, sd-client-config=R_CCU_SDConfig
    R_CCU_Vehicle_DiagnosticService: service-interface-deployment=DiagnosticService_Someip, required-service-instance-id=ANY, sd-client-config=R_CCU_SDConfig
    R_CCU_Vehicle_DiagnosticService: service-interface-deployment=DiagnosticService_Someip, required-service-instance-id=ANY, sd-client-config=R_CCU_SDConfig
    R_DCU_System_PowerManagement: service-interface-deployment=PowerManagement_Someip, required-service-instance-id=ANY, sd-client-config=R_CCU_SDConfig
      someip required event group Required_SomeIpEventGroups: event-group=PowerManagement_Someip/SomeIpEventGroups
    R_DCU_System_Time: service-interface-deployment=Deployment/Time_Someip, required-service-instance-id=ANY, sd-client-config=R_CCU_SDConfig
      someip required event group Required_SomeIpEventGroups: event-group=Time_Someip/SomeIpEventGroups
    R_DCU_System_Variation: service-interface-deployment=Variation_Someip, required-service-instance-id=ANY, sd-client-config=R_CCU_SDConfig
    R_DCU_Telephony_ConnectionContext: service-interface-deployment=ConnectionContext_Someip, required-service-instance-id=6145, sd-client-config=R_CCU_SDConfig
      someip required event group Required_SomeIpEventGroups: event-group=ConnectionContext_Someip/SomeIpEventGroups
    R_DCU_Telephony_ConnectionContext_1: service-interface-deployment=ConnectionContext_Someip, required-service-instance-id=6146, sd-client-config=R_CCU_SDConfig
      someip required event group Required_SomeIpEventGroups: event-group=ConnectionContext_Someip/SomeIpEventGroups
    R_DCU_Telephony_ConnectionContext_2: service-interface-deployment=ConnectionContext_Someip, required-service-instance-id=6147, sd-client-config=R_CCU_SDConfig
      someip required event group Required_SomeIpEventGroups: event-group=ConnectionContext_Someip/SomeIpEventGroups
    R_DCU_Telephony_ConnectionContext_3: service-interface-deployment=ConnectionContext_Someip, required-service-instance-id=6148, sd-client-config=R_CCU_SDConfig
      someip required event group Required_SomeIpEventGroups: event-group=ConnectionContext_Someip/SomeIpEventGroups
    R_DCU_Telephony_ConnectionManager: service-interface-deployment=ConnectionManager_Someip, required-service-instance-id=ANY, sd-client-config=R_CCU_SDConfig
      someip required event group Required_SomeIpEventGroups: event-group=ConnectionManager_Someip/SomeIpEventGroups
    R_DCU_Telephony_EngineeringMode: service-interface-deployment=Deployment/EngineeringMode_Someip, required-service-instance-id=ANY, sd-client-config=R_CCU_SDConfig
    R_DCU_Telephony_MessageManager: service-interface-deployment=Deployment/MessageManager_Someip, required-service-instance-id=ANY, sd-client-config=R_CCU_SDConfig
      someip required event group Required_SomeIpEventGroups: event-group=MessageManager_Someip/SomeIpEventGroups
    R_DCU_Telephony_ModemManager: service-interface-deployment=Deployment/ModemManager_Someip, required-service-instance-id=ANY, sd-client-config=R_CCU_SDConfig
      someip required event group Required_SomeIpEventGroups: event-group=ModemManager_Someip/SomeIpEventGroups
    R_DCU_Telephony_NetworkInformation: service-interface-deployment=NetworkInformation_Someip, required-service-instance-id=ANY, sd-client-config=R_CCU_SDConfig
      someip required event group Required_SomeIpEventGroups: event-group=NetworkInformation_Someip/SomeIpEventGroups
    R_DCU_Telephony_SimManager: service-interface-deployment=Deployment/SimManager_Someip, required-service-instance-id=ANY, sd-client-config=R_CCU_SDConfig
      someip required event group Required_SomeIpEventGroups: event-group=SimManager_Someip/SomeIpEventGroups
    R_DCU_Telephony_VoiceCallManager: service-interface-deployment=VoiceCallManager_Someip, required-service-instance-id=ANY, sd-client-config=R_CCU_SDConfig
      someip required event group Required_SomeIpEventGroups: event-group=VoiceCallManager_Someip/SomeIpEventGroups
    R_Info_Cloud_EngineeringMode: service-interface-deployment=Deployment/EngineeringMode_Someip, required-service-instance-id=ANY, sd-client-config=R_CCU_SDConfig
      someip required event group Required_SomeIpEventGroups: event-group=EngineeringMode_Someip/SomeIpEventGroups
      someip required event group Required_SomeIpEventGroups2: event-group=EngineeringMode_Someip/SomeIpEventGroups2
    R_Info_Cloud_EngineeringMode: service-interface-deployment=Deployment/EngineeringMode_Someip, required-service-instance-id=ANY, sd-client-config=R_CCU_SDConfig
      someip required event group Required_SomeIpEventGroups: event-group=EngineeringMode_Someip/SomeIpEventGroups
      someip required event group Required_SomeIpEventGroups2: event-group=EngineeringMode_Someip/SomeIpEventGroups2
    R_Info_Cloud_ProvisioningTable: service-interface-deployment=Deployment/ProvisioningTable_Someip, required-service-instance-id=ANY, sd-client-config=R_CCU_SDConfig
      someip required event group Required_SomeIpEventGroups: event-group=ProvisioningTable_Someip/SomeIpEventGroups
    R_Info_Cloud_ProvisioningTable: service-interface-deployment=Deployment/ProvisioningTable_Someip, required-service-instance-id=ANY, sd-client-config=R_CCU_SDConfig
      someip required event group Required_SomeIpEventGroups: event-group=ProvisioningTable_Someip/SomeIpEventGroups
    R_Info_Cluster_InformationProvider: service-interface-deployment=InformationProvider_Someip, required-service-instance-id=ANY, sd-client-config=R_CCU_SDConfig
      someip required event group Required_SomeIpEventGroups: event-group=InformationProvider_Someip/SomeIpEventGroups
    R_Info_Location_GNSS: service-interface-deployment=GNSS_Someip, required-service-instance-id=ANY, sd-client-config=R_CCU_SDConfig
      someip required event group Required_SomeIpEventGroups: event-group=GNSS_Someip/SomeIpEventGroups
    R_Info_Location_GNSS: service-interface-deployment=GNSS_Someip, required-service-instance-id=ANY, sd-client-config=R_CCU_SDConfig
      someip required event group Required_SomeIpEventGroups: event-group=GNSS_Someip/SomeIpEventGroups
    R_Info_Location_GNSS: service-interface-deployment=GNSS_Someip, required-service-instance-id=ANY, sd-client-config=R_CCU_SDConfig
      someip required event group Required_SomeIpEventGroups: event-group=GNSS_Someip/SomeIpEventGroups
    R_Info_Location_GNSS: service-interface-deployment=GNSS_Someip, required-service-instance-id=ANY, sd-client-config=R_CCU_SDConfig
      someip required event group Required_SomeIpEventGroups: event-group=GNSS_Someip/SomeIpEventGroups
    R_Info_Location_GNSS: service-interface-deployment=GNSS_Someip, required-service-instance-id=ANY, sd-client-config=R_CCU_SDConfig
      someip required event group Required_SomeIpEventGroups: event-group=GNSS_Someip/SomeIpEventGroups
    R_Info_Location_MapMatching: service-interface-deployment=MapMatching_Someip, required-service-instance-id=ANY, sd-client-config=R_CCU_SDConfig
      someip required event group Required_SomeIpEventGroups: event-group=MapMatching_Someip/SomeIpEventGroups
    R_Info_Location_MapMatching: service-interface-deployment=MapMatching_Someip, required-service-instance-id=ANY, sd-client-config=R_CCU_SDConfig
      someip required event group Required_SomeIpEventGroups: event-group=MapMatching_Someip/SomeIpEventGroups
    R_Info_Location_MapMatching: service-interface-deployment=MapMatching_Someip, required-service-instance-id=ANY, sd-client-config=R_CCU_SDConfig
      someip required event group Required_SomeIpEventGroups: event-group=MapMatching_Someip/SomeIpEventGroups
    R_Info_Location_MapMatching: service-interface-deployment=MapMatching_Someip, required-service-instance-id=ANY, sd-client-config=R_CCU_SDConfig
      someip required event group Required_SomeIpEventGroups: event-group=MapMatching_Someip/SomeIpEventGroups
    R_Info_Location_Time: service-interface-deployment=Deployment/Time_Someip, required-service-instance-id=ANY, sd-client-config=R_CCU_SDConfig
      someip required event group Required_SomeIpEventGroups: event-group=Time_Someip/SomeIpEventGroups
    R_Info_Location_Time: service-interface-deployment=Deployment/Time_Someip, required-service-instance-id=ANY, sd-client-config=R_CCU_SDConfig
      someip required event group Required_SomeIpEventGroups: event-group=Time_Someip/SomeIpEventGroups
    R_Info_Location_Time: service-interface-deployment=Deployment/Time_Someip, required-service-instance-id=ANY, sd-client-config=R_CCU_SDConfig
      someip required event group Required_SomeIpEventGroups: event-group=Time_Someip/SomeIpEventGroups
    R_Info_Location_Time: service-interface-deployment=Deployment/Time_Someip, required-service-instance-id=ANY, sd-client-config=R_CCU_SDConfig
      someip required event group Required_SomeIpEventGroups: event-group=Time_Someip/SomeIpEventGroups
    R_Info_Location_Time: service-interface-deployment=Deployment/Time_Someip, required-service-instance-id=ANY, sd-client-config=R_CCU_SDConfig
      someip required event group Required_SomeIpEventGroups: event-group=Time_Someip/SomeIpEventGroups
    R_Info_Setup_GeneralSettings: service-interface-deployment=GeneralSettings_Someip, required-service-instance-id=ANY, sd-client-config=R_CCU_SDConfig
      someip required event group Required_SomeIpEventGroups: event-group=GeneralSettings_Someip/SomeIpEventGroups
    R_Info_Setup_GeneralSettings: service-interface-deployment=GeneralSettings_Someip, required-service-instance-id=ANY, sd-client-config=R_CCU_SDConfig
      someip required event group Required_SomeIpEventGroups: event-group=GeneralSettings_Someip/SomeIpEventGroups
    R_Info_System_EngineeringMode: service-interface-deployment=Deployment/EngineeringMode_Someip, required-service-instance-id=ANY, sd-client-config=R_CCU_SDConfig
      someip required event group Required_SomeIpEventGroups: event-group=EngineeringMode_Someip/SomeIpEventGroups
    R_Info_System_EngineeringMode: service-interface-deployment=Deployment/EngineeringMode_Someip, required-service-instance-id=ANY, sd-client-config=R_CCU_SDConfig
      someip required event group Required_SomeIpEventGroups: event-group=EngineeringMode_Someip/SomeIpEventGroups
    R_Info_System_EngineeringMode: service-interface-deployment=Deployment/EngineeringMode_Someip, required-service-instance-id=ANY, sd-client-config=R_CCU_SDConfig
      someip required event group Required_SomeIpEventGroups: event-group=EngineeringMode_Someip/SomeIpEventGroups
    R_Info_System_Time: service-interface-deployment=Deployment/Time_Someip, required-service-instance-id=ANY, sd-client-config=R_CCU_SDConfig
      someip required event group Required_SomeIpEventGroups: event-group=Time_Someip/SomeIpEventGroups
    R_Info_System_Variant: service-interface-deployment=Variant_Someip, required-service-instance-id=ANY, sd-client-config=R_CCU_SDConfig
      someip required event group Required_SomeIpEventGroups: event-group=Variant_Someip/SomeIpEventGroups
    R_Info_Update_InteractionManager: service-interface-deployment=InteractionManager_Someip, required-service-instance-id=ANY, sd-client-config=R_CCU_SDConfig
      someip required event group Required_SomeIpEventGroups: event-group=InteractionManager_Someip/SomeIpEventGroups
    R_Info_Update_InteractionManager: service-interface-deployment=InteractionManager_Someip, required-service-instance-id=ANY, sd-client-config=R_CCU_SDConfig
      someip required event group Required_SomeIpEventGroups: event-group=InteractionManager_Someip/SomeIpEventGroups
    R_Info_Update_RFSManager: service-interface-deployment=RFSManager_Someip, required-service-instance-id=ANY, sd-client-config=R_CCU_SDConfig
      someip required event group Required_SomeIpEventGroups: event-group=RFSManager_Someip/SomeIpEventGroups
    R_Info_Update_RFSManager: service-interface-deployment=RFSManager_Someip, required-service-instance-id=ANY, sd-client-config=R_CCU_SDConfig
      someip required event group Required_SomeIpEventGroups: event-group=RFSManager_Someip/SomeIpEventGroups
    R_Info_Update_RFSManager: service-interface-deployment=RFSManager_Someip, required-service-instance-id=ANY, sd-client-config=R_CCU_SDConfig
      someip required event group Required_SomeIpEventGroups: event-group=RFSManager_Someip/SomeIpEventGroups
    R_Info_Update_RFSManager: service-interface-deployment=RFSManager_Someip, required-service-instance-id=ANY, sd-client-config=R_CCU_SDConfig
      someip required event group Required_SomeIpEventGroups: event-group=RFSManager_Someip/SomeIpEventGroups
    R_Update_USS_UpdateStandard: service-interface-deployment=UpdateStandard_Someip, required-service-instance-id=ANY, sd-client-config=R_CCU_SDConfig
      4 x someip required event group:
        Required_NewEventGroup: event-group=UpdateStandard_Someip/NewEventGroup
        Required_NewEventGroup1: event-group=UpdateStandard_Someip/NewEventGroup1
        Required_NewEventGroup2: event-group=UpdateStandard_Someip/NewEventGroup2
        Required_NewEventGroup4: event-group=UpdateStandard_Someip/NewEventGroup4
    R_Update_USS_UpdateStandard: service-interface-deployment=UpdateStandard_Someip, required-service-instance-id=ANY, sd-client-config=R_CCU_SDConfig
      4 x someip required event group:
        Required_NewEventGroup: event-group=UpdateStandard_Someip/NewEventGroup
        Required_NewEventGroup1: event-group=UpdateStandard_Someip/NewEventGroup1
        Required_NewEventGroup2: event-group=UpdateStandard_Someip/NewEventGroup2
        Required_NewEventGroup4: event-group=UpdateStandard_Someip/NewEventGroup4
    R_Update_USS_UpdateStandard: service-interface-deployment=UpdateStandard_Someip, required-service-instance-id=ANY, sd-client-config=R_CCU_SDConfig
      4 x someip required event group:
        Required_NewEventGroup: event-group=UpdateStandard_Someip/NewEventGroup
        Required_NewEventGroup1: event-group=UpdateStandard_Someip/NewEventGroup1
        Required_NewEventGroup2: event-group=UpdateStandard_Someip/NewEventGroup2
        Required_NewEventGroup4: event-group=UpdateStandard_Someip/NewEventGroup4
    R_Update_USS_UpdateStandard: service-interface-deployment=UpdateStandard_Someip, required-service-instance-id=ANY, sd-client-config=R_CCU_SDConfig
      4 x someip required event group:
        Required_NewEventGroup: event-group=UpdateStandard_Someip/NewEventGroup
        Required_NewEventGroup1: event-group=UpdateStandard_Someip/NewEventGroup1
        Required_NewEventGroup2: event-group=UpdateStandard_Someip/NewEventGroup2
        Required_NewEventGroup4: event-group=UpdateStandard_Someip/NewEventGroup4
    R_Vehicle_ApSysMgr_BootModeManager: service-interface-deployment=BootModeManager_Someip, required-service-instance-id=ANY, sd-client-config=R_CCU_SDConfig
      someip required event group Required_NewEventGroup: event-group=BootModeManager_Someip/NewEventGroup
    R_Vehicle_ApSysMgr_IOManager: service-interface-deployment=IOManager_Someip, required-service-instance-id=ANY, sd-client-config=R_CCU_SDConfig
      someip required event group Required_NewEventGroup: event-group=IOManager_Someip/NewEventGroup
      someip required event group Required_NewEventGroup1: event-group=IOManager_Someip/NewEventGroup1
    R_Vehicle_ApSysMgr_IOManager: service-interface-deployment=IOManager_Someip, required-service-instance-id=ANY, sd-client-config=R_CCU_SDConfig
      someip required event group Required_NewEventGroup: event-group=IOManager_Someip/NewEventGroup
      someip required event group Required_NewEventGroup1: event-group=IOManager_Someip/NewEventGroup1
    R_Vehicle_ApSysMgr_IOManager: service-interface-deployment=IOManager_Someip, required-service-instance-id=ANY, sd-client-config=R_CCU_SDConfig
      someip required event group Required_NewEventGroup: event-group=IOManager_Someip/NewEventGroup
      someip required event group Required_NewEventGroup1: event-group=IOManager_Someip/NewEventGroup1
    R_Vehicle_ApSysMgr_IOManager: service-interface-deployment=IOManager_Someip, required-service-instance-id=ANY, sd-client-config=R_CCU_SDConfig
      someip required event group Required_NewEventGroup: event-group=IOManager_Someip/NewEventGroup
      someip required event group Required_NewEventGroup1: event-group=IOManager_Someip/NewEventGroup1
    R_Vehicle_ApSysMgr_IOManager: service-interface-deployment=IOManager_Someip, required-service-instance-id=ANY, sd-client-config=R_CCU_SDConfig
      someip required event group Required_NewEventGroup: event-group=IOManager_Someip/NewEventGroup
      someip required event group Required_NewEventGroup1: event-group=IOManager_Someip/NewEventGroup1
    R_Vehicle_ApSysMgr_IOManager: service-interface-deployment=IOManager_Someip, required-service-instance-id=ANY, sd-client-config=R_CCU_SDConfig
      someip required event group Required_NewEventGroup: event-group=IOManager_Someip/NewEventGroup
      someip required event group Required_NewEventGroup1: event-group=IOManager_Someip/NewEventGroup1
    R_Vehicle_ApSysMgr_IOManager: service-interface-deployment=IOManager_Someip, required-service-instance-id=ANY, sd-client-config=R_CCU_SDConfig
      someip required event group Required_NewEventGroup: event-group=IOManager_Someip/NewEventGroup
      someip required event group Required_NewEventGroup1: event-group=IOManager_Someip/NewEventGroup1
    R_Vehicle_ApSysMgr_IOManager: service-interface-deployment=IOManager_Someip, required-service-instance-id=ANY, sd-client-config=R_CCU_SDConfig
      someip required event group Required_NewEventGroup: event-group=IOManager_Someip/NewEventGroup
      someip required event group Required_NewEventGroup1: event-group=IOManager_Someip/NewEventGroup1
    R_Vehicle_ApSysMgr_IOManager: service-interface-deployment=IOManager_Someip, required-service-instance-id=ANY, sd-client-config=R_CCU_SDConfig
      someip required event group Required_NewEventGroup: event-group=IOManager_Someip/NewEventGroup
      someip required event group Required_NewEventGroup1: event-group=IOManager_Someip/NewEventGroup1
    R_Vehicle_ApSysMgr_IOManager: service-interface-deployment=IOManager_Someip, required-service-instance-id=ANY, sd-client-config=R_CCU_SDConfig
      someip required event group Required_NewEventGroup: event-group=IOManager_Someip/NewEventGroup
      someip required event group Required_NewEventGroup1: event-group=IOManager_Someip/NewEventGroup1
    R_Vehicle_ApSysMgr_IOManager: service-interface-deployment=IOManager_Someip, required-service-instance-id=ANY, sd-client-config=R_CCU_SDConfig
      someip required event group Required_NewEventGroup: event-group=IOManager_Someip/NewEventGroup
      someip required event group Required_NewEventGroup1: event-group=IOManager_Someip/NewEventGroup1
    R_Vehicle_ApSysMgr_IOManager: service-interface-deployment=IOManager_Someip, required-service-instance-id=ANY, sd-client-config=R_CCU_SDConfig
      someip required event group Required_NewEventGroup: event-group=IOManager_Someip/NewEventGroup
      someip required event group Required_NewEventGroup1: event-group=IOManager_Someip/NewEventGroup1
    R_Vehicle_ApSysMgr_IOManager: service-interface-deployment=IOManager_Someip, required-service-instance-id=ANY, sd-client-config=R_CCU_SDConfig
      someip required event group Required_NewEventGroup: event-group=IOManager_Someip/NewEventGroup
      someip required event group Required_NewEventGroup1: event-group=IOManager_Someip/NewEventGroup1
    R_Vehicle_ApSysMgr_IOManager: service-interface-deployment=IOManager_Someip, required-service-instance-id=ANY, sd-client-config=R_CCU_SDConfig
      someip required event group Required_NewEventGroup: event-group=IOManager_Someip/NewEventGroup
      someip required event group Required_NewEventGroup1: event-group=IOManager_Someip/NewEventGroup1
    R_Vehicle_ApSysMgr_IOManager: service-interface-deployment=IOManager_Someip, required-service-instance-id=ANY, sd-client-config=R_CCU_SDConfig
      someip required event group Required_NewEventGroup: event-group=IOManager_Someip/NewEventGroup
      someip required event group Required_NewEventGroup1: event-group=IOManager_Someip/NewEventGroup1
    R_Vehicle_ApSysMgr_IOManager: service-interface-deployment=IOManager_Someip, required-service-instance-id=ANY, sd-client-config=R_CCU_SDConfig
      someip required event group Required_NewEventGroup: event-group=IOManager_Someip/NewEventGroup
      someip required event group Required_NewEventGroup1: event-group=IOManager_Someip/NewEventGroup1
    R_Vehicle_ApSysMgr_IOManager: service-interface-deployment=IOManager_Someip, required-service-instance-id=ANY, sd-client-config=R_CCU_SDConfig
      someip required event group Required_NewEventGroup: event-group=IOManager_Someip/NewEventGroup
      someip required event group Required_NewEventGroup1: event-group=IOManager_Someip/NewEventGroup1
    R_Vehicle_ApSysMgr_IOManager: service-interface-deployment=IOManager_Someip, required-service-instance-id=ANY, sd-client-config=R_CCU_SDConfig
      someip required event group Required_NewEventGroup: event-group=IOManager_Someip/NewEventGroup
      someip required event group Required_NewEventGroup1: event-group=IOManager_Someip/NewEventGroup1
    R_Vehicle_ApSysMgr_IOManager: service-interface-deployment=IOManager_Someip, required-service-instance-id=ANY, sd-client-config=R_CCU_SDConfig
      someip required event group Required_NewEventGroup: event-group=IOManager_Someip/NewEventGroup
      someip required event group Required_NewEventGroup1: event-group=IOManager_Someip/NewEventGroup1
    R_Vehicle_ApSysMgr_IOManager: service-interface-deployment=IOManager_Someip, required-service-instance-id=ANY, sd-client-config=R_CCU_SDConfig
      someip required event group Required_NewEventGroup: event-group=IOManager_Someip/NewEventGroup
      someip required event group Required_NewEventGroup1: event-group=IOManager_Someip/NewEventGroup1
    R_Vehicle_ApSysMgr_IOManager: service-interface-deployment=IOManager_Someip, required-service-instance-id=ANY, sd-client-config=R_CCU_SDConfig
      someip required event group Required_NewEventGroup: event-group=IOManager_Someip/NewEventGroup
      someip required event group Required_NewEventGroup1: event-group=IOManager_Someip/NewEventGroup1
    R_Vehicle_ApSysMgr_IOManager: service-interface-deployment=IOManager_Someip, required-service-instance-id=ANY, sd-client-config=R_CCU_SDConfig
      someip required event group Required_NewEventGroup: event-group=IOManager_Someip/NewEventGroup
      someip required event group Required_NewEventGroup1: event-group=IOManager_Someip/NewEventGroup1
    R_Vehicle_ApSysMgr_NetManager: service-interface-deployment=Deployment/NetManager_Someip, required-service-instance-id=ANY, sd-client-config=R_CCU_SDConfig
      6 x someip required event group:
        Required_NewEventGroup: event-group=NetManager_Someip/NewEventGroup
        Required_NewEventGroup{1..5}: event-group=NetManager_Someip/NewEventGroup{1..5}
    R_Vehicle_ApSysMgr_NetManager: service-interface-deployment=Deployment/NetManager_Someip, required-service-instance-id=ANY, sd-client-config=R_CCU_SDConfig
      6 x someip required event group:
        Required_NewEventGroup: event-group=NetManager_Someip/NewEventGroup
        Required_NewEventGroup{1..5}: event-group=NetManager_Someip/NewEventGroup{1..5}
    R_Vehicle_ApSysMgr_NetManager: service-interface-deployment=Deployment/NetManager_Someip, required-service-instance-id=ANY, sd-client-config=R_CCU_SDConfig
      6 x someip required event group:
        Required_NewEventGroup: event-group=NetManager_Someip/NewEventGroup
        Required_NewEventGroup{1..5}: event-group=NetManager_Someip/NewEventGroup{1..5}
    R_Vehicle_ApSysMgr_NetManager: service-interface-deployment=Deployment/NetManager_Someip, required-service-instance-id=ANY, sd-client-config=R_CCU_SDConfig
      6 x someip required event group:
        Required_NewEventGroup: event-group=NetManager_Someip/NewEventGroup
        Required_NewEventGroup{1..5}: event-group=NetManager_Someip/NewEventGroup{1..5}
    R_Vehicle_ApSysMgr_NetManager: service-interface-deployment=Deployment/NetManager_Someip, required-service-instance-id=ANY, sd-client-config=R_CCU_SDConfig
      6 x someip required event group:
        Required_NewEventGroup: event-group=NetManager_Someip/NewEventGroup
        Required_NewEventGroup{1..5}: event-group=NetManager_Someip/NewEventGroup{1..5}
    R_Vehicle_ApSysMgr_NetManager: service-interface-deployment=Deployment/NetManager_Someip, required-service-instance-id=ANY, sd-client-config=R_CCU_SDConfig
      6 x someip required event group:
        Required_NewEventGroup: event-group=NetManager_Someip/NewEventGroup
        Required_NewEventGroup{1..5}: event-group=NetManager_Someip/NewEventGroup{1..5}
    R_Vehicle_ApSysMgr_NetManager: service-interface-deployment=Deployment/NetManager_Someip, required-service-instance-id=ANY, sd-client-config=R_CCU_SDConfig
      6 x someip required event group:
        Required_NewEventGroup: event-group=NetManager_Someip/NewEventGroup
        Required_NewEventGroup{1..5}: event-group=NetManager_Someip/NewEventGroup{1..5}
    R_Vehicle_ApSysMgr_NetManager: service-interface-deployment=Deployment/NetManager_Someip, required-service-instance-id=ANY, sd-client-config=R_CCU_SDConfig
      6 x someip required event group:
        Required_NewEventGroup: event-group=NetManager_Someip/NewEventGroup
        Required_NewEventGroup{1..5}: event-group=NetManager_Someip/NewEventGroup{1..5}
    R_Vehicle_ApSysMgr_NetManager: service-interface-deployment=Deployment/NetManager_Someip, required-service-instance-id=ANY, sd-client-config=R_CCU_SDConfig
      6 x someip required event group:
        Required_NewEventGroup: event-group=NetManager_Someip/NewEventGroup
        Required_NewEventGroup{1..5}: event-group=NetManager_Someip/NewEventGroup{1..5}
    R_Vehicle_ApSysMgr_NetManager: service-interface-deployment=Deployment/NetManager_Someip, required-service-instance-id=ANY, sd-client-config=R_CCU_SDConfig
      6 x someip required event group:
        Required_NewEventGroup: event-group=NetManager_Someip/NewEventGroup
        Required_NewEventGroup{1..5}: event-group=NetManager_Someip/NewEventGroup{1..5}
    R_Vehicle_ApSysMgr_NetManager: service-interface-deployment=Deployment/NetManager_Someip, required-service-instance-id=ANY, sd-client-config=R_CCU_SDConfig
      6 x someip required event group:
        Required_NewEventGroup: event-group=NetManager_Someip/NewEventGroup
        Required_NewEventGroup{1..5}: event-group=NetManager_Someip/NewEventGroup{1..5}
    R_Vehicle_ApSysMgr_NetManager: service-interface-deployment=Deployment/NetManager_Someip, required-service-instance-id=ANY, sd-client-config=R_CCU_SDConfig
      6 x someip required event group:
        Required_NewEventGroup: event-group=NetManager_Someip/NewEventGroup
        Required_NewEventGroup{1..5}: event-group=NetManager_Someip/NewEventGroup{1..5}
    R_Vehicle_ApSysMgr_NetManager: service-interface-deployment=Deployment/NetManager_Someip, required-service-instance-id=ANY, sd-client-config=R_CCU_SDConfig
      6 x someip required event group:
        Required_NewEventGroup: event-group=NetManager_Someip/NewEventGroup
        Required_NewEventGroup{1..5}: event-group=NetManager_Someip/NewEventGroup{1..5}
    R_Vehicle_ApSysMgr_NetManager: service-interface-deployment=Deployment/NetManager_Someip, required-service-instance-id=ANY, sd-client-config=R_CCU_SDConfig
      6 x someip required event group:
        Required_NewEventGroup: event-group=NetManager_Someip/NewEventGroup
        Required_NewEventGroup{1..5}: event-group=NetManager_Someip/NewEventGroup{1..5}
    R_Vehicle_ApSysMgr_NetManager: service-interface-deployment=Deployment/NetManager_Someip, required-service-instance-id=ANY, sd-client-config=R_CCU_SDConfig
      6 x someip required event group:
        Required_NewEventGroup: event-group=NetManager_Someip/NewEventGroup
        Required_NewEventGroup{1..5}: event-group=NetManager_Someip/NewEventGroup{1..5}
    R_Vehicle_ApSysMgr_NetManager: service-interface-deployment=Deployment/NetManager_Someip, required-service-instance-id=ANY, sd-client-config=R_CCU_SDConfig
      6 x someip required event group:
        Required_NewEventGroup: event-group=NetManager_Someip/NewEventGroup
        Required_NewEventGroup{1..5}: event-group=NetManager_Someip/NewEventGroup{1..5}
    R_Vehicle_ApSysMgr_NetManager: service-interface-deployment=Deployment/NetManager_Someip, required-service-instance-id=ANY, sd-client-config=R_CCU_SDConfig
      6 x someip required event group:
        Required_NewEventGroup: event-group=NetManager_Someip/NewEventGroup
        Required_NewEventGroup{1..5}: event-group=NetManager_Someip/NewEventGroup{1..5}
    R_Vehicle_ApSysMgr_NetManager: service-interface-deployment=Deployment/NetManager_Someip, required-service-instance-id=ANY, sd-client-config=R_CCU_SDConfig
      6 x someip required event group:
        Required_NewEventGroup: event-group=NetManager_Someip/NewEventGroup
        Required_NewEventGroup{1..5}: event-group=NetManager_Someip/NewEventGroup{1..5}
    R_Vehicle_ApSysMgr_NetManager: service-interface-deployment=Deployment/NetManager_Someip, required-service-instance-id=ANY, sd-client-config=R_CCU_SDConfig
      6 x someip required event group:
        Required_NewEventGroup: event-group=NetManager_Someip/NewEventGroup
        Required_NewEventGroup{1..5}: event-group=NetManager_Someip/NewEventGroup{1..5}
    R_Vehicle_ApSysMgr_NetManager: service-interface-deployment=Deployment/NetManager_Someip, required-service-instance-id=ANY, sd-client-config=R_CCU_SDConfig
      6 x someip required event group:
        Required_NewEventGroup: event-group=NetManager_Someip/NewEventGroup
        Required_NewEventGroup{1..5}: event-group=NetManager_Someip/NewEventGroup{1..5}
    R_Vehicle_ApSysMgr_SysInfoManager: service-interface-deployment=SysInfoManager_Someip, required-service-instance-id=ANY, sd-client-config=R_CCU_SDConfig
      someip required event group Required_NewEventGroup: event-group=SysInfoManager_Someip/NewEventGroup
      someip required event group Required_NewEventGroup1: event-group=SysInfoManager_Someip/NewEventGroup1
    R_Vehicle_ApSysMgr_SysInfoManager: service-interface-deployment=SysInfoManager_Someip, required-service-instance-id=ANY, sd-client-config=R_CCU_SDConfig
      someip required event group Required_NewEventGroup: event-group=SysInfoManager_Someip/NewEventGroup
      someip required event group Required_NewEventGroup1: event-group=SysInfoManager_Someip/NewEventGroup1
    R_Vehicle_ApSysMgr_SysInfoManager: service-interface-deployment=SysInfoManager_Someip, required-service-instance-id=ANY, sd-client-config=R_CCU_SDConfig
      someip required event group Required_NewEventGroup: event-group=SysInfoManager_Someip/NewEventGroup
      someip required event group Required_NewEventGroup1: event-group=SysInfoManager_Someip/NewEventGroup1
    R_Vehicle_ApSysMgr_SysInfoManager: service-interface-deployment=SysInfoManager_Someip, required-service-instance-id=ANY, sd-client-config=R_CCU_SDConfig
      someip required event group Required_NewEventGroup: event-group=SysInfoManager_Someip/NewEventGroup
      someip required event group Required_NewEventGroup1: event-group=SysInfoManager_Someip/NewEventGroup1
    R_Vehicle_ApSysMgr_SysInfoManager: service-interface-deployment=SysInfoManager_Someip, required-service-instance-id=ANY, sd-client-config=R_CCU_SDConfig
      someip required event group Required_NewEventGroup: event-group=SysInfoManager_Someip/NewEventGroup
      someip required event group Required_NewEventGroup1: event-group=SysInfoManager_Someip/NewEventGroup1
    R_Vehicle_ApSysMgr_SysInfoManager: service-interface-deployment=SysInfoManager_Someip, required-service-instance-id=ANY, sd-client-config=R_CCU_SDConfig
      someip required event group Required_NewEventGroup: event-group=SysInfoManager_Someip/NewEventGroup
      someip required event group Required_NewEventGroup1: event-group=SysInfoManager_Someip/NewEventGroup1
    R_Vehicle_ApSysMgr_SysInfoManager: service-interface-deployment=SysInfoManager_Someip, required-service-instance-id=ANY, sd-client-config=R_CCU_SDConfig
      someip required event group Required_NewEventGroup: event-group=SysInfoManager_Someip/NewEventGroup
      someip required event group Required_NewEventGroup1: event-group=SysInfoManager_Someip/NewEventGroup1
    R_Vehicle_ApSysMgr_SysInfoManager: service-interface-deployment=SysInfoManager_Someip, required-service-instance-id=ANY, sd-client-config=R_CCU_SDConfig
      someip required event group Required_NewEventGroup: event-group=SysInfoManager_Someip/NewEventGroup
      someip required event group Required_NewEventGroup1: event-group=SysInfoManager_Someip/NewEventGroup1
    R_Vehicle_ApSysMgr_SysInfoManager: service-interface-deployment=SysInfoManager_Someip, required-service-instance-id=ANY, sd-client-config=R_CCU_SDConfig
      someip required event group Required_NewEventGroup: event-group=SysInfoManager_Someip/NewEventGroup
      someip required event group Required_NewEventGroup1: event-group=SysInfoManager_Someip/NewEventGroup1
    R_Vehicle_ApSysMgr_SysInfoManager: service-interface-deployment=SysInfoManager_Someip, required-service-instance-id=ANY, sd-client-config=R_CCU_SDConfig
      someip required event group Required_NewEventGroup: event-group=SysInfoManager_Someip/NewEventGroup
      someip required event group Required_NewEventGroup1: event-group=SysInfoManager_Someip/NewEventGroup1
    R_Vehicle_ApSysMgr_SysInfoManager: service-interface-deployment=SysInfoManager_Someip, required-service-instance-id=ANY, sd-client-config=R_CCU_SDConfig
      someip required event group Required_NewEventGroup: event-group=SysInfoManager_Someip/NewEventGroup
      someip required event group Required_NewEventGroup1: event-group=SysInfoManager_Someip/NewEventGroup1
    R_Vehicle_ApSysMgr_SysInfoManager: service-interface-deployment=SysInfoManager_Someip, required-service-instance-id=ANY, sd-client-config=R_CCU_SDConfig
      someip required event group Required_NewEventGroup: event-group=SysInfoManager_Someip/NewEventGroup
      someip required event group Required_NewEventGroup1: event-group=SysInfoManager_Someip/NewEventGroup1
    R_Vehicle_ApSysMgr_SysInfoManager: service-interface-deployment=SysInfoManager_Someip, required-service-instance-id=ANY, sd-client-config=R_CCU_SDConfig
      someip required event group Required_NewEventGroup: event-group=SysInfoManager_Someip/NewEventGroup
      someip required event group Required_NewEventGroup1: event-group=SysInfoManager_Someip/NewEventGroup1
    R_Vehicle_ApSysMgr_SysInfoManager: service-interface-deployment=SysInfoManager_Someip, required-service-instance-id=ANY, sd-client-config=R_CCU_SDConfig
      someip required event group Required_NewEventGroup: event-group=SysInfoManager_Someip/NewEventGroup
      someip required event group Required_NewEventGroup1: event-group=SysInfoManager_Someip/NewEventGroup1
    R_Vehicle_ApSysMgr_SysInfoManager: service-interface-deployment=SysInfoManager_Someip, required-service-instance-id=ANY, sd-client-config=R_CCU_SDConfig
      someip required event group Required_NewEventGroup: event-group=SysInfoManager_Someip/NewEventGroup
      someip required event group Required_NewEventGroup1: event-group=SysInfoManager_Someip/NewEventGroup1
    R_Vehicle_ApSysMgr_SysInfoManager: service-interface-deployment=SysInfoManager_Someip, required-service-instance-id=ANY, sd-client-config=R_CCU_SDConfig
      someip required event group Required_NewEventGroup: event-group=SysInfoManager_Someip/NewEventGroup
      someip required event group Required_NewEventGroup1: event-group=SysInfoManager_Someip/NewEventGroup1
    R_Vehicle_ApSysMgr_SysInfoManager: service-interface-deployment=SysInfoManager_Someip, required-service-instance-id=ANY, sd-client-config=R_CCU_SDConfig
      someip required event group Required_NewEventGroup: event-group=SysInfoManager_Someip/NewEventGroup
      someip required event group Required_NewEventGroup1: event-group=SysInfoManager_Someip/NewEventGroup1
    R_Vehicle_ApSysMgr_SysInfoManager: service-interface-deployment=SysInfoManager_Someip, required-service-instance-id=ANY, sd-client-config=R_CCU_SDConfig
      someip required event group Required_NewEventGroup: event-group=SysInfoManager_Someip/NewEventGroup
      someip required event group Required_NewEventGroup1: event-group=SysInfoManager_Someip/NewEventGroup1
    R_Vehicle_ApSysMgr_SysInfoManager: service-interface-deployment=SysInfoManager_Someip, required-service-instance-id=ANY, sd-client-config=R_CCU_SDConfig
      someip required event group Required_NewEventGroup: event-group=SysInfoManager_Someip/NewEventGroup
      someip required event group Required_NewEventGroup1: event-group=SysInfoManager_Someip/NewEventGroup1
    R_Vehicle_ApSysMgr_SysInfoManager: service-interface-deployment=SysInfoManager_Someip, required-service-instance-id=ANY, sd-client-config=R_CCU_SDConfig
      someip required event group Required_NewEventGroup: event-group=SysInfoManager_Someip/NewEventGroup
      someip required event group Required_NewEventGroup1: event-group=SysInfoManager_Someip/NewEventGroup1
    R_Vehicle_ApSysMgr_SysInfoManager: service-interface-deployment=SysInfoManager_Someip, required-service-instance-id=ANY, sd-client-config=R_CCU_SDConfig
      someip required event group Required_NewEventGroup: event-group=SysInfoManager_Someip/NewEventGroup
      someip required event group Required_NewEventGroup1: event-group=SysInfoManager_Someip/NewEventGroup1
    R_Vehicle_ApSysMgr_SysInfoManager: service-interface-deployment=SysInfoManager_Someip, required-service-instance-id=ANY, sd-client-config=R_CCU_SDConfig
      someip required event group Required_NewEventGroup: event-group=SysInfoManager_Someip/NewEventGroup
      someip required event group Required_NewEventGroup1: event-group=SysInfoManager_Someip/NewEventGroup1
    R_Vehicle_ApSysMgr_SysInfoManager: service-interface-deployment=SysInfoManager_Someip, required-service-instance-id=ANY, sd-client-config=R_CCU_SDConfig
      someip required event group Required_NewEventGroup: event-group=SysInfoManager_Someip/NewEventGroup
      someip required event group Required_NewEventGroup1: event-group=SysInfoManager_Someip/NewEventGroup1
    R_Vehicle_ApSysMgr_SysInfoManager: service-interface-deployment=SysInfoManager_Someip, required-service-instance-id=ANY, sd-client-config=R_CCU_SDConfig
      someip required event group Required_NewEventGroup: event-group=SysInfoManager_Someip/NewEventGroup
      someip required event group Required_NewEventGroup1: event-group=SysInfoManager_Someip/NewEventGroup1
    R_Vehicle_ApSysMgr_SysInfoManager: service-interface-deployment=SysInfoManager_Someip, required-service-instance-id=ANY, sd-client-config=R_CCU_SDConfig
      someip required event group Required_NewEventGroup: event-group=SysInfoManager_Someip/NewEventGroup
      someip required event group Required_NewEventGroup1: event-group=SysInfoManager_Someip/NewEventGroup1
    R_Vehicle_ApSysMgr_TAD: service-interface-deployment=TAD_Someip, required-service-instance-id=ANY, sd-client-config=R_CCU_SDConfig
    R_Vehicle_ApSysMgr_TimeManager: service-interface-deployment=TimeManager_Someip, required-service-instance-id=ANY, sd-client-config=R_CCU_SDConfig
      someip required event group Required_NewEventGroup: event-group=TimeManager_Someip/NewEventGroup
    R_Vehicle_ApSysMgr_TimeManager: service-interface-deployment=TimeManager_Someip, required-service-instance-id=ANY, sd-client-config=R_CCU_SDConfig
      someip required event group Required_NewEventGroup: event-group=TimeManager_Someip/NewEventGroup
    R_Vehicle_ApSysMgr_TimeManager: service-interface-deployment=TimeManager_Someip, required-service-instance-id=ANY, sd-client-config=R_CCU_SDConfig
      someip required event group Required_NewEventGroup: event-group=TimeManager_Someip/NewEventGroup
    R_Vehicle_ApSysMgr_TimeManager: service-interface-deployment=TimeManager_Someip, required-service-instance-id=ANY, sd-client-config=R_CCU_SDConfig
      someip required event group Required_NewEventGroup: event-group=TimeManager_Someip/NewEventGroup
    R_Vehicle_ApSysMgr_TimeManager: service-interface-deployment=TimeManager_Someip, required-service-instance-id=ANY, sd-client-config=R_CCU_SDConfig
      someip required event group Required_NewEventGroup: event-group=TimeManager_Someip/NewEventGroup
    R_Vehicle_ApSysMgr_TimeManager: service-interface-deployment=TimeManager_Someip, required-service-instance-id=ANY, sd-client-config=R_CCU_SDConfig
      someip required event group Required_NewEventGroup: event-group=TimeManager_Someip/NewEventGroup
    R_Vehicle_ApSysMgr_TimeManager: service-interface-deployment=TimeManager_Someip, required-service-instance-id=ANY, sd-client-config=R_CCU_SDConfig
      someip required event group Required_NewEventGroup: event-group=TimeManager_Someip/NewEventGroup
    R_Vehicle_ApSysMgr_TimeManager: service-interface-deployment=TimeManager_Someip, required-service-instance-id=ANY, sd-client-config=R_CCU_SDConfig
      someip required event group Required_NewEventGroup: event-group=TimeManager_Someip/NewEventGroup
    R_Vehicle_ApSysMgr_TimeManager: service-interface-deployment=TimeManager_Someip, required-service-instance-id=ANY, sd-client-config=R_CCU_SDConfig
      someip required event group Required_NewEventGroup: event-group=TimeManager_Someip/NewEventGroup
    R_Vehicle_ApSysMgr_TimeManager: service-interface-deployment=TimeManager_Someip, required-service-instance-id=ANY, sd-client-config=R_CCU_SDConfig
      someip required event group Required_NewEventGroup: event-group=TimeManager_Someip/NewEventGroup
    R_Vehicle_BSM_BootSyncManager: service-interface-deployment=BootSyncManager_Someip, required-service-instance-id=ANY, sd-client-config=R_CCU_SDConfig
      someip required event group Required_NewEventGroup: event-group=BootSyncManager_Someip/NewEventGroup
      someip required event group Required_NewEventGroup1: event-group=BootSyncManager_Someip/NewEventGroup1
      someip required event group Required_NewEventGroup2: event-group=BootSyncManager_Someip/NewEventGroup2
    R_Vehicle_BSM_BootSyncManager: service-interface-deployment=BootSyncManager_Someip, required-service-instance-id=ANY, sd-client-config=R_CCU_SDConfig
      someip required event group Required_NewEventGroup: event-group=BootSyncManager_Someip/NewEventGroup
      someip required event group Required_NewEventGroup1: event-group=BootSyncManager_Someip/NewEventGroup1
      someip required event group Required_NewEventGroup2: event-group=BootSyncManager_Someip/NewEventGroup2
    R_Vehicle_BSM_BootSyncManager: service-interface-deployment=BootSyncManager_Someip, required-service-instance-id=ANY, sd-client-config=R_CCU_SDConfig
      someip required event group Required_NewEventGroup: event-group=BootSyncManager_Someip/NewEventGroup
      someip required event group Required_NewEventGroup1: event-group=BootSyncManager_Someip/NewEventGroup1
      someip required event group Required_NewEventGroup2: event-group=BootSyncManager_Someip/NewEventGroup2
    R_Vehicle_BSM_BootSyncManager: service-interface-deployment=BootSyncManager_Someip, required-service-instance-id=ANY, sd-client-config=R_CCU_SDConfig
      someip required event group Required_NewEventGroup: event-group=BootSyncManager_Someip/NewEventGroup
      someip required event group Required_NewEventGroup1: event-group=BootSyncManager_Someip/NewEventGroup1
      someip required event group Required_NewEventGroup2: event-group=BootSyncManager_Someip/NewEventGroup2
    R_Vehicle_BSM_BootSyncManager: service-interface-deployment=BootSyncManager_Someip, required-service-instance-id=ANY, sd-client-config=R_CCU_SDConfig
      someip required event group Required_NewEventGroup: event-group=BootSyncManager_Someip/NewEventGroup
      someip required event group Required_NewEventGroup1: event-group=BootSyncManager_Someip/NewEventGroup1
      someip required event group Required_NewEventGroup2: event-group=BootSyncManager_Someip/NewEventGroup2
    R_Vehicle_CCS_Monitoring: service-interface-deployment=Monitoring_Someip, required-service-instance-id=ANY, sd-client-config=R_CCU_SDConfig
    R_Vehicle_CCS_Monitoring: service-interface-deployment=Monitoring_Someip, required-service-instance-id=ANY, sd-client-config=R_CCU_SDConfig
    R_Vehicle_CCS_Monitoring: service-interface-deployment=Monitoring_Someip, required-service-instance-id=ANY, sd-client-config=R_CCU_SDConfig
    R_Vehicle_CCS_Monitoring: service-interface-deployment=Monitoring_Someip, required-service-instance-id=ANY, sd-client-config=R_CCU_SDConfig
    R_Vehicle_CCS_Monitoring: service-interface-deployment=Monitoring_Someip, required-service-instance-id=ANY, sd-client-config=R_CCU_SDConfig
    R_Vehicle_CCS_Monitoring: service-interface-deployment=Monitoring_Someip, required-service-instance-id=ANY, sd-client-config=R_CCU_SDConfig
    R_Vehicle_CCS_Monitoring: service-interface-deployment=Monitoring_Someip, required-service-instance-id=ANY, sd-client-config=R_CCU_SDConfig
    R_Vehicle_CCS_Monitoring: service-interface-deployment=Monitoring_Someip, required-service-instance-id=ANY, sd-client-config=R_CCU_SDConfig
    R_Vehicle_CCS_Monitoring: service-interface-deployment=Monitoring_Someip, required-service-instance-id=ANY, sd-client-config=R_CCU_SDConfig
    R_Vehicle_CCS_Monitoring: service-interface-deployment=Monitoring_Someip, required-service-instance-id=ANY, sd-client-config=R_CCU_SDConfig
    R_Vehicle_CCS_Monitoring: service-interface-deployment=Monitoring_Someip, required-service-instance-id=ANY, sd-client-config=R_CCU_SDConfig
    R_Vehicle_CCS_Monitoring: service-interface-deployment=Monitoring_Someip, required-service-instance-id=ANY, sd-client-config=R_CCU_SDConfig
    R_Vehicle_CCS_Monitoring: service-interface-deployment=Monitoring_Someip, required-service-instance-id=ANY, sd-client-config=R_CCU_SDConfig
    R_Vehicle_CCS_Monitoring: service-interface-deployment=Monitoring_Someip, required-service-instance-id=ANY, sd-client-config=R_CCU_SDConfig
    R_Vehicle_CCS_Monitoring: service-interface-deployment=Monitoring_Someip, required-service-instance-id=ANY, sd-client-config=R_CCU_SDConfig
    R_Vehicle_CCS_Monitoring: service-interface-deployment=Monitoring_Someip, required-service-instance-id=ANY, sd-client-config=R_CCU_SDConfig
    R_Vehicle_CCS_Monitoring: service-interface-deployment=Monitoring_Someip, required-service-instance-id=ANY, sd-client-config=R_CCU_SDConfig
    R_Vehicle_CCS_Monitoring: service-interface-deployment=Monitoring_Someip, required-service-instance-id=ANY, sd-client-config=R_CCU_SDConfig
    R_Vehicle_CIDS_CIDSDiagInfo: service-interface-deployment=CIDSDiagInfo_Someip, required-service-instance-id=ANY, sd-client-config=R_CCU_SDConfig
    R_Vehicle_CIDS_CIDSDiagInfo: service-interface-deployment=CIDSDiagInfo_Someip, required-service-instance-id=ANY, sd-client-config=R_CCU_SDConfig
    R_Vehicle_CIDS_CIDSInfo: service-interface-deployment=CIDSInfo_Someip, required-service-instance-id=ANY, sd-client-config=R_CCU_SDConfig
      someip required event group Required_NewEventGroup: event-group=CIDSInfo_Someip/NewEventGroup
      someip required event group Required_NewEventGroup2: event-group=CIDSInfo_Someip/NewEventGroup2
    R_Vehicle_CIDS_ReportSender: service-interface-deployment=Deployment/ReportSender_Someip, required-service-instance-id=ANY, sd-client-config=R_CCU_SDConfig
    R_Vehicle_CM_OTA: service-interface-deployment=OTA_Someip, required-service-instance-id=ANY, sd-client-config=R_CCU_SDConfig
    R_Vehicle_CM_OTA: service-interface-deployment=OTA_Someip, required-service-instance-id=ANY, sd-client-config=R_CCU_SDConfig
    R_Vehicle_CM_PackageManagement: service-interface-deployment=Deployment/PackageManagement_Someip, required-service-instance-id=ANY, sd-client-config=R_CCU_SDConfig
      someip required event group Required_NewEventGroup1: event-group=PackageManagement_Someip/NewEventGroup1
      someip required event group Required_NewEventGroup2: event-group=PackageManagement_Someip/NewEventGroup2
    R_Vehicle_CM_PackageManagement: service-interface-deployment=Deployment/PackageManagement_Someip, required-service-instance-id=ANY, sd-client-config=R_CCU_SDConfig
      someip required event group Required_NewEventGroup1: event-group=PackageManagement_Someip/NewEventGroup1
      someip required event group Required_NewEventGroup2: event-group=PackageManagement_Someip/NewEventGroup2
    R_Vehicle_CM_PackageManagement: service-interface-deployment=Deployment/PackageManagement_Someip, required-service-instance-id=ANY, sd-client-config=R_CCU_SDConfig
      someip required event group Required_NewEventGroup1: event-group=PackageManagement_Someip/NewEventGroup1
      someip required event group Required_NewEventGroup2: event-group=PackageManagement_Someip/NewEventGroup2
    R_Vehicle_DPM_Policy: service-interface-deployment=Deployment/Policy_Someip, required-service-instance-id=ANY, sd-client-config=R_CCU_SDConfig
      11 x someip required event group:
        Required_NewEventGroup: event-group=Policy_Someip/NewEventGroup
        Required_NewEventGroup1: event-group=Policy_Someip/NewEventGroup1
        Required_NewEventGroup10: event-group=Policy_Someip/NewEventGroup10
        Required_NewEventGroup{2..9}: event-group=Policy_Someip/NewEventGroup{2..9}
    R_Vehicle_DPM_Policy: service-interface-deployment=Deployment/Policy_Someip, required-service-instance-id=ANY, sd-client-config=R_CCU_SDConfig
      11 x someip required event group:
        Required_NewEventGroup: event-group=Policy_Someip/NewEventGroup
        Required_NewEventGroup1: event-group=Policy_Someip/NewEventGroup1
        Required_NewEventGroup10: event-group=Policy_Someip/NewEventGroup10
        Required_NewEventGroup{2..9}: event-group=Policy_Someip/NewEventGroup{2..9}
    R_Vehicle_DPM_Policy: service-interface-deployment=Deployment/Policy_Someip, required-service-instance-id=ANY, sd-client-config=R_CCU_SDConfig
      11 x someip required event group:
        Required_NewEventGroup: event-group=Policy_Someip/NewEventGroup
        Required_NewEventGroup1: event-group=Policy_Someip/NewEventGroup1
        Required_NewEventGroup10: event-group=Policy_Someip/NewEventGroup10
        Required_NewEventGroup{2..9}: event-group=Policy_Someip/NewEventGroup{2..9}
    R_Vehicle_DPM_Policy: service-interface-deployment=Deployment/Policy_Someip, required-service-instance-id=ANY, sd-client-config=R_CCU_SDConfig
      11 x someip required event group:
        Required_NewEventGroup: event-group=Policy_Someip/NewEventGroup
        Required_NewEventGroup1: event-group=Policy_Someip/NewEventGroup1
        Required_NewEventGroup10: event-group=Policy_Someip/NewEventGroup10
        Required_NewEventGroup{2..9}: event-group=Policy_Someip/NewEventGroup{2..9}
    R_Vehicle_DPM_Policy: service-interface-deployment=Deployment/Policy_Someip, required-service-instance-id=ANY, sd-client-config=R_CCU_SDConfig
      11 x someip required event group:
        Required_NewEventGroup: event-group=Policy_Someip/NewEventGroup
        Required_NewEventGroup1: event-group=Policy_Someip/NewEventGroup1
        Required_NewEventGroup10: event-group=Policy_Someip/NewEventGroup10
        Required_NewEventGroup{2..9}: event-group=Policy_Someip/NewEventGroup{2..9}
    R_Vehicle_DPM_Policy: service-interface-deployment=Deployment/Policy_Someip, required-service-instance-id=ANY, sd-client-config=R_CCU_SDConfig
      11 x someip required event group:
        Required_NewEventGroup: event-group=Policy_Someip/NewEventGroup
        Required_NewEventGroup1: event-group=Policy_Someip/NewEventGroup1
        Required_NewEventGroup10: event-group=Policy_Someip/NewEventGroup10
        Required_NewEventGroup{2..9}: event-group=Policy_Someip/NewEventGroup{2..9}
    R_Vehicle_DPM_Policy: service-interface-deployment=Deployment/Policy_Someip, required-service-instance-id=ANY, sd-client-config=R_CCU_SDConfig
      11 x someip required event group:
        Required_NewEventGroup: event-group=Policy_Someip/NewEventGroup
        Required_NewEventGroup1: event-group=Policy_Someip/NewEventGroup1
        Required_NewEventGroup10: event-group=Policy_Someip/NewEventGroup10
        Required_NewEventGroup{2..9}: event-group=Policy_Someip/NewEventGroup{2..9}
    R_Vehicle_DPM_Policy: service-interface-deployment=Deployment/Policy_Someip, required-service-instance-id=ANY, sd-client-config=R_CCU_SDConfig
      11 x someip required event group:
        Required_NewEventGroup: event-group=Policy_Someip/NewEventGroup
        Required_NewEventGroup1: event-group=Policy_Someip/NewEventGroup1
        Required_NewEventGroup10: event-group=Policy_Someip/NewEventGroup10
        Required_NewEventGroup{2..9}: event-group=Policy_Someip/NewEventGroup{2..9}
    R_Vehicle_DiagMgr_RoutingDiag: service-interface-deployment=RoutingDiag_Someip, required-service-instance-id=ANY, sd-client-config=R_CCU_SDConfig
      someip required event group Required_NewEventGroup: event-group=RoutingDiag_Someip/NewEventGroup
      someip required event group Required_NewEventGroup1: event-group=RoutingDiag_Someip/NewEventGroup1
    R_Vehicle_DiagMgr_RoutingDiag: service-interface-deployment=RoutingDiag_Someip, required-service-instance-id=ANY, sd-client-config=R_CCU_SDConfig
      someip required event group Required_NewEventGroup: event-group=RoutingDiag_Someip/NewEventGroup
      someip required event group Required_NewEventGroup1: event-group=RoutingDiag_Someip/NewEventGroup1
    R_Vehicle_DiagMgr_RoutingDiag: service-interface-deployment=RoutingDiag_Someip, required-service-instance-id=ANY, sd-client-config=R_CCU_SDConfig
      someip required event group Required_NewEventGroup: event-group=RoutingDiag_Someip/NewEventGroup
      someip required event group Required_NewEventGroup1: event-group=RoutingDiag_Someip/NewEventGroup1
    R_Vehicle_DiagMgr_RoutingDiag: service-interface-deployment=RoutingDiag_Someip, required-service-instance-id=ANY, sd-client-config=R_CCU_SDConfig
      someip required event group Required_NewEventGroup: event-group=RoutingDiag_Someip/NewEventGroup
      someip required event group Required_NewEventGroup1: event-group=RoutingDiag_Someip/NewEventGroup1
    R_Vehicle_DiagMgr_RoutingDiag: service-interface-deployment=RoutingDiag_Someip, required-service-instance-id=ANY, sd-client-config=R_CCU_SDConfig
      someip required event group Required_NewEventGroup: event-group=RoutingDiag_Someip/NewEventGroup
      someip required event group Required_NewEventGroup1: event-group=RoutingDiag_Someip/NewEventGroup1
    R_Vehicle_DiagMgr_RoutingDiag: service-interface-deployment=RoutingDiag_Someip, required-service-instance-id=ANY, sd-client-config=R_CCU_SDConfig
      someip required event group Required_NewEventGroup: event-group=RoutingDiag_Someip/NewEventGroup
      someip required event group Required_NewEventGroup1: event-group=RoutingDiag_Someip/NewEventGroup1
    R_Vehicle_DiagMgr_RoutingDiag: service-interface-deployment=RoutingDiag_Someip, required-service-instance-id=ANY, sd-client-config=R_CCU_SDConfig
      someip required event group Required_NewEventGroup: event-group=RoutingDiag_Someip/NewEventGroup
      someip required event group Required_NewEventGroup1: event-group=RoutingDiag_Someip/NewEventGroup1
    R_Vehicle_DiagMgr_RoutingDiag: service-interface-deployment=RoutingDiag_Someip, required-service-instance-id=ANY, sd-client-config=R_CCU_SDConfig
      someip required event group Required_NewEventGroup: event-group=RoutingDiag_Someip/NewEventGroup
      someip required event group Required_NewEventGroup1: event-group=RoutingDiag_Someip/NewEventGroup1
    R_Vehicle_DiagMgr_RoutingDiag: service-interface-deployment=RoutingDiag_Someip, required-service-instance-id=ANY, sd-client-config=R_CCU_SDConfig
      someip required event group Required_NewEventGroup: event-group=RoutingDiag_Someip/NewEventGroup
      someip required event group Required_NewEventGroup1: event-group=RoutingDiag_Someip/NewEventGroup1
    R_Vehicle_DiagMgr_RoutingDiag: service-interface-deployment=RoutingDiag_Someip, required-service-instance-id=ANY, sd-client-config=R_CCU_SDConfig
      someip required event group Required_NewEventGroup: event-group=RoutingDiag_Someip/NewEventGroup
      someip required event group Required_NewEventGroup1: event-group=RoutingDiag_Someip/NewEventGroup1
    R_Vehicle_DiagMgr_RoutingDiag: service-interface-deployment=RoutingDiag_Someip, required-service-instance-id=ANY, sd-client-config=R_CCU_SDConfig
      someip required event group Required_NewEventGroup: event-group=RoutingDiag_Someip/NewEventGroup
      someip required event group Required_NewEventGroup1: event-group=RoutingDiag_Someip/NewEventGroup1
    R_Vehicle_DiagMgr_RoutingDiag: service-interface-deployment=RoutingDiag_Someip, required-service-instance-id=ANY, sd-client-config=R_CCU_SDConfig
      someip required event group Required_NewEventGroup: event-group=RoutingDiag_Someip/NewEventGroup
      someip required event group Required_NewEventGroup1: event-group=RoutingDiag_Someip/NewEventGroup1
    R_Vehicle_DiagMgr_RoutingTP: service-interface-deployment=RoutingTP_Someip, required-service-instance-id=ANY, sd-client-config=R_CCU_SDConfig
      someip required event group Required_NewEventGroup: event-group=RoutingTP_Someip/NewEventGroup
    R_Vehicle_EIDS_EIDSDiagInfo: service-interface-deployment=EIDSDiagInfo_Someip, required-service-instance-id=ANY, sd-client-config=R_CCU_SDConfig
    R_Vehicle_EIDS_EIDSInfo: service-interface-deployment=EIDSInfo_Someip, required-service-instance-id=ANY, sd-client-config=R_CCU_SDConfig
      someip required event group Required_NewEventGroup: event-group=EIDSInfo_Someip/NewEventGroup
      someip required event group Required_NewEventGroup1: event-group=EIDSInfo_Someip/NewEventGroup1
    R_Vehicle_EIDS_ReportSender: service-interface-deployment=Deployment/ReportSender_Someip, required-service-instance-id=ANY, sd-client-config=R_CCU_SDConfig
    R_Vehicle_EthHandler_EthernetSwitchMgr: service-interface-deployment=EthernetSwitchMgr_Someip, required-service-instance-id=ANY, sd-client-config=R_CCU_SDConfig
      someip required event group Required_NewEventGroup: event-group=EthernetSwitchMgr_Someip/NewEventGroup
    R_Vehicle_EthHandler_EthernetSwitchMgr: service-interface-deployment=EthernetSwitchMgr_Someip, required-service-instance-id=ANY, sd-client-config=R_CCU_SDConfig
      someip required event group Required_NewEventGroup: event-group=EthernetSwitchMgr_Someip/NewEventGroup
    R_Vehicle_EthHandler_EthernetSwitchMgr: service-interface-deployment=EthernetSwitchMgr_Someip, required-service-instance-id=ANY, sd-client-config=R_CCU_SDConfig
      someip required event group Required_NewEventGroup: event-group=EthernetSwitchMgr_Someip/NewEventGroup
    R_Vehicle_EthHandler_EthernetSwitchMgr: service-interface-deployment=EthernetSwitchMgr_Someip, required-service-instance-id=ANY, sd-client-config=R_CCU_SDConfig
      someip required event group Required_NewEventGroup: event-group=EthernetSwitchMgr_Someip/NewEventGroup
    R_Vehicle_EthHandler_EthernetSwitchMgr: service-interface-deployment=EthernetSwitchMgr_Someip, required-service-instance-id=ANY, sd-client-config=R_CCU_SDConfig
      someip required event group Required_NewEventGroup: event-group=EthernetSwitchMgr_Someip/NewEventGroup
    R_Vehicle_EthHandler_EthernetSwitchMgr: service-interface-deployment=EthernetSwitchMgr_Someip, required-service-instance-id=ANY, sd-client-config=R_CCU_SDConfig
      someip required event group Required_NewEventGroup: event-group=EthernetSwitchMgr_Someip/NewEventGroup
    R_Vehicle_EthHandler_EthernetSwitchMgr: service-interface-deployment=EthernetSwitchMgr_Someip, required-service-instance-id=ANY, sd-client-config=R_CCU_SDConfig
      someip required event group Required_NewEventGroup: event-group=EthernetSwitchMgr_Someip/NewEventGroup
    R_Vehicle_EthHandler_EthernetSwitchMgr: service-interface-deployment=EthernetSwitchMgr_Someip, required-service-instance-id=ANY, sd-client-config=R_CCU_SDConfig
      someip required event group Required_NewEventGroup: event-group=EthernetSwitchMgr_Someip/NewEventGroup
    R_Vehicle_EthHandler_EthernetSwitchMgr: service-interface-deployment=EthernetSwitchMgr_Someip, required-service-instance-id=ANY, sd-client-config=R_CCU_SDConfig
      someip required event group Required_NewEventGroup: event-group=EthernetSwitchMgr_Someip/NewEventGroup
    R_Vehicle_EthHandler_EthernetSwitchMgr: service-interface-deployment=EthernetSwitchMgr_Someip, required-service-instance-id=ANY, sd-client-config=R_CCU_SDConfig
      someip required event group Required_NewEventGroup: event-group=EthernetSwitchMgr_Someip/NewEventGroup
    R_Vehicle_EthHandler_EthernetSwitchMgr: service-interface-deployment=EthernetSwitchMgr_Someip, required-service-instance-id=ANY, sd-client-config=R_CCU_SDConfig
      someip required event group Required_NewEventGroup: event-group=EthernetSwitchMgr_Someip/NewEventGroup
    R_Vehicle_EthHandler_EthernetSwitchMgr: service-interface-deployment=EthernetSwitchMgr_Someip, required-service-instance-id=ANY, sd-client-config=R_CCU_SDConfig
      someip required event group Required_NewEventGroup: event-group=EthernetSwitchMgr_Someip/NewEventGroup
    R_Vehicle_EthNM_NM: service-interface-deployment=NM_Someip, required-service-instance-id=ANY, sd-client-config=R_CCU_SDConfig
      someip required event group Required_NewEventGroup: event-group=NM_Someip/NewEventGroup
      someip required event group Required_NewEventGroup1: event-group=NM_Someip/NewEventGroup1
      someip required event group Required_NewEventGroup2: event-group=NM_Someip/NewEventGroup2
    R_Vehicle_EthNM_NM: service-interface-deployment=NM_Someip, required-service-instance-id=ANY, sd-client-config=R_CCU_SDConfig
      someip required event group Required_NewEventGroup: event-group=NM_Someip/NewEventGroup
      someip required event group Required_NewEventGroup1: event-group=NM_Someip/NewEventGroup1
      someip required event group Required_NewEventGroup2: event-group=NM_Someip/NewEventGroup2
    R_Vehicle_EthNM_NM: service-interface-deployment=NM_Someip, required-service-instance-id=ANY, sd-client-config=R_CCU_SDConfig
      someip required event group Required_NewEventGroup: event-group=NM_Someip/NewEventGroup
      someip required event group Required_NewEventGroup1: event-group=NM_Someip/NewEventGroup1
      someip required event group Required_NewEventGroup2: event-group=NM_Someip/NewEventGroup2
    R_Vehicle_EthNM_NM: service-interface-deployment=NM_Someip, required-service-instance-id=ANY, sd-client-config=R_CCU_SDConfig
      someip required event group Required_NewEventGroup: event-group=NM_Someip/NewEventGroup
      someip required event group Required_NewEventGroup1: event-group=NM_Someip/NewEventGroup1
      someip required event group Required_NewEventGroup2: event-group=NM_Someip/NewEventGroup2
    R_Vehicle_EthNM_NM: service-interface-deployment=NM_Someip, required-service-instance-id=ANY, sd-client-config=R_CCU_SDConfig
      someip required event group Required_NewEventGroup: event-group=NM_Someip/NewEventGroup
      someip required event group Required_NewEventGroup1: event-group=NM_Someip/NewEventGroup1
      someip required event group Required_NewEventGroup2: event-group=NM_Someip/NewEventGroup2
    R_Vehicle_FlashingAdaptor_PackageManagement: service-interface-deployment=Deployment/PackageManagement_Someip, required-service-instance-id=ANY, sd-client-config=R_CCU_SDConfig
    R_Vehicle_FlashingAdaptor_PackageManagement: service-interface-deployment=Deployment/PackageManagement_Someip, required-service-instance-id=ANY, sd-client-config=R_CCU_SDConfig
    R_Vehicle_FoDClient_ActivationManager: service-interface-deployment=ActivationManager_Someip, required-service-instance-id=ANY, sd-client-config=R_CCU_SDConfig
    R_Vehicle_FoDMaster_Support: service-interface-deployment=Support_Someip, required-service-instance-id=ANY, sd-client-config=R_CCU_SDConfig
      someip required event group Required_NewEventGroup: event-group=Support_Someip/NewEventGroup
    R_Vehicle_FoDMaster_Support: service-interface-deployment=Support_Someip, required-service-instance-id=ANY, sd-client-config=R_CCU_SDConfig
      someip required event group Required_NewEventGroup: event-group=Support_Someip/NewEventGroup
    R_Vehicle_IPCHandler_RoutingIPC: service-interface-deployment=RoutingIPC_Someip, required-service-instance-id=ANY, sd-client-config=R_CCU_SDConfig
      8 x someip required event group:
        Required_NewEventGroup: event-group=RoutingIPC_Someip/NewEventGroup
        Required_NewEventGroup{1..7}: event-group=RoutingIPC_Someip/NewEventGroup{1..7}
    R_Vehicle_IPCHandler_RoutingIPC: service-interface-deployment=RoutingIPC_Someip, required-service-instance-id=ANY, sd-client-config=R_CCU_SDConfig
      8 x someip required event group:
        Required_NewEventGroup: event-group=RoutingIPC_Someip/NewEventGroup
        Required_NewEventGroup{1..7}: event-group=RoutingIPC_Someip/NewEventGroup{1..7}
    R_Vehicle_IPCHandler_RoutingIPC: service-interface-deployment=RoutingIPC_Someip, required-service-instance-id=ANY, sd-client-config=R_CCU_SDConfig
      8 x someip required event group:
        Required_NewEventGroup: event-group=RoutingIPC_Someip/NewEventGroup
        Required_NewEventGroup{1..7}: event-group=RoutingIPC_Someip/NewEventGroup{1..7}
    R_Vehicle_IPCHandler_RoutingIPC: service-interface-deployment=RoutingIPC_Someip, required-service-instance-id=ANY, sd-client-config=R_CCU_SDConfig
      8 x someip required event group:
        Required_NewEventGroup: event-group=RoutingIPC_Someip/NewEventGroup
        Required_NewEventGroup{1..7}: event-group=RoutingIPC_Someip/NewEventGroup{1..7}
    R_Vehicle_IPCHandler_RoutingIPC: service-interface-deployment=RoutingIPC_Someip, required-service-instance-id=ANY, sd-client-config=R_CCU_SDConfig
      8 x someip required event group:
        Required_NewEventGroup: event-group=RoutingIPC_Someip/NewEventGroup
        Required_NewEventGroup{1..7}: event-group=RoutingIPC_Someip/NewEventGroup{1..7}
    R_Vehicle_IPCHandler_RoutingIPC: service-interface-deployment=RoutingIPC_Someip, required-service-instance-id=ANY, sd-client-config=R_CCU_SDConfig
      8 x someip required event group:
        Required_NewEventGroup: event-group=RoutingIPC_Someip/NewEventGroup
        Required_NewEventGroup{1..7}: event-group=RoutingIPC_Someip/NewEventGroup{1..7}
    R_Vehicle_IPCHandler_RoutingIPC: service-interface-deployment=RoutingIPC_Someip, required-service-instance-id=ANY, sd-client-config=R_CCU_SDConfig
      8 x someip required event group:
        Required_NewEventGroup: event-group=RoutingIPC_Someip/NewEventGroup
        Required_NewEventGroup{1..7}: event-group=RoutingIPC_Someip/NewEventGroup{1..7}
    R_Vehicle_IPCHandler_RoutingIPC: service-interface-deployment=RoutingIPC_Someip, required-service-instance-id=ANY, sd-client-config=R_CCU_SDConfig
      8 x someip required event group:
        Required_NewEventGroup: event-group=RoutingIPC_Someip/NewEventGroup
        Required_NewEventGroup{1..7}: event-group=RoutingIPC_Someip/NewEventGroup{1..7}
    R_Vehicle_IPCHandler_RoutingIPC: service-interface-deployment=RoutingIPC_Someip, required-service-instance-id=ANY, sd-client-config=R_CCU_SDConfig
      8 x someip required event group:
        Required_NewEventGroup: event-group=RoutingIPC_Someip/NewEventGroup
        Required_NewEventGroup{1..7}: event-group=RoutingIPC_Someip/NewEventGroup{1..7}
    R_Vehicle_LogCollection_DebugSnapshot: service-interface-deployment=DebugSnapshot_Someip, required-service-instance-id=ANY, sd-client-config=R_CCU_SDConfig
      someip required event group Required_NewEventGroup: event-group=DebugSnapshot_Someip/NewEventGroup
    R_Vehicle_LogCollection_DebugSnapshot: service-interface-deployment=DebugSnapshot_Someip, required-service-instance-id=ANY, sd-client-config=R_CCU_SDConfig
      someip required event group Required_NewEventGroup: event-group=DebugSnapshot_Someip/NewEventGroup
    R_Vehicle_LogCollection_DebugSnapshot: service-interface-deployment=DebugSnapshot_Someip, required-service-instance-id=ANY, sd-client-config=R_CCU_SDConfig
      someip required event group Required_NewEventGroup: event-group=DebugSnapshot_Someip/NewEventGroup
    R_Vehicle_LogCollection_DebugSnapshot: service-interface-deployment=DebugSnapshot_Someip, required-service-instance-id=ANY, sd-client-config=R_CCU_SDConfig
      someip required event group Required_NewEventGroup: event-group=DebugSnapshot_Someip/NewEventGroup
    R_Vehicle_LogCollection_DebugSnapshot: service-interface-deployment=DebugSnapshot_Someip, required-service-instance-id=ANY, sd-client-config=R_CCU_SDConfig
      someip required event group Required_NewEventGroup: event-group=DebugSnapshot_Someip/NewEventGroup
    R_Vehicle_LogCollection_DebugSnapshot: service-interface-deployment=DebugSnapshot_Someip, required-service-instance-id=ANY, sd-client-config=R_CCU_SDConfig
      someip required event group Required_NewEventGroup: event-group=DebugSnapshot_Someip/NewEventGroup
    R_Vehicle_LogCollection_DebugSnapshot: service-interface-deployment=DebugSnapshot_Someip, required-service-instance-id=ANY, sd-client-config=R_CCU_SDConfig
      someip required event group Required_NewEventGroup: event-group=DebugSnapshot_Someip/NewEventGroup
    R_Vehicle_LogCollection_DebugSnapshot: service-interface-deployment=DebugSnapshot_Someip, required-service-instance-id=ANY, sd-client-config=R_CCU_SDConfig
      someip required event group Required_NewEventGroup: event-group=DebugSnapshot_Someip/NewEventGroup
    R_Vehicle_LogCollection_DebugSnapshot: service-interface-deployment=DebugSnapshot_Someip, required-service-instance-id=ANY, sd-client-config=R_CCU_SDConfig
      someip required event group Required_NewEventGroup: event-group=DebugSnapshot_Someip/NewEventGroup
    R_Vehicle_LogCollection_Logging: service-interface-deployment=Logging_Someip, required-service-instance-id=ANY, sd-client-config=R_CCU_SDConfig
    R_Vehicle_LogCollection_Logging: service-interface-deployment=Logging_Someip, required-service-instance-id=ANY, sd-client-config=R_CCU_SDConfig
    R_Vehicle_LogCollection_Logging: service-interface-deployment=Logging_Someip, required-service-instance-id=ANY, sd-client-config=R_CCU_SDConfig
    R_Vehicle_LogCollection_Logging: service-interface-deployment=Logging_Someip, required-service-instance-id=ANY, sd-client-config=R_CCU_SDConfig
    R_Vehicle_LogCollection_Logging: service-interface-deployment=Logging_Someip, required-service-instance-id=ANY, sd-client-config=R_CCU_SDConfig
    R_Vehicle_LogCollection_Logging: service-interface-deployment=Logging_Someip, required-service-instance-id=ANY, sd-client-config=R_CCU_SDConfig
    R_Vehicle_LogCollection_Logging: service-interface-deployment=Logging_Someip, required-service-instance-id=ANY, sd-client-config=R_CCU_SDConfig
    R_Vehicle_LogCollection_Logging: service-interface-deployment=Logging_Someip, required-service-instance-id=ANY, sd-client-config=R_CCU_SDConfig
    R_Vehicle_LogCollection_Logging: service-interface-deployment=Logging_Someip, required-service-instance-id=ANY, sd-client-config=R_CCU_SDConfig
    R_Vehicle_MSM_APNManager: service-interface-deployment=APNManager_Someip, required-service-instance-id=ANY, sd-client-config=R_CCU_SDConfig
      someip required event group Required_NewEventGroup: event-group=APNManager_Someip/NewEventGroup
      someip required event group Required_NewEventGroup1: event-group=APNManager_Someip/NewEventGroup1
    R_Vehicle_MSM_APNManager: service-interface-deployment=APNManager_Someip, required-service-instance-id=ANY, sd-client-config=R_CCU_SDConfig
      someip required event group Required_NewEventGroup: event-group=APNManager_Someip/NewEventGroup
      someip required event group Required_NewEventGroup1: event-group=APNManager_Someip/NewEventGroup1
    R_Vehicle_MSM_APNManager: service-interface-deployment=APNManager_Someip, required-service-instance-id=ANY, sd-client-config=R_CCU_SDConfig
      someip required event group Required_NewEventGroup: event-group=APNManager_Someip/NewEventGroup
      someip required event group Required_NewEventGroup1: event-group=APNManager_Someip/NewEventGroup1
    R_Vehicle_MSM_APNManager: service-interface-deployment=APNManager_Someip, required-service-instance-id=ANY, sd-client-config=R_CCU_SDConfig
      someip required event group Required_NewEventGroup: event-group=APNManager_Someip/NewEventGroup
      someip required event group Required_NewEventGroup1: event-group=APNManager_Someip/NewEventGroup1
    R_Vehicle_MSM_MessageManager: service-interface-deployment=Deployment/MessageManager_Someip, required-service-instance-id=ANY, sd-client-config=R_CCU_SDConfig
      someip required event group Required_NewEventGroup: event-group=MessageManager_Someip/NewEventGroup
      someip required event group Required_NewEventGroup1: event-group=MessageManager_Someip/NewEventGroup1
      someip required event group Required_NewEventGroup2: event-group=MessageManager_Someip/NewEventGroup2
    R_Vehicle_MSM_MessageManager: service-interface-deployment=Deployment/MessageManager_Someip, required-service-instance-id=ANY, sd-client-config=R_CCU_SDConfig
      someip required event group Required_NewEventGroup: event-group=MessageManager_Someip/NewEventGroup
      someip required event group Required_NewEventGroup1: event-group=MessageManager_Someip/NewEventGroup1
      someip required event group Required_NewEventGroup2: event-group=MessageManager_Someip/NewEventGroup2
    R_Vehicle_MSM_MessageManager: service-interface-deployment=Deployment/MessageManager_Someip, required-service-instance-id=ANY, sd-client-config=R_CCU_SDConfig
      someip required event group Required_NewEventGroup: event-group=MessageManager_Someip/NewEventGroup
      someip required event group Required_NewEventGroup1: event-group=MessageManager_Someip/NewEventGroup1
      someip required event group Required_NewEventGroup2: event-group=MessageManager_Someip/NewEventGroup2
    R_Vehicle_MSM_MessageManager: service-interface-deployment=Deployment/MessageManager_Someip, required-service-instance-id=ANY, sd-client-config=R_CCU_SDConfig
      someip required event group Required_NewEventGroup: event-group=MessageManager_Someip/NewEventGroup
      someip required event group Required_NewEventGroup1: event-group=MessageManager_Someip/NewEventGroup1
      someip required event group Required_NewEventGroup2: event-group=MessageManager_Someip/NewEventGroup2
    R_Vehicle_MSM_ModemManager: service-interface-deployment=Deployment/ModemManager_Someip, required-service-instance-id=ANY, sd-client-config=R_CCU_SDConfig
      someip required event group Required_NewEventGroup: event-group=ModemManager_Someip/NewEventGroup
    R_Vehicle_MSM_ModemManager: service-interface-deployment=Deployment/ModemManager_Someip, required-service-instance-id=ANY, sd-client-config=R_CCU_SDConfig
      someip required event group Required_NewEventGroup: event-group=ModemManager_Someip/NewEventGroup
    R_Vehicle_MSM_ModemManager: service-interface-deployment=Deployment/ModemManager_Someip, required-service-instance-id=ANY, sd-client-config=R_CCU_SDConfig
      someip required event group Required_NewEventGroup: event-group=ModemManager_Someip/NewEventGroup
    R_Vehicle_MSM_NetworkManager: service-interface-deployment=NetworkManager_Someip, required-service-instance-id=ANY, sd-client-config=R_CCU_SDConfig
      someip required event group Required_NewEventGroup: event-group=NetworkManager_Someip/NewEventGroup
    R_Vehicle_MSM_NetworkManager: service-interface-deployment=NetworkManager_Someip, required-service-instance-id=ANY, sd-client-config=R_CCU_SDConfig
      someip required event group Required_NewEventGroup: event-group=NetworkManager_Someip/NewEventGroup
    R_Vehicle_MSM_NetworkManager: service-interface-deployment=NetworkManager_Someip, required-service-instance-id=ANY, sd-client-config=R_CCU_SDConfig
      someip required event group Required_NewEventGroup: event-group=NetworkManager_Someip/NewEventGroup
    R_Vehicle_MSM_SimManager: service-interface-deployment=Deployment/SimManager_Someip, required-service-instance-id=ANY, sd-client-config=R_CCU_SDConfig
      6 x someip required event group:
        Required_NewEventGroup: event-group=SimManager_Someip/NewEventGroup
        Required_NewEventGroup{1..5}: event-group=SimManager_Someip/NewEventGroup{1..5}
    R_Vehicle_MSM_SimManager: service-interface-deployment=Deployment/SimManager_Someip, required-service-instance-id=ANY, sd-client-config=R_CCU_SDConfig
      6 x someip required event group:
        Required_NewEventGroup: event-group=SimManager_Someip/NewEventGroup
        Required_NewEventGroup{1..5}: event-group=SimManager_Someip/NewEventGroup{1..5}
    R_Vehicle_MSM_SimManager: service-interface-deployment=Deployment/SimManager_Someip, required-service-instance-id=ANY, sd-client-config=R_CCU_SDConfig
      6 x someip required event group:
        Required_NewEventGroup: event-group=SimManager_Someip/NewEventGroup
        Required_NewEventGroup{1..5}: event-group=SimManager_Someip/NewEventGroup{1..5}
    R_Vehicle_MSM_SimManager: service-interface-deployment=Deployment/SimManager_Someip, required-service-instance-id=ANY, sd-client-config=R_CCU_SDConfig
      6 x someip required event group:
        Required_NewEventGroup: event-group=SimManager_Someip/NewEventGroup
        Required_NewEventGroup{1..5}: event-group=SimManager_Someip/NewEventGroup{1..5}
    R_Vehicle_NSD_NonSleep: service-interface-deployment=NonSleep_Someip, required-service-instance-id=ANY, sd-client-config=R_CCU_SDConfig
      someip required event group Required_NewEventGroup: event-group=NonSleep_Someip/NewEventGroup
    R_Vehicle_NSD_NonSleep: service-interface-deployment=NonSleep_Someip, required-service-instance-id=ANY, sd-client-config=R_CCU_SDConfig
      someip required event group Required_NewEventGroup: event-group=NonSleep_Someip/NewEventGroup
    R_Vehicle_RFSM_RemoteFileSystemManager: service-interface-deployment=RemoteFileSystemManager_Someip, required-service-instance-id=ANY, sd-client-config=R_CCU_SDConfig
      someip required event group Required_NewEventGroup: event-group=RemoteFileSystemManager_Someip/NewEventGroup
    R_Vehicle_RFSM_RemoteFileSystemManager: service-interface-deployment=RemoteFileSystemManager_Someip, required-service-instance-id=ANY, sd-client-config=R_CCU_SDConfig
      someip required event group Required_NewEventGroup: event-group=RemoteFileSystemManager_Someip/NewEventGroup
    R_Vehicle_RFSM_RemoteFileSystemManager: service-interface-deployment=RemoteFileSystemManager_Someip, required-service-instance-id=ANY, sd-client-config=R_CCU_SDConfig
      someip required event group Required_NewEventGroup: event-group=RemoteFileSystemManager_Someip/NewEventGroup
    R_Vehicle_SDE_SelfDiagnosis: service-interface-deployment=SelfDiagnosis_Someip, required-service-instance-id=ANY, sd-client-config=R_CCU_SDConfig
      5 x someip required event group:
        Required_NewEventGroup: event-group=SelfDiagnosis_Someip/NewEventGroup
        Required_NewEventGroup{1..3}: event-group=SelfDiagnosis_Someip/NewEventGroup{1..3}
        Required_NewEventGroup5: event-group=SelfDiagnosis_Someip/NewEventGroup5
    R_Vehicle_SDE_SelfDiagnosis: service-interface-deployment=SelfDiagnosis_Someip, required-service-instance-id=ANY, sd-client-config=R_CCU_SDConfig
      5 x someip required event group:
        Required_NewEventGroup: event-group=SelfDiagnosis_Someip/NewEventGroup
        Required_NewEventGroup{1..3}: event-group=SelfDiagnosis_Someip/NewEventGroup{1..3}
        Required_NewEventGroup5: event-group=SelfDiagnosis_Someip/NewEventGroup5
    R_Vehicle_SDE_SelfDiagnosis: service-interface-deployment=SelfDiagnosis_Someip, required-service-instance-id=ANY, sd-client-config=R_CCU_SDConfig
      5 x someip required event group:
        Required_NewEventGroup: event-group=SelfDiagnosis_Someip/NewEventGroup
        Required_NewEventGroup{1..3}: event-group=SelfDiagnosis_Someip/NewEventGroup{1..3}
        Required_NewEventGroup5: event-group=SelfDiagnosis_Someip/NewEventGroup5
    R_Vehicle_SDE_SelfDiagnosis: service-interface-deployment=SelfDiagnosis_Someip, required-service-instance-id=ANY, sd-client-config=R_CCU_SDConfig
      5 x someip required event group:
        Required_NewEventGroup: event-group=SelfDiagnosis_Someip/NewEventGroup
        Required_NewEventGroup{1..3}: event-group=SelfDiagnosis_Someip/NewEventGroup{1..3}
        Required_NewEventGroup5: event-group=SelfDiagnosis_Someip/NewEventGroup5
    R_Vehicle_SDE_SelfDiagnosis: service-interface-deployment=SelfDiagnosis_Someip, required-service-instance-id=ANY, sd-client-config=R_CCU_SDConfig
      5 x someip required event group:
        Required_NewEventGroup: event-group=SelfDiagnosis_Someip/NewEventGroup
        Required_NewEventGroup{1..3}: event-group=SelfDiagnosis_Someip/NewEventGroup{1..3}
        Required_NewEventGroup5: event-group=SelfDiagnosis_Someip/NewEventGroup5
    R_Vehicle_SDE_SelfDiagnosis: service-interface-deployment=SelfDiagnosis_Someip, required-service-instance-id=ANY, sd-client-config=R_CCU_SDConfig
      5 x someip required event group:
        Required_NewEventGroup: event-group=SelfDiagnosis_Someip/NewEventGroup
        Required_NewEventGroup{1..3}: event-group=SelfDiagnosis_Someip/NewEventGroup{1..3}
        Required_NewEventGroup5: event-group=SelfDiagnosis_Someip/NewEventGroup5
    R_Vehicle_SDE_SelfDiagnosis: service-interface-deployment=SelfDiagnosis_Someip, required-service-instance-id=ANY, sd-client-config=R_CCU_SDConfig
      5 x someip required event group:
        Required_NewEventGroup: event-group=SelfDiagnosis_Someip/NewEventGroup
        Required_NewEventGroup{1..3}: event-group=SelfDiagnosis_Someip/NewEventGroup{1..3}
        Required_NewEventGroup5: event-group=SelfDiagnosis_Someip/NewEventGroup5
    R_Vehicle_SDE_SelfDiagnosis: service-interface-deployment=SelfDiagnosis_Someip, required-service-instance-id=ANY, sd-client-config=R_CCU_SDConfig
      5 x someip required event group:
        Required_NewEventGroup: event-group=SelfDiagnosis_Someip/NewEventGroup
        Required_NewEventGroup{1..3}: event-group=SelfDiagnosis_Someip/NewEventGroup{1..3}
        Required_NewEventGroup5: event-group=SelfDiagnosis_Someip/NewEventGroup5
    R_Vehicle_SDE_SelfDiagnosis: service-interface-deployment=SelfDiagnosis_Someip, required-service-instance-id=ANY, sd-client-config=R_CCU_SDConfig
      5 x someip required event group:
        Required_NewEventGroup: event-group=SelfDiagnosis_Someip/NewEventGroup
        Required_NewEventGroup{1..3}: event-group=SelfDiagnosis_Someip/NewEventGroup{1..3}
        Required_NewEventGroup5: event-group=SelfDiagnosis_Someip/NewEventGroup5
    R_Vehicle_SDE_SelfDiagnosis: service-interface-deployment=SelfDiagnosis_Someip, required-service-instance-id=ANY, sd-client-config=R_CCU_SDConfig
      5 x someip required event group:
        Required_NewEventGroup: event-group=SelfDiagnosis_Someip/NewEventGroup
        Required_NewEventGroup{1..3}: event-group=SelfDiagnosis_Someip/NewEventGroup{1..3}
        Required_NewEventGroup5: event-group=SelfDiagnosis_Someip/NewEventGroup5
    R_Vehicle_SDE_SelfDiagnosis: service-interface-deployment=SelfDiagnosis_Someip, required-service-instance-id=ANY, sd-client-config=R_CCU_SDConfig
      5 x someip required event group:
        Required_NewEventGroup: event-group=SelfDiagnosis_Someip/NewEventGroup
        Required_NewEventGroup{1..3}: event-group=SelfDiagnosis_Someip/NewEventGroup{1..3}
        Required_NewEventGroup5: event-group=SelfDiagnosis_Someip/NewEventGroup5
    R_Vehicle_SDE_SelfDiagnosis: service-interface-deployment=SelfDiagnosis_Someip, required-service-instance-id=ANY, sd-client-config=R_CCU_SDConfig
      5 x someip required event group:
        Required_NewEventGroup: event-group=SelfDiagnosis_Someip/NewEventGroup
        Required_NewEventGroup{1..3}: event-group=SelfDiagnosis_Someip/NewEventGroup{1..3}
        Required_NewEventGroup5: event-group=SelfDiagnosis_Someip/NewEventGroup5
    R_Vehicle_SDE_SelfDiagnosis: service-interface-deployment=SelfDiagnosis_Someip, required-service-instance-id=ANY, sd-client-config=R_CCU_SDConfig
      5 x someip required event group:
        Required_NewEventGroup: event-group=SelfDiagnosis_Someip/NewEventGroup
        Required_NewEventGroup{1..3}: event-group=SelfDiagnosis_Someip/NewEventGroup{1..3}
        Required_NewEventGroup5: event-group=SelfDiagnosis_Someip/NewEventGroup5
    R_Vehicle_SM_StateManager: service-interface-deployment=StateManager_Someip, required-service-instance-id=ANY, sd-client-config=R_CCU_SDConfig
      someip required event group Required_NewEventGroup: event-group=StateManager_Someip/NewEventGroup
      someip required event group Required_NewEventGroup1: event-group=StateManager_Someip/NewEventGroup1
      someip required event group Required_NewEventGroup2: event-group=StateManager_Someip/NewEventGroup2
    R_Vehicle_SM_StateManager: service-interface-deployment=StateManager_Someip, required-service-instance-id=ANY, sd-client-config=R_CCU_SDConfig
      someip required event group Required_NewEventGroup: event-group=StateManager_Someip/NewEventGroup
      someip required event group Required_NewEventGroup1: event-group=StateManager_Someip/NewEventGroup1
      someip required event group Required_NewEventGroup2: event-group=StateManager_Someip/NewEventGroup2
    R_Vehicle_SM_StateManager: service-interface-deployment=StateManager_Someip, required-service-instance-id=ANY, sd-client-config=R_CCU_SDConfig
      someip required event group Required_NewEventGroup: event-group=StateManager_Someip/NewEventGroup
      someip required event group Required_NewEventGroup1: event-group=StateManager_Someip/NewEventGroup1
      someip required event group Required_NewEventGroup2: event-group=StateManager_Someip/NewEventGroup2
    R_Vehicle_SM_StateManager: service-interface-deployment=StateManager_Someip, required-service-instance-id=ANY, sd-client-config=R_CCU_SDConfig
      someip required event group Required_NewEventGroup: event-group=StateManager_Someip/NewEventGroup
      someip required event group Required_NewEventGroup1: event-group=StateManager_Someip/NewEventGroup1
      someip required event group Required_NewEventGroup2: event-group=StateManager_Someip/NewEventGroup2
    R_Vehicle_SM_StateManager: service-interface-deployment=StateManager_Someip, required-service-instance-id=ANY, sd-client-config=R_CCU_SDConfig
      someip required event group Required_NewEventGroup: event-group=StateManager_Someip/NewEventGroup
      someip required event group Required_NewEventGroup1: event-group=StateManager_Someip/NewEventGroup1
      someip required event group Required_NewEventGroup2: event-group=StateManager_Someip/NewEventGroup2
    R_Vehicle_SM_StateManager: service-interface-deployment=StateManager_Someip, required-service-instance-id=ANY, sd-client-config=R_CCU_SDConfig
      someip required event group Required_NewEventGroup: event-group=StateManager_Someip/NewEventGroup
      someip required event group Required_NewEventGroup1: event-group=StateManager_Someip/NewEventGroup1
      someip required event group Required_NewEventGroup2: event-group=StateManager_Someip/NewEventGroup2
    R_Vehicle_SM_StateManager: service-interface-deployment=StateManager_Someip, required-service-instance-id=ANY, sd-client-config=R_CCU_SDConfig
      someip required event group Required_NewEventGroup: event-group=StateManager_Someip/NewEventGroup
      someip required event group Required_NewEventGroup1: event-group=StateManager_Someip/NewEventGroup1
      someip required event group Required_NewEventGroup2: event-group=StateManager_Someip/NewEventGroup2
    R_Vehicle_SM_StateManager: service-interface-deployment=StateManager_Someip, required-service-instance-id=ANY, sd-client-config=R_CCU_SDConfig
      someip required event group Required_NewEventGroup: event-group=StateManager_Someip/NewEventGroup
      someip required event group Required_NewEventGroup1: event-group=StateManager_Someip/NewEventGroup1
      someip required event group Required_NewEventGroup2: event-group=StateManager_Someip/NewEventGroup2
    R_Vehicle_SM_StateManager: service-interface-deployment=StateManager_Someip, required-service-instance-id=ANY, sd-client-config=R_CCU_SDConfig
      someip required event group Required_NewEventGroup: event-group=StateManager_Someip/NewEventGroup
      someip required event group Required_NewEventGroup1: event-group=StateManager_Someip/NewEventGroup1
      someip required event group Required_NewEventGroup2: event-group=StateManager_Someip/NewEventGroup2
    R_Vehicle_SM_StateManager: service-interface-deployment=StateManager_Someip, required-service-instance-id=ANY, sd-client-config=R_CCU_SDConfig
      someip required event group Required_NewEventGroup: event-group=StateManager_Someip/NewEventGroup
      someip required event group Required_NewEventGroup1: event-group=StateManager_Someip/NewEventGroup1
      someip required event group Required_NewEventGroup2: event-group=StateManager_Someip/NewEventGroup2
    R_Vehicle_SM_StateManager: service-interface-deployment=StateManager_Someip, required-service-instance-id=ANY, sd-client-config=R_CCU_SDConfig
      someip required event group Required_NewEventGroup: event-group=StateManager_Someip/NewEventGroup
      someip required event group Required_NewEventGroup1: event-group=StateManager_Someip/NewEventGroup1
      someip required event group Required_NewEventGroup2: event-group=StateManager_Someip/NewEventGroup2
    R_Vehicle_SM_StateManager: service-interface-deployment=StateManager_Someip, required-service-instance-id=ANY, sd-client-config=R_CCU_SDConfig
      someip required event group Required_NewEventGroup: event-group=StateManager_Someip/NewEventGroup
      someip required event group Required_NewEventGroup1: event-group=StateManager_Someip/NewEventGroup1
      someip required event group Required_NewEventGroup2: event-group=StateManager_Someip/NewEventGroup2
    R_Vehicle_SM_StateManager: service-interface-deployment=StateManager_Someip, required-service-instance-id=ANY, sd-client-config=R_CCU_SDConfig
      someip required event group Required_NewEventGroup: event-group=StateManager_Someip/NewEventGroup
      someip required event group Required_NewEventGroup1: event-group=StateManager_Someip/NewEventGroup1
      someip required event group Required_NewEventGroup2: event-group=StateManager_Someip/NewEventGroup2
    R_Vehicle_SM_StateManager: service-interface-deployment=StateManager_Someip, required-service-instance-id=ANY, sd-client-config=R_CCU_SDConfig
      someip required event group Required_NewEventGroup: event-group=StateManager_Someip/NewEventGroup
      someip required event group Required_NewEventGroup1: event-group=StateManager_Someip/NewEventGroup1
      someip required event group Required_NewEventGroup2: event-group=StateManager_Someip/NewEventGroup2
    R_Vehicle_SM_StateManager: service-interface-deployment=StateManager_Someip, required-service-instance-id=ANY, sd-client-config=R_CCU_SDConfig
      someip required event group Required_NewEventGroup: event-group=StateManager_Someip/NewEventGroup
      someip required event group Required_NewEventGroup1: event-group=StateManager_Someip/NewEventGroup1
      someip required event group Required_NewEventGroup2: event-group=StateManager_Someip/NewEventGroup2
    R_Vehicle_SM_StateManager: service-interface-deployment=StateManager_Someip, required-service-instance-id=ANY, sd-client-config=R_CCU_SDConfig
      someip required event group Required_NewEventGroup: event-group=StateManager_Someip/NewEventGroup
      someip required event group Required_NewEventGroup1: event-group=StateManager_Someip/NewEventGroup1
      someip required event group Required_NewEventGroup2: event-group=StateManager_Someip/NewEventGroup2
    R_Vehicle_SM_StateManager: service-interface-deployment=StateManager_Someip, required-service-instance-id=ANY, sd-client-config=R_CCU_SDConfig
      someip required event group Required_NewEventGroup: event-group=StateManager_Someip/NewEventGroup
      someip required event group Required_NewEventGroup1: event-group=StateManager_Someip/NewEventGroup1
      someip required event group Required_NewEventGroup2: event-group=StateManager_Someip/NewEventGroup2
    R_Vehicle_SM_StateManager: service-interface-deployment=StateManager_Someip, required-service-instance-id=ANY, sd-client-config=R_CCU_SDConfig
      someip required event group Required_NewEventGroup: event-group=StateManager_Someip/NewEventGroup
      someip required event group Required_NewEventGroup1: event-group=StateManager_Someip/NewEventGroup1
      someip required event group Required_NewEventGroup2: event-group=StateManager_Someip/NewEventGroup2
    R_Vehicle_SM_StateManager: service-interface-deployment=StateManager_Someip, required-service-instance-id=ANY, sd-client-config=R_CCU_SDConfig
      someip required event group Required_NewEventGroup: event-group=StateManager_Someip/NewEventGroup
      someip required event group Required_NewEventGroup1: event-group=StateManager_Someip/NewEventGroup1
      someip required event group Required_NewEventGroup2: event-group=StateManager_Someip/NewEventGroup2
    R_Vehicle_SM_StateManager: service-interface-deployment=StateManager_Someip, required-service-instance-id=ANY, sd-client-config=R_CCU_SDConfig
      someip required event group Required_NewEventGroup: event-group=StateManager_Someip/NewEventGroup
      someip required event group Required_NewEventGroup1: event-group=StateManager_Someip/NewEventGroup1
      someip required event group Required_NewEventGroup2: event-group=StateManager_Someip/NewEventGroup2
    R_Vehicle_SM_StateManager: service-interface-deployment=StateManager_Someip, required-service-instance-id=ANY, sd-client-config=R_CCU_SDConfig
      someip required event group Required_NewEventGroup: event-group=StateManager_Someip/NewEventGroup
      someip required event group Required_NewEventGroup1: event-group=StateManager_Someip/NewEventGroup1
      someip required event group Required_NewEventGroup2: event-group=StateManager_Someip/NewEventGroup2
    R_Vehicle_SM_StateManager: service-interface-deployment=StateManager_Someip, required-service-instance-id=ANY, sd-client-config=R_CCU_SDConfig
      someip required event group Required_NewEventGroup: event-group=StateManager_Someip/NewEventGroup
      someip required event group Required_NewEventGroup1: event-group=StateManager_Someip/NewEventGroup1
      someip required event group Required_NewEventGroup2: event-group=StateManager_Someip/NewEventGroup2
    R_Vehicle_SM_StateManager: service-interface-deployment=StateManager_Someip, required-service-instance-id=ANY, sd-client-config=R_CCU_SDConfig
      someip required event group Required_NewEventGroup: event-group=StateManager_Someip/NewEventGroup
      someip required event group Required_NewEventGroup1: event-group=StateManager_Someip/NewEventGroup1
      someip required event group Required_NewEventGroup2: event-group=StateManager_Someip/NewEventGroup2
    R_Vehicle_SM_StateManager: service-interface-deployment=StateManager_Someip, required-service-instance-id=ANY, sd-client-config=R_CCU_SDConfig
      someip required event group Required_NewEventGroup: event-group=StateManager_Someip/NewEventGroup
      someip required event group Required_NewEventGroup1: event-group=StateManager_Someip/NewEventGroup1
      someip required event group Required_NewEventGroup2: event-group=StateManager_Someip/NewEventGroup2
    R_Vehicle_SM_StateManager: service-interface-deployment=StateManager_Someip, required-service-instance-id=ANY, sd-client-config=R_CCU_SDConfig
      someip required event group Required_NewEventGroup: event-group=StateManager_Someip/NewEventGroup
      someip required event group Required_NewEventGroup1: event-group=StateManager_Someip/NewEventGroup1
      someip required event group Required_NewEventGroup2: event-group=StateManager_Someip/NewEventGroup2
    R_Vehicle_SM_StateManager: service-interface-deployment=StateManager_Someip, required-service-instance-id=ANY, sd-client-config=R_CCU_SDConfig
      someip required event group Required_NewEventGroup: event-group=StateManager_Someip/NewEventGroup
      someip required event group Required_NewEventGroup1: event-group=StateManager_Someip/NewEventGroup1
      someip required event group Required_NewEventGroup2: event-group=StateManager_Someip/NewEventGroup2
    R_Vehicle_SOAAdaptor_Body1: service-interface-deployment=Body1_Someip, required-service-instance-id=ANY, sd-client-config=R_CCU_SDConfig
      216 x someip required event group:
        Required_NewEventGroup: event-group=Body1_Someip/NewEventGroup
        Required_NewEventGroup1: event-group=Body1_Someip/NewEventGroup1
        Required_NewEventGroup10: event-group=Body1_Someip/NewEventGroup10
        Required_NewEventGroup{100..109}: event-group=Body1_Someip/NewEventGroup{100..109}
        Required_NewEventGroup11: event-group=Body1_Someip/NewEventGroup11
        Required_NewEventGroup{110..119}: event-group=Body1_Someip/NewEventGroup{110..119}
        Required_NewEventGroup12: event-group=Body1_Someip/NewEventGroup12
        Required_NewEventGroup{120..129}: event-group=Body1_Someip/NewEventGroup{120..129}
        Required_NewEventGroup13: event-group=Body1_Someip/NewEventGroup13
        Required_NewEventGroup{130..139}: event-group=Body1_Someip/NewEventGroup{130..139}
        Required_NewEventGroup14: event-group=Body1_Someip/NewEventGroup14
        Required_NewEventGroup{140..149}: event-group=Body1_Someip/NewEventGroup{140..149}
        Required_NewEventGroup15: event-group=Body1_Someip/NewEventGroup15
        Required_NewEventGroup{150..159}: event-group=Body1_Someip/NewEventGroup{150..159}
        Required_NewEventGroup16: event-group=Body1_Someip/NewEventGroup16
        Required_NewEventGroup{160..169}: event-group=Body1_Someip/NewEventGroup{160..169}
        Required_NewEventGroup17: event-group=Body1_Someip/NewEventGroup17
        Required_NewEventGroup{170..179}: event-group=Body1_Someip/NewEventGroup{170..179}
        Required_NewEventGroup18: event-group=Body1_Someip/NewEventGroup18
        Required_NewEventGroup{180..189}: event-group=Body1_Someip/NewEventGroup{180..189}
        Required_NewEventGroup19: event-group=Body1_Someip/NewEventGroup19
        Required_NewEventGroup{190..199}: event-group=Body1_Someip/NewEventGroup{190..199}
        Required_NewEventGroup2: event-group=Body1_Someip/NewEventGroup2
        Required_NewEventGroup20: event-group=Body1_Someip/NewEventGroup20
        Required_NewEventGroup{200..209}: event-group=Body1_Someip/NewEventGroup{200..209}
        Required_NewEventGroup21: event-group=Body1_Someip/NewEventGroup21
        Required_NewEventGroup{210..215}: event-group=Body1_Someip/NewEventGroup{210..215}
        Required_NewEventGroup{22..29}: event-group=Body1_Someip/NewEventGroup{22..29}
        Required_NewEventGroup3: event-group=Body1_Someip/NewEventGroup3
        Required_NewEventGroup{30..39}: event-group=Body1_Someip/NewEventGroup{30..39}
        Required_NewEventGroup4: event-group=Body1_Someip/NewEventGroup4
        Required_NewEventGroup{40..49}: event-group=Body1_Someip/NewEventGroup{40..49}
        Required_NewEventGroup5: event-group=Body1_Someip/NewEventGroup5
        Required_NewEventGroup{50..59}: event-group=Body1_Someip/NewEventGroup{50..59}
        Required_NewEventGroup6: event-group=Body1_Someip/NewEventGroup6
        Required_NewEventGroup{60..69}: event-group=Body1_Someip/NewEventGroup{60..69}
        Required_NewEventGroup7: event-group=Body1_Someip/NewEventGroup7
        Required_NewEventGroup{70..79}: event-group=Body1_Someip/NewEventGroup{70..79}
        Required_NewEventGroup8: event-group=Body1_Someip/NewEventGroup8
        Required_NewEventGroup{80..89}: event-group=Body1_Someip/NewEventGroup{80..89}
        Required_NewEventGroup9: event-group=Body1_Someip/NewEventGroup9
        Required_NewEventGroup{90..99}: event-group=Body1_Someip/NewEventGroup{90..99}
    R_Vehicle_SOAAdaptor_Body1: service-interface-deployment=Body1_Someip, required-service-instance-id=ANY, sd-client-config=R_CCU_SDConfig
      216 x someip required event group:
        Required_NewEventGroup: event-group=Body1_Someip/NewEventGroup
        Required_NewEventGroup1: event-group=Body1_Someip/NewEventGroup1
        Required_NewEventGroup10: event-group=Body1_Someip/NewEventGroup10
        Required_NewEventGroup{100..109}: event-group=Body1_Someip/NewEventGroup{100..109}
        Required_NewEventGroup11: event-group=Body1_Someip/NewEventGroup11
        Required_NewEventGroup{110..119}: event-group=Body1_Someip/NewEventGroup{110..119}
        Required_NewEventGroup12: event-group=Body1_Someip/NewEventGroup12
        Required_NewEventGroup{120..129}: event-group=Body1_Someip/NewEventGroup{120..129}
        Required_NewEventGroup13: event-group=Body1_Someip/NewEventGroup13
        Required_NewEventGroup{130..139}: event-group=Body1_Someip/NewEventGroup{130..139}
        Required_NewEventGroup14: event-group=Body1_Someip/NewEventGroup14
        Required_NewEventGroup{140..149}: event-group=Body1_Someip/NewEventGroup{140..149}
        Required_NewEventGroup15: event-group=Body1_Someip/NewEventGroup15
        Required_NewEventGroup{150..159}: event-group=Body1_Someip/NewEventGroup{150..159}
        Required_NewEventGroup16: event-group=Body1_Someip/NewEventGroup16
        Required_NewEventGroup{160..169}: event-group=Body1_Someip/NewEventGroup{160..169}
        Required_NewEventGroup17: event-group=Body1_Someip/NewEventGroup17
        Required_NewEventGroup{170..179}: event-group=Body1_Someip/NewEventGroup{170..179}
        Required_NewEventGroup18: event-group=Body1_Someip/NewEventGroup18
        Required_NewEventGroup{180..189}: event-group=Body1_Someip/NewEventGroup{180..189}
        Required_NewEventGroup19: event-group=Body1_Someip/NewEventGroup19
        Required_NewEventGroup{190..199}: event-group=Body1_Someip/NewEventGroup{190..199}
        Required_NewEventGroup2: event-group=Body1_Someip/NewEventGroup2
        Required_NewEventGroup20: event-group=Body1_Someip/NewEventGroup20
        Required_NewEventGroup{200..209}: event-group=Body1_Someip/NewEventGroup{200..209}
        Required_NewEventGroup21: event-group=Body1_Someip/NewEventGroup21
        Required_NewEventGroup{210..215}: event-group=Body1_Someip/NewEventGroup{210..215}
        Required_NewEventGroup{22..29}: event-group=Body1_Someip/NewEventGroup{22..29}
        Required_NewEventGroup3: event-group=Body1_Someip/NewEventGroup3
        Required_NewEventGroup{30..39}: event-group=Body1_Someip/NewEventGroup{30..39}
        Required_NewEventGroup4: event-group=Body1_Someip/NewEventGroup4
        Required_NewEventGroup{40..49}: event-group=Body1_Someip/NewEventGroup{40..49}
        Required_NewEventGroup5: event-group=Body1_Someip/NewEventGroup5
        Required_NewEventGroup{50..59}: event-group=Body1_Someip/NewEventGroup{50..59}
        Required_NewEventGroup6: event-group=Body1_Someip/NewEventGroup6
        Required_NewEventGroup{60..69}: event-group=Body1_Someip/NewEventGroup{60..69}
        Required_NewEventGroup7: event-group=Body1_Someip/NewEventGroup7
        Required_NewEventGroup{70..79}: event-group=Body1_Someip/NewEventGroup{70..79}
        Required_NewEventGroup8: event-group=Body1_Someip/NewEventGroup8
        Required_NewEventGroup{80..89}: event-group=Body1_Someip/NewEventGroup{80..89}
        Required_NewEventGroup9: event-group=Body1_Someip/NewEventGroup9
        Required_NewEventGroup{90..99}: event-group=Body1_Someip/NewEventGroup{90..99}
    R_Vehicle_SOAAdaptor_Body1: service-interface-deployment=Body1_Someip, required-service-instance-id=ANY, sd-client-config=R_CCU_SDConfig
      216 x someip required event group:
        Required_NewEventGroup: event-group=Body1_Someip/NewEventGroup
        Required_NewEventGroup1: event-group=Body1_Someip/NewEventGroup1
        Required_NewEventGroup10: event-group=Body1_Someip/NewEventGroup10
        Required_NewEventGroup{100..109}: event-group=Body1_Someip/NewEventGroup{100..109}
        Required_NewEventGroup11: event-group=Body1_Someip/NewEventGroup11
        Required_NewEventGroup{110..119}: event-group=Body1_Someip/NewEventGroup{110..119}
        Required_NewEventGroup12: event-group=Body1_Someip/NewEventGroup12
        Required_NewEventGroup{120..129}: event-group=Body1_Someip/NewEventGroup{120..129}
        Required_NewEventGroup13: event-group=Body1_Someip/NewEventGroup13
        Required_NewEventGroup{130..139}: event-group=Body1_Someip/NewEventGroup{130..139}
        Required_NewEventGroup14: event-group=Body1_Someip/NewEventGroup14
        Required_NewEventGroup{140..149}: event-group=Body1_Someip/NewEventGroup{140..149}
        Required_NewEventGroup15: event-group=Body1_Someip/NewEventGroup15
        Required_NewEventGroup{150..159}: event-group=Body1_Someip/NewEventGroup{150..159}
        Required_NewEventGroup16: event-group=Body1_Someip/NewEventGroup16
        Required_NewEventGroup{160..169}: event-group=Body1_Someip/NewEventGroup{160..169}
        Required_NewEventGroup17: event-group=Body1_Someip/NewEventGroup17
        Required_NewEventGroup{170..179}: event-group=Body1_Someip/NewEventGroup{170..179}
        Required_NewEventGroup18: event-group=Body1_Someip/NewEventGroup18
        Required_NewEventGroup{180..189}: event-group=Body1_Someip/NewEventGroup{180..189}
        Required_NewEventGroup19: event-group=Body1_Someip/NewEventGroup19
        Required_NewEventGroup{190..199}: event-group=Body1_Someip/NewEventGroup{190..199}
        Required_NewEventGroup2: event-group=Body1_Someip/NewEventGroup2
        Required_NewEventGroup20: event-group=Body1_Someip/NewEventGroup20
        Required_NewEventGroup{200..209}: event-group=Body1_Someip/NewEventGroup{200..209}
        Required_NewEventGroup21: event-group=Body1_Someip/NewEventGroup21
        Required_NewEventGroup{210..215}: event-group=Body1_Someip/NewEventGroup{210..215}
        Required_NewEventGroup{22..29}: event-group=Body1_Someip/NewEventGroup{22..29}
        Required_NewEventGroup3: event-group=Body1_Someip/NewEventGroup3
        Required_NewEventGroup{30..39}: event-group=Body1_Someip/NewEventGroup{30..39}
        Required_NewEventGroup4: event-group=Body1_Someip/NewEventGroup4
        Required_NewEventGroup{40..49}: event-group=Body1_Someip/NewEventGroup{40..49}
        Required_NewEventGroup5: event-group=Body1_Someip/NewEventGroup5
        Required_NewEventGroup{50..59}: event-group=Body1_Someip/NewEventGroup{50..59}
        Required_NewEventGroup6: event-group=Body1_Someip/NewEventGroup6
        Required_NewEventGroup{60..69}: event-group=Body1_Someip/NewEventGroup{60..69}
        Required_NewEventGroup7: event-group=Body1_Someip/NewEventGroup7
        Required_NewEventGroup{70..79}: event-group=Body1_Someip/NewEventGroup{70..79}
        Required_NewEventGroup8: event-group=Body1_Someip/NewEventGroup8
        Required_NewEventGroup{80..89}: event-group=Body1_Someip/NewEventGroup{80..89}
        Required_NewEventGroup9: event-group=Body1_Someip/NewEventGroup9
        Required_NewEventGroup{90..99}: event-group=Body1_Someip/NewEventGroup{90..99}
    R_Vehicle_SOAAdaptor_Body1: service-interface-deployment=Body1_Someip, required-service-instance-id=ANY, sd-client-config=R_CCU_SDConfig
      216 x someip required event group:
        Required_NewEventGroup: event-group=Body1_Someip/NewEventGroup
        Required_NewEventGroup1: event-group=Body1_Someip/NewEventGroup1
        Required_NewEventGroup10: event-group=Body1_Someip/NewEventGroup10
        Required_NewEventGroup{100..109}: event-group=Body1_Someip/NewEventGroup{100..109}
        Required_NewEventGroup11: event-group=Body1_Someip/NewEventGroup11
        Required_NewEventGroup{110..119}: event-group=Body1_Someip/NewEventGroup{110..119}
        Required_NewEventGroup12: event-group=Body1_Someip/NewEventGroup12
        Required_NewEventGroup{120..129}: event-group=Body1_Someip/NewEventGroup{120..129}
        Required_NewEventGroup13: event-group=Body1_Someip/NewEventGroup13
        Required_NewEventGroup{130..139}: event-group=Body1_Someip/NewEventGroup{130..139}
        Required_NewEventGroup14: event-group=Body1_Someip/NewEventGroup14
        Required_NewEventGroup{140..149}: event-group=Body1_Someip/NewEventGroup{140..149}
        Required_NewEventGroup15: event-group=Body1_Someip/NewEventGroup15
        Required_NewEventGroup{150..159}: event-group=Body1_Someip/NewEventGroup{150..159}
        Required_NewEventGroup16: event-group=Body1_Someip/NewEventGroup16
        Required_NewEventGroup{160..169}: event-group=Body1_Someip/NewEventGroup{160..169}
        Required_NewEventGroup17: event-group=Body1_Someip/NewEventGroup17
        Required_NewEventGroup{170..179}: event-group=Body1_Someip/NewEventGroup{170..179}
        Required_NewEventGroup18: event-group=Body1_Someip/NewEventGroup18
        Required_NewEventGroup{180..189}: event-group=Body1_Someip/NewEventGroup{180..189}
        Required_NewEventGroup19: event-group=Body1_Someip/NewEventGroup19
        Required_NewEventGroup{190..199}: event-group=Body1_Someip/NewEventGroup{190..199}
        Required_NewEventGroup2: event-group=Body1_Someip/NewEventGroup2
        Required_NewEventGroup20: event-group=Body1_Someip/NewEventGroup20
        Required_NewEventGroup{200..209}: event-group=Body1_Someip/NewEventGroup{200..209}
        Required_NewEventGroup21: event-group=Body1_Someip/NewEventGroup21
        Required_NewEventGroup{210..215}: event-group=Body1_Someip/NewEventGroup{210..215}
        Required_NewEventGroup{22..29}: event-group=Body1_Someip/NewEventGroup{22..29}
        Required_NewEventGroup3: event-group=Body1_Someip/NewEventGroup3
        Required_NewEventGroup{30..39}: event-group=Body1_Someip/NewEventGroup{30..39}
        Required_NewEventGroup4: event-group=Body1_Someip/NewEventGroup4
        Required_NewEventGroup{40..49}: event-group=Body1_Someip/NewEventGroup{40..49}
        Required_NewEventGroup5: event-group=Body1_Someip/NewEventGroup5
        Required_NewEventGroup{50..59}: event-group=Body1_Someip/NewEventGroup{50..59}
        Required_NewEventGroup6: event-group=Body1_Someip/NewEventGroup6
        Required_NewEventGroup{60..69}: event-group=Body1_Someip/NewEventGroup{60..69}
        Required_NewEventGroup7: event-group=Body1_Someip/NewEventGroup7
        Required_NewEventGroup{70..79}: event-group=Body1_Someip/NewEventGroup{70..79}
        Required_NewEventGroup8: event-group=Body1_Someip/NewEventGroup8
        Required_NewEventGroup{80..89}: event-group=Body1_Someip/NewEventGroup{80..89}
        Required_NewEventGroup9: event-group=Body1_Someip/NewEventGroup9
        Required_NewEventGroup{90..99}: event-group=Body1_Someip/NewEventGroup{90..99}
    R_Vehicle_SOAAdaptor_Body1: service-interface-deployment=Body1_Someip, required-service-instance-id=ANY, sd-client-config=R_CCU_SDConfig
      216 x someip required event group:
        Required_NewEventGroup: event-group=Body1_Someip/NewEventGroup
        Required_NewEventGroup1: event-group=Body1_Someip/NewEventGroup1
        Required_NewEventGroup10: event-group=Body1_Someip/NewEventGroup10
        Required_NewEventGroup{100..109}: event-group=Body1_Someip/NewEventGroup{100..109}
        Required_NewEventGroup11: event-group=Body1_Someip/NewEventGroup11
        Required_NewEventGroup{110..119}: event-group=Body1_Someip/NewEventGroup{110..119}
        Required_NewEventGroup12: event-group=Body1_Someip/NewEventGroup12
        Required_NewEventGroup{120..129}: event-group=Body1_Someip/NewEventGroup{120..129}
        Required_NewEventGroup13: event-group=Body1_Someip/NewEventGroup13
        Required_NewEventGroup{130..139}: event-group=Body1_Someip/NewEventGroup{130..139}
        Required_NewEventGroup14: event-group=Body1_Someip/NewEventGroup14
        Required_NewEventGroup{140..149}: event-group=Body1_Someip/NewEventGroup{140..149}
        Required_NewEventGroup15: event-group=Body1_Someip/NewEventGroup15
        Required_NewEventGroup{150..159}: event-group=Body1_Someip/NewEventGroup{150..159}
        Required_NewEventGroup16: event-group=Body1_Someip/NewEventGroup16
        Required_NewEventGroup{160..169}: event-group=Body1_Someip/NewEventGroup{160..169}
        Required_NewEventGroup17: event-group=Body1_Someip/NewEventGroup17
        Required_NewEventGroup{170..179}: event-group=Body1_Someip/NewEventGroup{170..179}
        Required_NewEventGroup18: event-group=Body1_Someip/NewEventGroup18
        Required_NewEventGroup{180..189}: event-group=Body1_Someip/NewEventGroup{180..189}
        Required_NewEventGroup19: event-group=Body1_Someip/NewEventGroup19
        Required_NewEventGroup{190..199}: event-group=Body1_Someip/NewEventGroup{190..199}
        Required_NewEventGroup2: event-group=Body1_Someip/NewEventGroup2
        Required_NewEventGroup20: event-group=Body1_Someip/NewEventGroup20
        Required_NewEventGroup{200..209}: event-group=Body1_Someip/NewEventGroup{200..209}
        Required_NewEventGroup21: event-group=Body1_Someip/NewEventGroup21
        Required_NewEventGroup{210..215}: event-group=Body1_Someip/NewEventGroup{210..215}
        Required_NewEventGroup{22..29}: event-group=Body1_Someip/NewEventGroup{22..29}
        Required_NewEventGroup3: event-group=Body1_Someip/NewEventGroup3
        Required_NewEventGroup{30..39}: event-group=Body1_Someip/NewEventGroup{30..39}
        Required_NewEventGroup4: event-group=Body1_Someip/NewEventGroup4
        Required_NewEventGroup{40..49}: event-group=Body1_Someip/NewEventGroup{40..49}
        Required_NewEventGroup5: event-group=Body1_Someip/NewEventGroup5
        Required_NewEventGroup{50..59}: event-group=Body1_Someip/NewEventGroup{50..59}
        Required_NewEventGroup6: event-group=Body1_Someip/NewEventGroup6
        Required_NewEventGroup{60..69}: event-group=Body1_Someip/NewEventGroup{60..69}
        Required_NewEventGroup7: event-group=Body1_Someip/NewEventGroup7
        Required_NewEventGroup{70..79}: event-group=Body1_Someip/NewEventGroup{70..79}
        Required_NewEventGroup8: event-group=Body1_Someip/NewEventGroup8
        Required_NewEventGroup{80..89}: event-group=Body1_Someip/NewEventGroup{80..89}
        Required_NewEventGroup9: event-group=Body1_Someip/NewEventGroup9
        Required_NewEventGroup{90..99}: event-group=Body1_Someip/NewEventGroup{90..99}
    R_Vehicle_SOAAdaptor_Body1: service-interface-deployment=Body1_Someip, required-service-instance-id=ANY, sd-client-config=R_CCU_SDConfig
      216 x someip required event group:
        Required_NewEventGroup: event-group=Body1_Someip/NewEventGroup
        Required_NewEventGroup1: event-group=Body1_Someip/NewEventGroup1
        Required_NewEventGroup10: event-group=Body1_Someip/NewEventGroup10
        Required_NewEventGroup{100..109}: event-group=Body1_Someip/NewEventGroup{100..109}
        Required_NewEventGroup11: event-group=Body1_Someip/NewEventGroup11
        Required_NewEventGroup{110..119}: event-group=Body1_Someip/NewEventGroup{110..119}
        Required_NewEventGroup12: event-group=Body1_Someip/NewEventGroup12
        Required_NewEventGroup{120..129}: event-group=Body1_Someip/NewEventGroup{120..129}
        Required_NewEventGroup13: event-group=Body1_Someip/NewEventGroup13
        Required_NewEventGroup{130..139}: event-group=Body1_Someip/NewEventGroup{130..139}
        Required_NewEventGroup14: event-group=Body1_Someip/NewEventGroup14
        Required_NewEventGroup{140..149}: event-group=Body1_Someip/NewEventGroup{140..149}
        Required_NewEventGroup15: event-group=Body1_Someip/NewEventGroup15
        Required_NewEventGroup{150..159}: event-group=Body1_Someip/NewEventGroup{150..159}
        Required_NewEventGroup16: event-group=Body1_Someip/NewEventGroup16
        Required_NewEventGroup{160..169}: event-group=Body1_Someip/NewEventGroup{160..169}
        Required_NewEventGroup17: event-group=Body1_Someip/NewEventGroup17
        Required_NewEventGroup{170..179}: event-group=Body1_Someip/NewEventGroup{170..179}
        Required_NewEventGroup18: event-group=Body1_Someip/NewEventGroup18
        Required_NewEventGroup{180..189}: event-group=Body1_Someip/NewEventGroup{180..189}
        Required_NewEventGroup19: event-group=Body1_Someip/NewEventGroup19
        Required_NewEventGroup{190..199}: event-group=Body1_Someip/NewEventGroup{190..199}
        Required_NewEventGroup2: event-group=Body1_Someip/NewEventGroup2
        Required_NewEventGroup20: event-group=Body1_Someip/NewEventGroup20
        Required_NewEventGroup{200..209}: event-group=Body1_Someip/NewEventGroup{200..209}
        Required_NewEventGroup21: event-group=Body1_Someip/NewEventGroup21
        Required_NewEventGroup{210..215}: event-group=Body1_Someip/NewEventGroup{210..215}
        Required_NewEventGroup{22..29}: event-group=Body1_Someip/NewEventGroup{22..29}
        Required_NewEventGroup3: event-group=Body1_Someip/NewEventGroup3
        Required_NewEventGroup{30..39}: event-group=Body1_Someip/NewEventGroup{30..39}
        Required_NewEventGroup4: event-group=Body1_Someip/NewEventGroup4
        Required_NewEventGroup{40..49}: event-group=Body1_Someip/NewEventGroup{40..49}
        Required_NewEventGroup5: event-group=Body1_Someip/NewEventGroup5
        Required_NewEventGroup{50..59}: event-group=Body1_Someip/NewEventGroup{50..59}
        Required_NewEventGroup6: event-group=Body1_Someip/NewEventGroup6
        Required_NewEventGroup{60..69}: event-group=Body1_Someip/NewEventGroup{60..69}
        Required_NewEventGroup7: event-group=Body1_Someip/NewEventGroup7
        Required_NewEventGroup{70..79}: event-group=Body1_Someip/NewEventGroup{70..79}
        Required_NewEventGroup8: event-group=Body1_Someip/NewEventGroup8
        Required_NewEventGroup{80..89}: event-group=Body1_Someip/NewEventGroup{80..89}
        Required_NewEventGroup9: event-group=Body1_Someip/NewEventGroup9
        Required_NewEventGroup{90..99}: event-group=Body1_Someip/NewEventGroup{90..99}
    R_Vehicle_SOAAdaptor_Body1: service-interface-deployment=Body1_Someip, required-service-instance-id=ANY, sd-client-config=R_CCU_SDConfig
      216 x someip required event group:
        Required_NewEventGroup: event-group=Body1_Someip/NewEventGroup
        Required_NewEventGroup1: event-group=Body1_Someip/NewEventGroup1
        Required_NewEventGroup10: event-group=Body1_Someip/NewEventGroup10
        Required_NewEventGroup{100..109}: event-group=Body1_Someip/NewEventGroup{100..109}
        Required_NewEventGroup11: event-group=Body1_Someip/NewEventGroup11
        Required_NewEventGroup{110..119}: event-group=Body1_Someip/NewEventGroup{110..119}
        Required_NewEventGroup12: event-group=Body1_Someip/NewEventGroup12
        Required_NewEventGroup{120..129}: event-group=Body1_Someip/NewEventGroup{120..129}
        Required_NewEventGroup13: event-group=Body1_Someip/NewEventGroup13
        Required_NewEventGroup{130..139}: event-group=Body1_Someip/NewEventGroup{130..139}
        Required_NewEventGroup14: event-group=Body1_Someip/NewEventGroup14
        Required_NewEventGroup{140..149}: event-group=Body1_Someip/NewEventGroup{140..149}
        Required_NewEventGroup15: event-group=Body1_Someip/NewEventGroup15
        Required_NewEventGroup{150..159}: event-group=Body1_Someip/NewEventGroup{150..159}
        Required_NewEventGroup16: event-group=Body1_Someip/NewEventGroup16
        Required_NewEventGroup{160..169}: event-group=Body1_Someip/NewEventGroup{160..169}
        Required_NewEventGroup17: event-group=Body1_Someip/NewEventGroup17
        Required_NewEventGroup{170..179}: event-group=Body1_Someip/NewEventGroup{170..179}
        Required_NewEventGroup18: event-group=Body1_Someip/NewEventGroup18
        Required_NewEventGroup{180..189}: event-group=Body1_Someip/NewEventGroup{180..189}
        Required_NewEventGroup19: event-group=Body1_Someip/NewEventGroup19
        Required_NewEventGroup{190..199}: event-group=Body1_Someip/NewEventGroup{190..199}
        Required_NewEventGroup2: event-group=Body1_Someip/NewEventGroup2
        Required_NewEventGroup20: event-group=Body1_Someip/NewEventGroup20
        Required_NewEventGroup{200..209}: event-group=Body1_Someip/NewEventGroup{200..209}
        Required_NewEventGroup21: event-group=Body1_Someip/NewEventGroup21
        Required_NewEventGroup{210..215}: event-group=Body1_Someip/NewEventGroup{210..215}
        Required_NewEventGroup{22..29}: event-group=Body1_Someip/NewEventGroup{22..29}
        Required_NewEventGroup3: event-group=Body1_Someip/NewEventGroup3
        Required_NewEventGroup{30..39}: event-group=Body1_Someip/NewEventGroup{30..39}
        Required_NewEventGroup4: event-group=Body1_Someip/NewEventGroup4
        Required_NewEventGroup{40..49}: event-group=Body1_Someip/NewEventGroup{40..49}
        Required_NewEventGroup5: event-group=Body1_Someip/NewEventGroup5
        Required_NewEventGroup{50..59}: event-group=Body1_Someip/NewEventGroup{50..59}
        Required_NewEventGroup6: event-group=Body1_Someip/NewEventGroup6
        Required_NewEventGroup{60..69}: event-group=Body1_Someip/NewEventGroup{60..69}
        Required_NewEventGroup7: event-group=Body1_Someip/NewEventGroup7
        Required_NewEventGroup{70..79}: event-group=Body1_Someip/NewEventGroup{70..79}
        Required_NewEventGroup8: event-group=Body1_Someip/NewEventGroup8
        Required_NewEventGroup{80..89}: event-group=Body1_Someip/NewEventGroup{80..89}
        Required_NewEventGroup9: event-group=Body1_Someip/NewEventGroup9
        Required_NewEventGroup{90..99}: event-group=Body1_Someip/NewEventGroup{90..99}
    R_Vehicle_SOAAdaptor_Body1: service-interface-deployment=Body1_Someip, required-service-instance-id=ANY, sd-client-config=R_CCU_SDConfig
      216 x someip required event group:
        Required_NewEventGroup: event-group=Body1_Someip/NewEventGroup
        Required_NewEventGroup1: event-group=Body1_Someip/NewEventGroup1
        Required_NewEventGroup10: event-group=Body1_Someip/NewEventGroup10
        Required_NewEventGroup{100..109}: event-group=Body1_Someip/NewEventGroup{100..109}
        Required_NewEventGroup11: event-group=Body1_Someip/NewEventGroup11
        Required_NewEventGroup{110..119}: event-group=Body1_Someip/NewEventGroup{110..119}
        Required_NewEventGroup12: event-group=Body1_Someip/NewEventGroup12
        Required_NewEventGroup{120..129}: event-group=Body1_Someip/NewEventGroup{120..129}
        Required_NewEventGroup13: event-group=Body1_Someip/NewEventGroup13
        Required_NewEventGroup{130..139}: event-group=Body1_Someip/NewEventGroup{130..139}
        Required_NewEventGroup14: event-group=Body1_Someip/NewEventGroup14
        Required_NewEventGroup{140..149}: event-group=Body1_Someip/NewEventGroup{140..149}
        Required_NewEventGroup15: event-group=Body1_Someip/NewEventGroup15
        Required_NewEventGroup{150..159}: event-group=Body1_Someip/NewEventGroup{150..159}
        Required_NewEventGroup16: event-group=Body1_Someip/NewEventGroup16
        Required_NewEventGroup{160..169}: event-group=Body1_Someip/NewEventGroup{160..169}
        Required_NewEventGroup17: event-group=Body1_Someip/NewEventGroup17
        Required_NewEventGroup{170..179}: event-group=Body1_Someip/NewEventGroup{170..179}
        Required_NewEventGroup18: event-group=Body1_Someip/NewEventGroup18
        Required_NewEventGroup{180..189}: event-group=Body1_Someip/NewEventGroup{180..189}
        Required_NewEventGroup19: event-group=Body1_Someip/NewEventGroup19
        Required_NewEventGroup{190..199}: event-group=Body1_Someip/NewEventGroup{190..199}
        Required_NewEventGroup2: event-group=Body1_Someip/NewEventGroup2
        Required_NewEventGroup20: event-group=Body1_Someip/NewEventGroup20
        Required_NewEventGroup{200..209}: event-group=Body1_Someip/NewEventGroup{200..209}
        Required_NewEventGroup21: event-group=Body1_Someip/NewEventGroup21
        Required_NewEventGroup{210..215}: event-group=Body1_Someip/NewEventGroup{210..215}
        Required_NewEventGroup{22..29}: event-group=Body1_Someip/NewEventGroup{22..29}
        Required_NewEventGroup3: event-group=Body1_Someip/NewEventGroup3
        Required_NewEventGroup{30..39}: event-group=Body1_Someip/NewEventGroup{30..39}
        Required_NewEventGroup4: event-group=Body1_Someip/NewEventGroup4
        Required_NewEventGroup{40..49}: event-group=Body1_Someip/NewEventGroup{40..49}
        Required_NewEventGroup5: event-group=Body1_Someip/NewEventGroup5
        Required_NewEventGroup{50..59}: event-group=Body1_Someip/NewEventGroup{50..59}
        Required_NewEventGroup6: event-group=Body1_Someip/NewEventGroup6
        Required_NewEventGroup{60..69}: event-group=Body1_Someip/NewEventGroup{60..69}
        Required_NewEventGroup7: event-group=Body1_Someip/NewEventGroup7
        Required_NewEventGroup{70..79}: event-group=Body1_Someip/NewEventGroup{70..79}
        Required_NewEventGroup8: event-group=Body1_Someip/NewEventGroup8
        Required_NewEventGroup{80..89}: event-group=Body1_Someip/NewEventGroup{80..89}
        Required_NewEventGroup9: event-group=Body1_Someip/NewEventGroup9
        Required_NewEventGroup{90..99}: event-group=Body1_Someip/NewEventGroup{90..99}
    R_Vehicle_SOAAdaptor_Body1: service-interface-deployment=Body1_Someip, required-service-instance-id=ANY, sd-client-config=R_CCU_SDConfig
      216 x someip required event group:
        Required_NewEventGroup: event-group=Body1_Someip/NewEventGroup
        Required_NewEventGroup1: event-group=Body1_Someip/NewEventGroup1
        Required_NewEventGroup10: event-group=Body1_Someip/NewEventGroup10
        Required_NewEventGroup{100..109}: event-group=Body1_Someip/NewEventGroup{100..109}
        Required_NewEventGroup11: event-group=Body1_Someip/NewEventGroup11
        Required_NewEventGroup{110..119}: event-group=Body1_Someip/NewEventGroup{110..119}
        Required_NewEventGroup12: event-group=Body1_Someip/NewEventGroup12
        Required_NewEventGroup{120..129}: event-group=Body1_Someip/NewEventGroup{120..129}
        Required_NewEventGroup13: event-group=Body1_Someip/NewEventGroup13
        Required_NewEventGroup{130..139}: event-group=Body1_Someip/NewEventGroup{130..139}
        Required_NewEventGroup14: event-group=Body1_Someip/NewEventGroup14
        Required_NewEventGroup{140..149}: event-group=Body1_Someip/NewEventGroup{140..149}
        Required_NewEventGroup15: event-group=Body1_Someip/NewEventGroup15
        Required_NewEventGroup{150..159}: event-group=Body1_Someip/NewEventGroup{150..159}
        Required_NewEventGroup16: event-group=Body1_Someip/NewEventGroup16
        Required_NewEventGroup{160..169}: event-group=Body1_Someip/NewEventGroup{160..169}
        Required_NewEventGroup17: event-group=Body1_Someip/NewEventGroup17
        Required_NewEventGroup{170..179}: event-group=Body1_Someip/NewEventGroup{170..179}
        Required_NewEventGroup18: event-group=Body1_Someip/NewEventGroup18
        Required_NewEventGroup{180..189}: event-group=Body1_Someip/NewEventGroup{180..189}
        Required_NewEventGroup19: event-group=Body1_Someip/NewEventGroup19
        Required_NewEventGroup{190..199}: event-group=Body1_Someip/NewEventGroup{190..199}
        Required_NewEventGroup2: event-group=Body1_Someip/NewEventGroup2
        Required_NewEventGroup20: event-group=Body1_Someip/NewEventGroup20
        Required_NewEventGroup{200..209}: event-group=Body1_Someip/NewEventGroup{200..209}
        Required_NewEventGroup21: event-group=Body1_Someip/NewEventGroup21
        Required_NewEventGroup{210..215}: event-group=Body1_Someip/NewEventGroup{210..215}
        Required_NewEventGroup{22..29}: event-group=Body1_Someip/NewEventGroup{22..29}
        Required_NewEventGroup3: event-group=Body1_Someip/NewEventGroup3
        Required_NewEventGroup{30..39}: event-group=Body1_Someip/NewEventGroup{30..39}
        Required_NewEventGroup4: event-group=Body1_Someip/NewEventGroup4
        Required_NewEventGroup{40..49}: event-group=Body1_Someip/NewEventGroup{40..49}
        Required_NewEventGroup5: event-group=Body1_Someip/NewEventGroup5
        Required_NewEventGroup{50..59}: event-group=Body1_Someip/NewEventGroup{50..59}
        Required_NewEventGroup6: event-group=Body1_Someip/NewEventGroup6
        Required_NewEventGroup{60..69}: event-group=Body1_Someip/NewEventGroup{60..69}
        Required_NewEventGroup7: event-group=Body1_Someip/NewEventGroup7
        Required_NewEventGroup{70..79}: event-group=Body1_Someip/NewEventGroup{70..79}
        Required_NewEventGroup8: event-group=Body1_Someip/NewEventGroup8
        Required_NewEventGroup{80..89}: event-group=Body1_Someip/NewEventGroup{80..89}
        Required_NewEventGroup9: event-group=Body1_Someip/NewEventGroup9
        Required_NewEventGroup{90..99}: event-group=Body1_Someip/NewEventGroup{90..99}
    R_Vehicle_SOAAdaptor_Body1: service-interface-deployment=Body1_Someip, required-service-instance-id=ANY, sd-client-config=R_CCU_SDConfig
      216 x someip required event group:
        Required_NewEventGroup: event-group=Body1_Someip/NewEventGroup
        Required_NewEventGroup1: event-group=Body1_Someip/NewEventGroup1
        Required_NewEventGroup10: event-group=Body1_Someip/NewEventGroup10
        Required_NewEventGroup{100..109}: event-group=Body1_Someip/NewEventGroup{100..109}
        Required_NewEventGroup11: event-group=Body1_Someip/NewEventGroup11
        Required_NewEventGroup{110..119}: event-group=Body1_Someip/NewEventGroup{110..119}
        Required_NewEventGroup12: event-group=Body1_Someip/NewEventGroup12
        Required_NewEventGroup{120..129}: event-group=Body1_Someip/NewEventGroup{120..129}
        Required_NewEventGroup13: event-group=Body1_Someip/NewEventGroup13
        Required_NewEventGroup{130..139}: event-group=Body1_Someip/NewEventGroup{130..139}
        Required_NewEventGroup14: event-group=Body1_Someip/NewEventGroup14
        Required_NewEventGroup{140..149}: event-group=Body1_Someip/NewEventGroup{140..149}
        Required_NewEventGroup15: event-group=Body1_Someip/NewEventGroup15
        Required_NewEventGroup{150..159}: event-group=Body1_Someip/NewEventGroup{150..159}
        Required_NewEventGroup16: event-group=Body1_Someip/NewEventGroup16
        Required_NewEventGroup{160..169}: event-group=Body1_Someip/NewEventGroup{160..169}
        Required_NewEventGroup17: event-group=Body1_Someip/NewEventGroup17
        Required_NewEventGroup{170..179}: event-group=Body1_Someip/NewEventGroup{170..179}
        Required_NewEventGroup18: event-group=Body1_Someip/NewEventGroup18
        Required_NewEventGroup{180..189}: event-group=Body1_Someip/NewEventGroup{180..189}
        Required_NewEventGroup19: event-group=Body1_Someip/NewEventGroup19
        Required_NewEventGroup{190..199}: event-group=Body1_Someip/NewEventGroup{190..199}
        Required_NewEventGroup2: event-group=Body1_Someip/NewEventGroup2
        Required_NewEventGroup20: event-group=Body1_Someip/NewEventGroup20
        Required_NewEventGroup{200..209}: event-group=Body1_Someip/NewEventGroup{200..209}
        Required_NewEventGroup21: event-group=Body1_Someip/NewEventGroup21
        Required_NewEventGroup{210..215}: event-group=Body1_Someip/NewEventGroup{210..215}
        Required_NewEventGroup{22..29}: event-group=Body1_Someip/NewEventGroup{22..29}
        Required_NewEventGroup3: event-group=Body1_Someip/NewEventGroup3
        Required_NewEventGroup{30..39}: event-group=Body1_Someip/NewEventGroup{30..39}
        Required_NewEventGroup4: event-group=Body1_Someip/NewEventGroup4
        Required_NewEventGroup{40..49}: event-group=Body1_Someip/NewEventGroup{40..49}
        Required_NewEventGroup5: event-group=Body1_Someip/NewEventGroup5
        Required_NewEventGroup{50..59}: event-group=Body1_Someip/NewEventGroup{50..59}
        Required_NewEventGroup6: event-group=Body1_Someip/NewEventGroup6
        Required_NewEventGroup{60..69}: event-group=Body1_Someip/NewEventGroup{60..69}
        Required_NewEventGroup7: event-group=Body1_Someip/NewEventGroup7
        Required_NewEventGroup{70..79}: event-group=Body1_Someip/NewEventGroup{70..79}
        Required_NewEventGroup8: event-group=Body1_Someip/NewEventGroup8
        Required_NewEventGroup{80..89}: event-group=Body1_Someip/NewEventGroup{80..89}
        Required_NewEventGroup9: event-group=Body1_Someip/NewEventGroup9
        Required_NewEventGroup{90..99}: event-group=Body1_Someip/NewEventGroup{90..99}
    R_Vehicle_SOAAdaptor_Body1: service-interface-deployment=Body1_Someip, required-service-instance-id=ANY, sd-client-config=R_CCU_SDConfig
      216 x someip required event group:
        Required_NewEventGroup: event-group=Body1_Someip/NewEventGroup
        Required_NewEventGroup1: event-group=Body1_Someip/NewEventGroup1
        Required_NewEventGroup10: event-group=Body1_Someip/NewEventGroup10
        Required_NewEventGroup{100..109}: event-group=Body1_Someip/NewEventGroup{100..109}
        Required_NewEventGroup11: event-group=Body1_Someip/NewEventGroup11
        Required_NewEventGroup{110..119}: event-group=Body1_Someip/NewEventGroup{110..119}
        Required_NewEventGroup12: event-group=Body1_Someip/NewEventGroup12
        Required_NewEventGroup{120..129}: event-group=Body1_Someip/NewEventGroup{120..129}
        Required_NewEventGroup13: event-group=Body1_Someip/NewEventGroup13
        Required_NewEventGroup{130..139}: event-group=Body1_Someip/NewEventGroup{130..139}
        Required_NewEventGroup14: event-group=Body1_Someip/NewEventGroup14
        Required_NewEventGroup{140..149}: event-group=Body1_Someip/NewEventGroup{140..149}
        Required_NewEventGroup15: event-group=Body1_Someip/NewEventGroup15
        Required_NewEventGroup{150..159}: event-group=Body1_Someip/NewEventGroup{150..159}
        Required_NewEventGroup16: event-group=Body1_Someip/NewEventGroup16
        Required_NewEventGroup{160..169}: event-group=Body1_Someip/NewEventGroup{160..169}
        Required_NewEventGroup17: event-group=Body1_Someip/NewEventGroup17
        Required_NewEventGroup{170..179}: event-group=Body1_Someip/NewEventGroup{170..179}
        Required_NewEventGroup18: event-group=Body1_Someip/NewEventGroup18
        Required_NewEventGroup{180..189}: event-group=Body1_Someip/NewEventGroup{180..189}
        Required_NewEventGroup19: event-group=Body1_Someip/NewEventGroup19
        Required_NewEventGroup{190..199}: event-group=Body1_Someip/NewEventGroup{190..199}
        Required_NewEventGroup2: event-group=Body1_Someip/NewEventGroup2
        Required_NewEventGroup20: event-group=Body1_Someip/NewEventGroup20
        Required_NewEventGroup{200..209}: event-group=Body1_Someip/NewEventGroup{200..209}
        Required_NewEventGroup21: event-group=Body1_Someip/NewEventGroup21
        Required_NewEventGroup{210..215}: event-group=Body1_Someip/NewEventGroup{210..215}
        Required_NewEventGroup{22..29}: event-group=Body1_Someip/NewEventGroup{22..29}
        Required_NewEventGroup3: event-group=Body1_Someip/NewEventGroup3
        Required_NewEventGroup{30..39}: event-group=Body1_Someip/NewEventGroup{30..39}
        Required_NewEventGroup4: event-group=Body1_Someip/NewEventGroup4
        Required_NewEventGroup{40..49}: event-group=Body1_Someip/NewEventGroup{40..49}
        Required_NewEventGroup5: event-group=Body1_Someip/NewEventGroup5
        Required_NewEventGroup{50..59}: event-group=Body1_Someip/NewEventGroup{50..59}
        Required_NewEventGroup6: event-group=Body1_Someip/NewEventGroup6
        Required_NewEventGroup{60..69}: event-group=Body1_Someip/NewEventGroup{60..69}
        Required_NewEventGroup7: event-group=Body1_Someip/NewEventGroup7
        Required_NewEventGroup{70..79}: event-group=Body1_Someip/NewEventGroup{70..79}
        Required_NewEventGroup8: event-group=Body1_Someip/NewEventGroup8
        Required_NewEventGroup{80..89}: event-group=Body1_Someip/NewEventGroup{80..89}
        Required_NewEventGroup9: event-group=Body1_Someip/NewEventGroup9
        Required_NewEventGroup{90..99}: event-group=Body1_Someip/NewEventGroup{90..99}
    R_Vehicle_SOAAdaptor_Body2: service-interface-deployment=Body2_Someip, required-service-instance-id=ANY, sd-client-config=R_CCU_SDConfig
      47 x someip required event group:
        Required_NewEventGroup: event-group=Body2_Someip/NewEventGroup
        Required_NewEventGroup1: event-group=Body2_Someip/NewEventGroup1
        Required_NewEventGroup{10..19}: event-group=Body2_Someip/NewEventGroup{10..19}
        Required_NewEventGroup2: event-group=Body2_Someip/NewEventGroup2
        Required_NewEventGroup{20..29}: event-group=Body2_Someip/NewEventGroup{20..29}
        Required_NewEventGroup3: event-group=Body2_Someip/NewEventGroup3
        Required_NewEventGroup{30..39}: event-group=Body2_Someip/NewEventGroup{30..39}
        Required_NewEventGroup4: event-group=Body2_Someip/NewEventGroup4
        Required_NewEventGroup{40..46}: event-group=Body2_Someip/NewEventGroup{40..46}
        Required_NewEventGroup{5..9}: event-group=Body2_Someip/NewEventGroup{5..9}
    R_Vehicle_SOAAdaptor_Body2: service-interface-deployment=Body2_Someip, required-service-instance-id=ANY, sd-client-config=R_CCU_SDConfig
      47 x someip required event group:
        Required_NewEventGroup: event-group=Body2_Someip/NewEventGroup
        Required_NewEventGroup1: event-group=Body2_Someip/NewEventGroup1
        Required_NewEventGroup{10..19}: event-group=Body2_Someip/NewEventGroup{10..19}
        Required_NewEventGroup2: event-group=Body2_Someip/NewEventGroup2
        Required_NewEventGroup{20..29}: event-group=Body2_Someip/NewEventGroup{20..29}
        Required_NewEventGroup3: event-group=Body2_Someip/NewEventGroup3
        Required_NewEventGroup{30..39}: event-group=Body2_Someip/NewEventGroup{30..39}
        Required_NewEventGroup4: event-group=Body2_Someip/NewEventGroup4
        Required_NewEventGroup{40..46}: event-group=Body2_Someip/NewEventGroup{40..46}
        Required_NewEventGroup{5..9}: event-group=Body2_Someip/NewEventGroup{5..9}
    R_Vehicle_SOAAdaptor_Body2: service-interface-deployment=Body2_Someip, required-service-instance-id=ANY, sd-client-config=R_CCU_SDConfig
      47 x someip required event group:
        Required_NewEventGroup: event-group=Body2_Someip/NewEventGroup
        Required_NewEventGroup1: event-group=Body2_Someip/NewEventGroup1
        Required_NewEventGroup{10..19}: event-group=Body2_Someip/NewEventGroup{10..19}
        Required_NewEventGroup2: event-group=Body2_Someip/NewEventGroup2
        Required_NewEventGroup{20..29}: event-group=Body2_Someip/NewEventGroup{20..29}
        Required_NewEventGroup3: event-group=Body2_Someip/NewEventGroup3
        Required_NewEventGroup{30..39}: event-group=Body2_Someip/NewEventGroup{30..39}
        Required_NewEventGroup4: event-group=Body2_Someip/NewEventGroup4
        Required_NewEventGroup{40..46}: event-group=Body2_Someip/NewEventGroup{40..46}
        Required_NewEventGroup{5..9}: event-group=Body2_Someip/NewEventGroup{5..9}
    R_Vehicle_SOAAdaptor_Body2: service-interface-deployment=Body2_Someip, required-service-instance-id=ANY, sd-client-config=R_CCU_SDConfig
      47 x someip required event group:
        Required_NewEventGroup: event-group=Body2_Someip/NewEventGroup
        Required_NewEventGroup1: event-group=Body2_Someip/NewEventGroup1
        Required_NewEventGroup{10..19}: event-group=Body2_Someip/NewEventGroup{10..19}
        Required_NewEventGroup2: event-group=Body2_Someip/NewEventGroup2
        Required_NewEventGroup{20..29}: event-group=Body2_Someip/NewEventGroup{20..29}
        Required_NewEventGroup3: event-group=Body2_Someip/NewEventGroup3
        Required_NewEventGroup{30..39}: event-group=Body2_Someip/NewEventGroup{30..39}
        Required_NewEventGroup4: event-group=Body2_Someip/NewEventGroup4
        Required_NewEventGroup{40..46}: event-group=Body2_Someip/NewEventGroup{40..46}
        Required_NewEventGroup{5..9}: event-group=Body2_Someip/NewEventGroup{5..9}
    R_Vehicle_SOAAdaptor_Body2: service-interface-deployment=Body2_Someip, required-service-instance-id=ANY, sd-client-config=R_CCU_SDConfig
      47 x someip required event group:
        Required_NewEventGroup: event-group=Body2_Someip/NewEventGroup
        Required_NewEventGroup1: event-group=Body2_Someip/NewEventGroup1
        Required_NewEventGroup{10..19}: event-group=Body2_Someip/NewEventGroup{10..19}
        Required_NewEventGroup2: event-group=Body2_Someip/NewEventGroup2
        Required_NewEventGroup{20..29}: event-group=Body2_Someip/NewEventGroup{20..29}
        Required_NewEventGroup3: event-group=Body2_Someip/NewEventGroup3
        Required_NewEventGroup{30..39}: event-group=Body2_Someip/NewEventGroup{30..39}
        Required_NewEventGroup4: event-group=Body2_Someip/NewEventGroup4
        Required_NewEventGroup{40..46}: event-group=Body2_Someip/NewEventGroup{40..46}
        Required_NewEventGroup{5..9}: event-group=Body2_Someip/NewEventGroup{5..9}
    R_Vehicle_SOAAdaptor_Body2: service-interface-deployment=Body2_Someip, required-service-instance-id=ANY, sd-client-config=R_CCU_SDConfig
      47 x someip required event group:
        Required_NewEventGroup: event-group=Body2_Someip/NewEventGroup
        Required_NewEventGroup1: event-group=Body2_Someip/NewEventGroup1
        Required_NewEventGroup{10..19}: event-group=Body2_Someip/NewEventGroup{10..19}
        Required_NewEventGroup2: event-group=Body2_Someip/NewEventGroup2
        Required_NewEventGroup{20..29}: event-group=Body2_Someip/NewEventGroup{20..29}
        Required_NewEventGroup3: event-group=Body2_Someip/NewEventGroup3
        Required_NewEventGroup{30..39}: event-group=Body2_Someip/NewEventGroup{30..39}
        Required_NewEventGroup4: event-group=Body2_Someip/NewEventGroup4
        Required_NewEventGroup{40..46}: event-group=Body2_Someip/NewEventGroup{40..46}
        Required_NewEventGroup{5..9}: event-group=Body2_Someip/NewEventGroup{5..9}
    R_Vehicle_SOAAdaptor_Body2: service-interface-deployment=Body2_Someip, required-service-instance-id=ANY, sd-client-config=R_CCU_SDConfig
      47 x someip required event group:
        Required_NewEventGroup: event-group=Body2_Someip/NewEventGroup
        Required_NewEventGroup1: event-group=Body2_Someip/NewEventGroup1
        Required_NewEventGroup{10..19}: event-group=Body2_Someip/NewEventGroup{10..19}
        Required_NewEventGroup2: event-group=Body2_Someip/NewEventGroup2
        Required_NewEventGroup{20..29}: event-group=Body2_Someip/NewEventGroup{20..29}
        Required_NewEventGroup3: event-group=Body2_Someip/NewEventGroup3
        Required_NewEventGroup{30..39}: event-group=Body2_Someip/NewEventGroup{30..39}
        Required_NewEventGroup4: event-group=Body2_Someip/NewEventGroup4
        Required_NewEventGroup{40..46}: event-group=Body2_Someip/NewEventGroup{40..46}
        Required_NewEventGroup{5..9}: event-group=Body2_Someip/NewEventGroup{5..9}
    R_Vehicle_SOAAdaptor_CANoverIP: service-interface-deployment=CANoverIP_Someip, required-service-instance-id=ANY, sd-client-config=R_CCU_SDConfig
    R_Vehicle_SOAAdaptor_CANoverIP: service-interface-deployment=CANoverIP_Someip, required-service-instance-id=ANY, sd-client-config=R_CCU_SDConfig
    R_Vehicle_SOAAdaptor_CANoverIP: service-interface-deployment=CANoverIP_Someip, required-service-instance-id=ANY, sd-client-config=R_CCU_SDConfig
    R_Vehicle_SOAAdaptor_CANoverIP: service-interface-deployment=CANoverIP_Someip, required-service-instance-id=ANY, sd-client-config=R_CCU_SDConfig
    R_Vehicle_SOAAdaptor_CANoverIP: service-interface-deployment=CANoverIP_Someip, required-service-instance-id=ANY, sd-client-config=R_CCU_SDConfig
    R_Vehicle_SOAAdaptor_CANoverIP: service-interface-deployment=CANoverIP_Someip, required-service-instance-id=ANY, sd-client-config=R_CCU_SDConfig
    R_Vehicle_SOAAdaptor_CANoverIP: service-interface-deployment=CANoverIP_Someip, required-service-instance-id=ANY, sd-client-config=R_CCU_SDConfig
    R_Vehicle_SOAAdaptor_CANoverIP: service-interface-deployment=CANoverIP_Someip, required-service-instance-id=ANY, sd-client-config=R_CCU_SDConfig
    R_Vehicle_SOAAdaptor_CANoverIP: service-interface-deployment=CANoverIP_Someip, required-service-instance-id=ANY, sd-client-config=R_CCU_SDConfig
    R_Vehicle_SOAAdaptor_CANoverIP: service-interface-deployment=CANoverIP_Someip, required-service-instance-id=ANY, sd-client-config=R_CCU_SDConfig
    R_Vehicle_SOAAdaptor_CANoverIP: service-interface-deployment=CANoverIP_Someip, required-service-instance-id=ANY, sd-client-config=R_CCU_SDConfig
    R_Vehicle_SOAAdaptor_Chassis: service-interface-deployment=Chassis_Someip, required-service-instance-id=ANY, sd-client-config=R_CCU_SDConfig
      19 x someip required event group:
        Required_NewEventGroup: event-group=Chassis_Someip/NewEventGroup
        Required_NewEventGroup1: event-group=Chassis_Someip/NewEventGroup1
        Required_NewEventGroup{10..18}: event-group=Chassis_Someip/NewEventGroup{10..18}
        Required_NewEventGroup{2..9}: event-group=Chassis_Someip/NewEventGroup{2..9}
    R_Vehicle_SOAAdaptor_Chassis: service-interface-deployment=Chassis_Someip, required-service-instance-id=ANY, sd-client-config=R_CCU_SDConfig
      19 x someip required event group:
        Required_NewEventGroup: event-group=Chassis_Someip/NewEventGroup
        Required_NewEventGroup1: event-group=Chassis_Someip/NewEventGroup1
        Required_NewEventGroup{10..18}: event-group=Chassis_Someip/NewEventGroup{10..18}
        Required_NewEventGroup{2..9}: event-group=Chassis_Someip/NewEventGroup{2..9}
    R_Vehicle_SOAAdaptor_Chassis: service-interface-deployment=Chassis_Someip, required-service-instance-id=ANY, sd-client-config=R_CCU_SDConfig
      19 x someip required event group:
        Required_NewEventGroup: event-group=Chassis_Someip/NewEventGroup
        Required_NewEventGroup1: event-group=Chassis_Someip/NewEventGroup1
        Required_NewEventGroup{10..18}: event-group=Chassis_Someip/NewEventGroup{10..18}
        Required_NewEventGroup{2..9}: event-group=Chassis_Someip/NewEventGroup{2..9}
    R_Vehicle_SOAAdaptor_Chassis: service-interface-deployment=Chassis_Someip, required-service-instance-id=ANY, sd-client-config=R_CCU_SDConfig
      19 x someip required event group:
        Required_NewEventGroup: event-group=Chassis_Someip/NewEventGroup
        Required_NewEventGroup1: event-group=Chassis_Someip/NewEventGroup1
        Required_NewEventGroup{10..18}: event-group=Chassis_Someip/NewEventGroup{10..18}
        Required_NewEventGroup{2..9}: event-group=Chassis_Someip/NewEventGroup{2..9}
    R_Vehicle_SOAAdaptor_Chassis: service-interface-deployment=Chassis_Someip, required-service-instance-id=ANY, sd-client-config=R_CCU_SDConfig
      19 x someip required event group:
        Required_NewEventGroup: event-group=Chassis_Someip/NewEventGroup
        Required_NewEventGroup1: event-group=Chassis_Someip/NewEventGroup1
        Required_NewEventGroup{10..18}: event-group=Chassis_Someip/NewEventGroup{10..18}
        Required_NewEventGroup{2..9}: event-group=Chassis_Someip/NewEventGroup{2..9}
    R_Vehicle_SOAAdaptor_Chassis: service-interface-deployment=Chassis_Someip, required-service-instance-id=ANY, sd-client-config=R_CCU_SDConfig
      19 x someip required event group:
        Required_NewEventGroup: event-group=Chassis_Someip/NewEventGroup
        Required_NewEventGroup1: event-group=Chassis_Someip/NewEventGroup1
        Required_NewEventGroup{10..18}: event-group=Chassis_Someip/NewEventGroup{10..18}
        Required_NewEventGroup{2..9}: event-group=Chassis_Someip/NewEventGroup{2..9}
    R_Vehicle_SOAAdaptor_Chassis: service-interface-deployment=Chassis_Someip, required-service-instance-id=ANY, sd-client-config=R_CCU_SDConfig
      19 x someip required event group:
        Required_NewEventGroup: event-group=Chassis_Someip/NewEventGroup
        Required_NewEventGroup1: event-group=Chassis_Someip/NewEventGroup1
        Required_NewEventGroup{10..18}: event-group=Chassis_Someip/NewEventGroup{10..18}
        Required_NewEventGroup{2..9}: event-group=Chassis_Someip/NewEventGroup{2..9}
    R_Vehicle_SOAAdaptor_Chassis: service-interface-deployment=Chassis_Someip, required-service-instance-id=ANY, sd-client-config=R_CCU_SDConfig
      19 x someip required event group:
        Required_NewEventGroup: event-group=Chassis_Someip/NewEventGroup
        Required_NewEventGroup1: event-group=Chassis_Someip/NewEventGroup1
        Required_NewEventGroup{10..18}: event-group=Chassis_Someip/NewEventGroup{10..18}
        Required_NewEventGroup{2..9}: event-group=Chassis_Someip/NewEventGroup{2..9}
    R_Vehicle_SOAAdaptor_DataCollection: service-interface-deployment=DataCollection_Someip, required-service-instance-id=ANY, sd-client-config=R_CCU_SDConfig
      someip required event group Required_NewEventGroup1: event-group=DataCollection_Someip/NewEventGroup1
    R_Vehicle_SOAAdaptor_DataCollection: service-interface-deployment=DataCollection_Someip, required-service-instance-id=ANY, sd-client-config=R_CCU_SDConfig
      someip required event group Required_NewEventGroup1: event-group=DataCollection_Someip/NewEventGroup1
    R_Vehicle_SOAAdaptor_DataCollection: service-interface-deployment=DataCollection_Someip, required-service-instance-id=ANY, sd-client-config=R_CCU_SDConfig
      someip required event group Required_NewEventGroup1: event-group=DataCollection_Someip/NewEventGroup1
    R_Vehicle_SOAAdaptor_Extended: service-interface-deployment=Extended_Someip, required-service-instance-id=ANY, sd-client-config=R_CCU_SDConfig
      205 x someip required event group:
        Required_NewEventGroup: event-group=Extended_Someip/NewEventGroup
        Required_NewEventGroup1: event-group=Extended_Someip/NewEventGroup1
        Required_NewEventGroup10: event-group=Extended_Someip/NewEventGroup10
        Required_NewEventGroup{100..108}: event-group=Extended_Someip/NewEventGroup{100..108}
        Required_NewEventGroup11: event-group=Extended_Someip/NewEventGroup11
        Required_NewEventGroup113: event-group=Extended_Someip/NewEventGroup113
        Required_NewEventGroup{116..119}: event-group=Extended_Someip/NewEventGroup{116..119}
        Required_NewEventGroup12: event-group=Extended_Someip/NewEventGroup12
        Required_NewEventGroup{120..124}: event-group=Extended_Someip/NewEventGroup{120..124}
        Required_NewEventGroup13: event-group=Extended_Someip/NewEventGroup13
        Required_NewEventGroup137: event-group=Extended_Someip/NewEventGroup137
        Required_NewEventGroup139: event-group=Extended_Someip/NewEventGroup139
        Required_NewEventGroup14: event-group=Extended_Someip/NewEventGroup14
        Required_NewEventGroup{140..149}: event-group=Extended_Someip/NewEventGroup{140..149}
        Required_NewEventGroup15: event-group=Extended_Someip/NewEventGroup15
        Required_NewEventGroup{150..159}: event-group=Extended_Someip/NewEventGroup{150..159}
        Required_NewEventGroup16: event-group=Extended_Someip/NewEventGroup16
        Required_NewEventGroup{160..169}: event-group=Extended_Someip/NewEventGroup{160..169}
        Required_NewEventGroup17: event-group=Extended_Someip/NewEventGroup17
        Required_NewEventGroup{170..179}: event-group=Extended_Someip/NewEventGroup{170..179}
        Required_NewEventGroup18: event-group=Extended_Someip/NewEventGroup18
        Required_NewEventGroup{180..189}: event-group=Extended_Someip/NewEventGroup{180..189}
        Required_NewEventGroup19: event-group=Extended_Someip/NewEventGroup19
        Required_NewEventGroup{190..199}: event-group=Extended_Someip/NewEventGroup{190..199}
        Required_NewEventGroup2: event-group=Extended_Someip/NewEventGroup2
        Required_NewEventGroup20: event-group=Extended_Someip/NewEventGroup20
        Required_NewEventGroup{200..209}: event-group=Extended_Someip/NewEventGroup{200..209}
        Required_NewEventGroup21: event-group=Extended_Someip/NewEventGroup21
        Required_NewEventGroup{210..219}: event-group=Extended_Someip/NewEventGroup{210..219}
        Required_NewEventGroup22: event-group=Extended_Someip/NewEventGroup22
        Required_NewEventGroup{220..223}: event-group=Extended_Someip/NewEventGroup{220..223}
        Required_NewEventGroup{23..29}: event-group=Extended_Someip/NewEventGroup{23..29}
        Required_NewEventGroup3: event-group=Extended_Someip/NewEventGroup3
        Required_NewEventGroup{30..39}: event-group=Extended_Someip/NewEventGroup{30..39}
        Required_NewEventGroup4: event-group=Extended_Someip/NewEventGroup4
        Required_NewEventGroup{40..49}: event-group=Extended_Someip/NewEventGroup{40..49}
        Required_NewEventGroup5: event-group=Extended_Someip/NewEventGroup5
        Required_NewEventGroup{50..59}: event-group=Extended_Someip/NewEventGroup{50..59}
        Required_NewEventGroup6: event-group=Extended_Someip/NewEventGroup6
        Required_NewEventGroup{60..69}: event-group=Extended_Someip/NewEventGroup{60..69}
        Required_NewEventGroup7: event-group=Extended_Someip/NewEventGroup7
        Required_NewEventGroup{70..79}: event-group=Extended_Someip/NewEventGroup{70..79}
        Required_NewEventGroup8: event-group=Extended_Someip/NewEventGroup8
        Required_NewEventGroup{80..89}: event-group=Extended_Someip/NewEventGroup{80..89}
        Required_NewEventGroup9: event-group=Extended_Someip/NewEventGroup9
        Required_NewEventGroup{90..99}: event-group=Extended_Someip/NewEventGroup{90..99}
    R_Vehicle_SOAAdaptor_Extended: service-interface-deployment=Extended_Someip, required-service-instance-id=ANY, sd-client-config=R_CCU_SDConfig
      205 x someip required event group:
        Required_NewEventGroup: event-group=Extended_Someip/NewEventGroup
        Required_NewEventGroup1: event-group=Extended_Someip/NewEventGroup1
        Required_NewEventGroup10: event-group=Extended_Someip/NewEventGroup10
        Required_NewEventGroup{100..108}: event-group=Extended_Someip/NewEventGroup{100..108}
        Required_NewEventGroup11: event-group=Extended_Someip/NewEventGroup11
        Required_NewEventGroup113: event-group=Extended_Someip/NewEventGroup113
        Required_NewEventGroup{116..119}: event-group=Extended_Someip/NewEventGroup{116..119}
        Required_NewEventGroup12: event-group=Extended_Someip/NewEventGroup12
        Required_NewEventGroup{120..124}: event-group=Extended_Someip/NewEventGroup{120..124}
        Required_NewEventGroup13: event-group=Extended_Someip/NewEventGroup13
        Required_NewEventGroup137: event-group=Extended_Someip/NewEventGroup137
        Required_NewEventGroup139: event-group=Extended_Someip/NewEventGroup139
        Required_NewEventGroup14: event-group=Extended_Someip/NewEventGroup14
        Required_NewEventGroup{140..149}: event-group=Extended_Someip/NewEventGroup{140..149}
        Required_NewEventGroup15: event-group=Extended_Someip/NewEventGroup15
        Required_NewEventGroup{150..159}: event-group=Extended_Someip/NewEventGroup{150..159}
        Required_NewEventGroup16: event-group=Extended_Someip/NewEventGroup16
        Required_NewEventGroup{160..169}: event-group=Extended_Someip/NewEventGroup{160..169}
        Required_NewEventGroup17: event-group=Extended_Someip/NewEventGroup17
        Required_NewEventGroup{170..179}: event-group=Extended_Someip/NewEventGroup{170..179}
        Required_NewEventGroup18: event-group=Extended_Someip/NewEventGroup18
        Required_NewEventGroup{180..189}: event-group=Extended_Someip/NewEventGroup{180..189}
        Required_NewEventGroup19: event-group=Extended_Someip/NewEventGroup19
        Required_NewEventGroup{190..199}: event-group=Extended_Someip/NewEventGroup{190..199}
        Required_NewEventGroup2: event-group=Extended_Someip/NewEventGroup2
        Required_NewEventGroup20: event-group=Extended_Someip/NewEventGroup20
        Required_NewEventGroup{200..209}: event-group=Extended_Someip/NewEventGroup{200..209}
        Required_NewEventGroup21: event-group=Extended_Someip/NewEventGroup21
        Required_NewEventGroup{210..219}: event-group=Extended_Someip/NewEventGroup{210..219}
        Required_NewEventGroup22: event-group=Extended_Someip/NewEventGroup22
        Required_NewEventGroup{220..223}: event-group=Extended_Someip/NewEventGroup{220..223}
        Required_NewEventGroup{23..29}: event-group=Extended_Someip/NewEventGroup{23..29}
        Required_NewEventGroup3: event-group=Extended_Someip/NewEventGroup3
        Required_NewEventGroup{30..39}: event-group=Extended_Someip/NewEventGroup{30..39}
        Required_NewEventGroup4: event-group=Extended_Someip/NewEventGroup4
        Required_NewEventGroup{40..49}: event-group=Extended_Someip/NewEventGroup{40..49}
        Required_NewEventGroup5: event-group=Extended_Someip/NewEventGroup5
        Required_NewEventGroup{50..59}: event-group=Extended_Someip/NewEventGroup{50..59}
        Required_NewEventGroup6: event-group=Extended_Someip/NewEventGroup6
        Required_NewEventGroup{60..69}: event-group=Extended_Someip/NewEventGroup{60..69}
        Required_NewEventGroup7: event-group=Extended_Someip/NewEventGroup7
        Required_NewEventGroup{70..79}: event-group=Extended_Someip/NewEventGroup{70..79}
        Required_NewEventGroup8: event-group=Extended_Someip/NewEventGroup8
        Required_NewEventGroup{80..89}: event-group=Extended_Someip/NewEventGroup{80..89}
        Required_NewEventGroup9: event-group=Extended_Someip/NewEventGroup9
        Required_NewEventGroup{90..99}: event-group=Extended_Someip/NewEventGroup{90..99}
    R_Vehicle_SOAAdaptor_Extended: service-interface-deployment=Extended_Someip, required-service-instance-id=ANY, sd-client-config=R_CCU_SDConfig
      205 x someip required event group:
        Required_NewEventGroup: event-group=Extended_Someip/NewEventGroup
        Required_NewEventGroup1: event-group=Extended_Someip/NewEventGroup1
        Required_NewEventGroup10: event-group=Extended_Someip/NewEventGroup10
        Required_NewEventGroup{100..108}: event-group=Extended_Someip/NewEventGroup{100..108}
        Required_NewEventGroup11: event-group=Extended_Someip/NewEventGroup11
        Required_NewEventGroup113: event-group=Extended_Someip/NewEventGroup113
        Required_NewEventGroup{116..119}: event-group=Extended_Someip/NewEventGroup{116..119}
        Required_NewEventGroup12: event-group=Extended_Someip/NewEventGroup12
        Required_NewEventGroup{120..124}: event-group=Extended_Someip/NewEventGroup{120..124}
        Required_NewEventGroup13: event-group=Extended_Someip/NewEventGroup13
        Required_NewEventGroup137: event-group=Extended_Someip/NewEventGroup137
        Required_NewEventGroup139: event-group=Extended_Someip/NewEventGroup139
        Required_NewEventGroup14: event-group=Extended_Someip/NewEventGroup14
        Required_NewEventGroup{140..149}: event-group=Extended_Someip/NewEventGroup{140..149}
        Required_NewEventGroup15: event-group=Extended_Someip/NewEventGroup15
        Required_NewEventGroup{150..159}: event-group=Extended_Someip/NewEventGroup{150..159}
        Required_NewEventGroup16: event-group=Extended_Someip/NewEventGroup16
        Required_NewEventGroup{160..169}: event-group=Extended_Someip/NewEventGroup{160..169}
        Required_NewEventGroup17: event-group=Extended_Someip/NewEventGroup17
        Required_NewEventGroup{170..179}: event-group=Extended_Someip/NewEventGroup{170..179}
        Required_NewEventGroup18: event-group=Extended_Someip/NewEventGroup18
        Required_NewEventGroup{180..189}: event-group=Extended_Someip/NewEventGroup{180..189}
        Required_NewEventGroup19: event-group=Extended_Someip/NewEventGroup19
        Required_NewEventGroup{190..199}: event-group=Extended_Someip/NewEventGroup{190..199}
        Required_NewEventGroup2: event-group=Extended_Someip/NewEventGroup2
        Required_NewEventGroup20: event-group=Extended_Someip/NewEventGroup20
        Required_NewEventGroup{200..209}: event-group=Extended_Someip/NewEventGroup{200..209}
        Required_NewEventGroup21: event-group=Extended_Someip/NewEventGroup21
        Required_NewEventGroup{210..219}: event-group=Extended_Someip/NewEventGroup{210..219}
        Required_NewEventGroup22: event-group=Extended_Someip/NewEventGroup22
        Required_NewEventGroup{220..223}: event-group=Extended_Someip/NewEventGroup{220..223}
        Required_NewEventGroup{23..29}: event-group=Extended_Someip/NewEventGroup{23..29}
        Required_NewEventGroup3: event-group=Extended_Someip/NewEventGroup3
        Required_NewEventGroup{30..39}: event-group=Extended_Someip/NewEventGroup{30..39}
        Required_NewEventGroup4: event-group=Extended_Someip/NewEventGroup4
        Required_NewEventGroup{40..49}: event-group=Extended_Someip/NewEventGroup{40..49}
        Required_NewEventGroup5: event-group=Extended_Someip/NewEventGroup5
        Required_NewEventGroup{50..59}: event-group=Extended_Someip/NewEventGroup{50..59}
        Required_NewEventGroup6: event-group=Extended_Someip/NewEventGroup6
        Required_NewEventGroup{60..69}: event-group=Extended_Someip/NewEventGroup{60..69}
        Required_NewEventGroup7: event-group=Extended_Someip/NewEventGroup7
        Required_NewEventGroup{70..79}: event-group=Extended_Someip/NewEventGroup{70..79}
        Required_NewEventGroup8: event-group=Extended_Someip/NewEventGroup8
        Required_NewEventGroup{80..89}: event-group=Extended_Someip/NewEventGroup{80..89}
        Required_NewEventGroup9: event-group=Extended_Someip/NewEventGroup9
        Required_NewEventGroup{90..99}: event-group=Extended_Someip/NewEventGroup{90..99}
    R_Vehicle_SOAAdaptor_Extended: service-interface-deployment=Extended_Someip
      152 x someip required event group:
        Required_NewEventGroup: event-group=Extended_Someip/NewEventGroup
        Required_NewEventGroup1: event-group=Extended_Someip/NewEventGroup1
        Required_NewEventGroup10: event-group=Extended_Someip/NewEventGroup10
        Required_NewEventGroup{100..108}: event-group=Extended_Someip/NewEventGroup{100..108}
        Required_NewEventGroup11: event-group=Extended_Someip/NewEventGroup11
        Required_NewEventGroup113: event-group=Extended_Someip/NewEventGroup113
        Required_NewEventGroup{116..119}: event-group=Extended_Someip/NewEventGroup{116..119}
        Required_NewEventGroup12: event-group=Extended_Someip/NewEventGroup12
        Required_NewEventGroup{120..124}: event-group=Extended_Someip/NewEventGroup{120..124}
        Required_NewEventGroup13: event-group=Extended_Someip/NewEventGroup13
        Required_NewEventGroup137: event-group=Extended_Someip/NewEventGroup137
        Required_NewEventGroup139: event-group=Extended_Someip/NewEventGroup139
        Required_NewEventGroup14: event-group=Extended_Someip/NewEventGroup14
        Required_NewEventGroup{140..149}: event-group=Extended_Someip/NewEventGroup{140..149}
        Required_NewEventGroup15: event-group=Extended_Someip/NewEventGroup15
        Required_NewEventGroup{150..159}: event-group=Extended_Someip/NewEventGroup{150..159}
        Required_NewEventGroup16: event-group=Extended_Someip/NewEventGroup16
        Required_NewEventGroup{160..169}: event-group=Extended_Someip/NewEventGroup{160..169}
        Required_NewEventGroup17: event-group=Extended_Someip/NewEventGroup17
        Required_NewEventGroup{170..179}: event-group=Extended_Someip/NewEventGroup{170..179}
        Required_NewEventGroup18: event-group=Extended_Someip/NewEventGroup18
        Required_NewEventGroup{180..189}: event-group=Extended_Someip/NewEventGroup{180..189}
        Required_NewEventGroup19: event-group=Extended_Someip/NewEventGroup19
        Required_NewEventGroup{190..199}: event-group=Extended_Someip/NewEventGroup{190..199}
        Required_NewEventGroup2: event-group=Extended_Someip/NewEventGroup2
        Required_NewEventGroup20: event-group=Extended_Someip/NewEventGroup20
        Required_NewEventGroup{200..209}: event-group=Extended_Someip/NewEventGroup{200..209}
        Required_NewEventGroup21: event-group=Extended_Someip/NewEventGroup21
        Required_NewEventGroup{210..219}: event-group=Extended_Someip/NewEventGroup{210..219}
        Required_NewEventGroup22: event-group=Extended_Someip/NewEventGroup22
        Required_NewEventGroup{220..223}: event-group=Extended_Someip/NewEventGroup{220..223}
        Required_NewEventGroup{23..29}: event-group=Extended_Someip/NewEventGroup{23..29}
        Required_NewEventGroup3: event-group=Extended_Someip/NewEventGroup3
        Required_NewEventGroup{30..39}: event-group=Extended_Someip/NewEventGroup{30..39}
        Required_NewEventGroup4: event-group=Extended_Someip/NewEventGroup4
        Required_NewEventGroup{40..49}: event-group=Extended_Someip/NewEventGroup{40..49}
        Required_NewEventGroup5: event-group=Extended_Someip/NewEventGroup5
        Required_NewEventGroup50: event-group=Extended_Someip/NewEventGroup50
