[part 7 of 9: package /System/Service/Deployment]
AUTOSAR XML (schema 00049)
package /System/Service/Deployment  (continued)
  114 x someip service interface deployment:  (continued)
    PackageManagement_Someip: service-interface=Service/PackageManagement, service-interface-id=4047, service-interface-version={major-version=1, minor-version=2}
      someip field deployment CurrentStatus_Field: field=PackageManagement/CurrentStatus
        get getter: maximum-segment-length-request=0, maximum-segment-length-response=0, method-id=8199, transport-protocol=UDP
        notifier notifier: event-id=8200, maximum-segment-length=0, transport-protocol=UDP
      someip field deployment RollbackResult_Field: field=PackageManagement/RollbackResult
        get getter: maximum-segment-length-request=0, maximum-segment-length-response=0, method-id=8193, transport-protocol=UDP
        notifier notifier: event-id=8193, maximum-segment-length=0, transport-protocol=UDP
      21 x someip method deployment, all with transport-protocol=UDP:
        Activate_Method: method=PackageManagement/Activate, maximum-segment-length-request=0, method-id=4097
        Cancel_Method: method=PackageManagement/Cancel, maximum-segment-length-request=0, method-id=4098
        DeleteTransfer_Method: method=PackageManagement/DeleteTransfer, maximum-segment-length-request=0, method-id=4099
        Finish_Method: method=PackageManagement/Finish, maximum-segment-length-request=0, method-id=4100
        GetAppIVDHash_Method: method=PackageManagement/GetAppIVDHash, maximum-segment-length-response=0, method-id=4116
        GetHistory_Method: method=PackageManagement/GetHistory, maximum-segment-length-request=0, maximum-segment-length-response=0, method-id=4101
        GetId_Method: method=PackageManagement/GetId, maximum-segment-length-response=0, method-id=4102
        GetSwClusterChangeInfo_Method: method=PackageManagement/GetSwClusterChangeInfo, maximum-segment-length-response=0, method-id=4103
        GetSwClusterDescription_Method: method=PackageManagement/GetSwClusterDescription, maximum-segment-length-response=0, method-id=4104
        GetSwClusterInfo_Method: method=PackageManagement/GetSwClusterInfo, maximum-segment-length-response=0, method-id=4105
        GetSwPackages_Method: method=PackageManagement/GetSwPackages, maximum-segment-length-response=0, method-id=4106
        GetSwProcessProgress_Method: method=PackageManagement/GetSwProcessProgress, maximum-segment-length-request=0, maximum-segment-length-response=0, method-id=4107
        Initialize_Method: method=PackageManagement/Initialize, maximum-segment-length-request=0, method-id=4114
        ProcessSwPackage_Method: method=PackageManagement/ProcessSwPackage, maximum-segment-length-request=0, method-id=4108
        RemoveAppSwPackage_Method: method=PackageManagement/RemoveAppSwPackage, maximum-segment-length-request=0, method-id=4117
        RevertProcessedSwPackages_Method: method=PackageManagement/RevertProcessedSwPackages, maximum-segment-length-request=0, method-id=4109
        Rollback_Method: method=PackageManagement/Rollback, maximum-segment-length-request=0, method-id=4110
        TransferData_Method: method=PackageManagement/TransferData, maximum-segment-length-request=0, method-id=4111
        TransferExit_Method: method=PackageManagement/TransferExit, maximum-segment-length-request=0, method-id=4112
        TransferFilePath_Method: method=PackageManagement/TransferFilePath, maximum-segment-length-request=0, method-id=4115
        TransferStart_Method: method=PackageManagement/TransferStart, maximum-segment-length-request=0, maximum-segment-length-response=0, method-id=4113
      someip event group NewEventGroup1: event-group-id=1, event=CurrentStatus_Field/notifier
      someip event group NewEventGroup2: event-group-id=2, event=RollbackResult_Field/notifier
    PackageManagement_Someip: service-interface=Service/PackageManagement, service-interface-id=4049, service-interface-version={major-version=1, minor-version=3}
      25 x someip method deployment, all with transport-protocol=UDP:
        Activate_Method: method=PackageManagement/Activate, maximum-segment-length-request=0, maximum-segment-length-response=0, method-id=4097
        CheckOTAReady_Method: method=CheckOTAReady, maximum-segment-length-request=0, maximum-segment-length-response=0, method-id=4098
        CheckSwPackageIntegrity_Method: method=CheckSwPackageIntegrity, maximum-segment-length-request=0, maximum-segment-length-response=0, method-id=4120
        ConfirmReset_Method: method=PackageManagement/ConfirmReset, maximum-segment-length-request=0, method-id=4111
        DeleteTransfer_Method: method=PackageManagement/DeleteTransfer, maximum-segment-length-request=0, method-id=4099
        Finish_Method: method=PackageManagement/Finish, maximum-segment-length-request=0, method-id=4100
        GetEcuCode_Method: method=GetEcuCode, maximum-segment-length-request=0, maximum-segment-length-response=0, method-id=4115
        GetSwClusterInfo_Method: method=PackageManagement/GetSwClusterInfo, maximum-segment-length-response=0, method-id=4101
        Initialize_Method: method=PackageManagement/Initialize, maximum-segment-length-request=0, method-id=4112
        ProcessSwPackage_Method: method=PackageManagement/ProcessSwPackage, maximum-segment-length-request=0, maximum-segment-length-response=0, method-id=4102
        RequestBackgroundTransfer_Method: method=RequestBackgroundTransfer, maximum-segment-length-request=0, maximum-segment-length-response=0, method-id=4103
        RequestENMT_Method: method=RequestENMT, maximum-segment-length-response=0, method-id=4114
        RequestFinishUpdate_Method: method=RequestFinishUpdate, maximum-segment-length-request=0, maximum-segment-length-response=0, method-id=4121
        RequestPostProcess_Method: method=RequestPostProcess, maximum-segment-length-response=0, method-id=4105
        RequestPreProcess_Method: method=RequestPreProcess, maximum-segment-length-request=0, maximum-segment-length-response=0, method-id=4104
        RequestProcessingRulePreparation_Method: method=RequestProcessingRulePreparation, maximum-segment-length-request=0, maximum-segment-length-response=0, method-id=4113
        RequestSessionControl_Method: method=RequestSessionControl, maximum-segment-length-request=0, method-id=4119
        RequestTPStart_Method: method=RequestTPStart, maximum-segment-length-request=0, method-id=4116
        RequestTPStop_Method: method=RequestTPStop, maximum-segment-length-request=0, method-id=4117
        Rollback_Method: method=PackageManagement/Rollback, maximum-segment-length-request=0, maximum-segment-length-response=0, method-id=4106
        StopBackgroundTransfer_Method: method=StopBackgroundTransfer, maximum-segment-length-request=0, method-id=4118
        TransferData_Method: method=PackageManagement/TransferData, maximum-segment-length-request=0, method-id=4107
        TransferExit_Method: method=PackageManagement/TransferExit, maximum-segment-length-request=0, method-id=4108
        TransferFilePath_Method: method=PackageManagement/TransferFilePath, maximum-segment-length-request=0, method-id=4109
        TransferStart_Method: method=PackageManagement/TransferStart, maximum-segment-length-request=0, maximum-segment-length-response=0, method-id=4110
    PackageManagement_Someip: service-interface=Service/PackageManagement, service-interface-id=4048, service-interface-version={major-version=1, minor-version=2}
      6 x someip event deployment, all with maximum-segment-length=0, transport-protocol=UDP:
        AsyncServerReportRequested_Event: event=AsyncServerReportRequested, event-id=4102
        MobileOriginateRequested_Event: event=MobileOriginateRequested, event-id=4101
        MobileServerInfoReportRequested_Event: event=MobileServerInfoReportRequested, event-id=4099
        MobileServerResultReportRequested_Event: event=MobileServerResultReportRequested, event-id=4100
        ResetPrepareRequested_Event: event=ResetPrepareRequested, event-id=4097
        ServerReportRequested_Event: event=ServerReportRequested, event-id=4098
      6 x someip field deployment:
        InitializeRequested_Field: field=InitializeRequested
          get getter: maximum-segment-length-request=0, maximum-segment-length-response=0, method-id=8197, transport-protocol=UDP
          notifier notifier: event-id=8197, maximum-segment-length=0, transport-protocol=UDP
        OtaFeatureInfo_Field: field=OtaFeatureInfo
          get getter: maximum-segment-length-request=0, maximum-segment-length-response=0, method-id=8199, transport-protocol=UDP
          notifier notifier: event-id=8199, maximum-segment-length=0, transport-protocol=UDP
          set setter: maximum-segment-length-request=0, maximum-segment-length-response=0, method-id=12289, transport-protocol=UDP
        SwReleaseResultReport_Field: field=SwReleaseResultReport
          get getter: maximum-segment-length-request=0, maximum-segment-length-response=0, method-id=8196, transport-protocol=UDP
          notifier notifier: event-id=8196, maximum-segment-length=0, transport-protocol=UDP
        UpdateClientInfo_Field: field=UpdateClientInfo
          get getter: maximum-segment-length-request=0, maximum-segment-length-response=0, method-id=8198, transport-protocol=UDP
          notifier notifier: event-id=8198, maximum-segment-length=0, transport-protocol=UDP
        UpdateMasterState_Field: field=UpdateMasterState
          get getter: maximum-segment-length-request=0, maximum-segment-length-response=0, method-id=8194, transport-protocol=UDP
          notifier notifier: event-id=8194, maximum-segment-length=0, transport-protocol=UDP
        UpdateProgressReport_Field: field=UpdateProgressReport
          get getter: maximum-segment-length-request=0, maximum-segment-length-response=0, method-id=8195, transport-protocol=UDP
          notifier notifier: event-id=8195, maximum-segment-length=0, transport-protocol=UDP
      29 x someip method deployment, all with transport-protocol=UDP:
        CancelUpdate_Method: method=CancelUpdate, maximum-segment-length-request=0, method-id=4097
        ConfirmReset_Method: method=PackageManagement/ConfirmReset, maximum-segment-length-request=0, method-id=4108
        ConfirmSessionInactive_Method: method=ConfirmSessionInactive, maximum-segment-length-request=0, method-id=4117
        DeleteTransfer_Method: method=PackageManagement/DeleteTransfer, maximum-segment-length-request=0, method-id=4098
        FinishSoftwarePackageTransfer_Method: method=FinishSoftwarePackageTransfer, maximum-segment-length-request=0, method-id=4099
        GetOtaConditions_Method: method=GetOtaConditions, maximum-segment-length-response=0, method-id=4121
        GetPhoneUpdateAvailable_Method: method=GetPhoneUpdateAvailable, maximum-segment-length-response=0, method-id=4122
        GetProcessingRulePreparationResult_Method: method=GetProcessingRulePreparationResult, maximum-segment-length-response=0, method-id=4114
        GetSwClusterInfo_Method: method=PackageManagement/GetSwClusterInfo, maximum-segment-length-response=0, method-id=4100
        GetVehicleVersion_Method: method=GetVehicleVersion, maximum-segment-length-response=0, method-id=4115
        Initialize_Method: method=PackageManagement/Initialize, maximum-segment-length-request=0, method-id=4109
        MobileOriginateResponse_Method: method=MobileOriginateResponse, maximum-segment-length-request=0, method-id=4120
        MobileTerminateRequest_Method: method=MobileTerminateRequest, maximum-segment-length-request=0, maximum-segment-length-response=0, method-id=4119
        RemoveApplicationSoftware_Method: method=RemoveApplicationSoftware, maximum-segment-length-request=0, method-id=4124
        ReportResetReady_Method: method=ReportResetReady, maximum-segment-length-request=0, method-id=4110
        RequestRDBI_Method: method=PackageManagement/RequestRDBI, maximum-segment-length-request=0, maximum-segment-length-response=0, method-id=4112
        RequestRDBIfilepath_Method: method=RequestRDBIfilepath, maximum-segment-length-request=0, maximum-segment-length-response=0, method-id=4111
        RequestRoutineControl_Method: method=PackageManagement/RequestRoutineControl, maximum-segment-length-request=0, maximum-segment-length-response=0, method-id=4113
        SetPhoneUpdateClientStatus_Method: method=SetPhoneUpdateClientStatus, maximum-segment-length-request=0, method-id=4123
        SetUmaEOUStatus_Method: method=SetUmaEOUStatus, maximum-segment-length-request=0, method-id=4125
        SwPackageInventory_Method: method=SwPackageInventory, maximum-segment-length-request=0, maximum-segment-length-response=0, method-id=4101
        TransferData_Method: method=PackageManagement/TransferData, maximum-segment-length-request=0, method-id=4102
        TransferExit_Method: method=PackageManagement/TransferExit, maximum-segment-length-request=0, method-id=4103
        TransferFilePath_Method: method=PackageManagement/TransferFilePath, maximum-segment-length-request=0, method-id=4104
        TransferStart_Method: method=PackageManagement/TransferStart, maximum-segment-length-request=0, maximum-segment-length-response=0, method-id=4105
        TransferVehiclePackage_Method: method=TransferVehiclePackage, maximum-segment-length-request=0, maximum-segment-length-response=0, method-id=4106
        UpdateCCUConfig_Method: method=UpdateCCUConfig, maximum-segment-length-request=0, method-id=4107
        UpdateVehicleVersion_Method: method=UpdateVehicleVersion, maximum-segment-length-request=0, method-id=4116
        ValidateFinish_Method: method=ValidateFinish, maximum-segment-length-request=0, method-id=4118
      12 x someip event group:
        NewEventGroup: event-group-id=1, event=InitializeRequested_Field/notifier
        NewEventGroup1: event-group-id=2, event=MobileOriginateRequested_Event
        NewEventGroup10: event-group-id=11, event=AsyncServerReportRequested_Event
        NewEventGroup11: event-group-id=12, event=OtaFeatureInfo_Field/notifier
        NewEventGroup2: event-group-id=3, event=MobileServerInfoReportRequested_Event
        NewEventGroup3: event-group-id=4, event=MobileServerResultReportRequested_Event
        NewEventGroup4: event-group-id=5, event=ResetPrepareRequested_Event
        NewEventGroup5: event-group-id=6, event=ServerReportRequested_Event
        NewEventGroup6: event-group-id=7, event=SwReleaseResultReport_Field/notifier
        NewEventGroup7: event-group-id=8, event=UpdateClientInfo_Field/notifier
        NewEventGroup8: event-group-id=9, event=UpdateMasterState_Field/notifier
        NewEventGroup9: event-group-id=10, event=UpdateProgressReport_Field/notifier
    PackageManagement_Someip: service-interface=Service/PackageManagement, service-interface-id=4051, service-interface-version={major-version=1, minor-version=3}
      someip field deployment CurrentStatus_Field: field=PackageManagement/CurrentStatus
        get getter: maximum-segment-length-request=0, maximum-segment-length-response=0, method-id=8199, transport-protocol=UDP
        notifier notifier: event-id=8200, maximum-segment-length=0, transport-protocol=UDP
      someip field deployment PreInstallRequiredAppsInfo_Field: field=PreInstallRequiredAppsInfo
        get getter: maximum-segment-length-request=0, maximum-segment-length-response=0, method-id=8194, transport-protocol=UDP
        notifier notifier: event-id=8194, maximum-segment-length=0, transport-protocol=UDP
      someip field deployment RollbackResult_Field: field=PackageManagement/RollbackResult
        get getter: maximum-segment-length-request=0, maximum-segment-length-response=0, method-id=8193, transport-protocol=UDP
        notifier notifier: event-id=8193, maximum-segment-length=0, transport-protocol=UDP
      22 x someip method deployment, all with transport-protocol=UDP:
        Activate_Method: method=PackageManagement/Activate, maximum-segment-length-request=0, method-id=4097
        Cancel_Method: method=PackageManagement/Cancel, maximum-segment-length-request=0, method-id=4098
        DeleteTransfer_Method: method=PackageManagement/DeleteTransfer, maximum-segment-length-request=0, method-id=4099
        Finish_Method: method=PackageManagement/Finish, maximum-segment-length-request=0, method-id=4100
        GetAppIVDHash_Method: method=PackageManagement/GetAppIVDHash, maximum-segment-length-response=0, method-id=4116
        GetHistory_Method: method=PackageManagement/GetHistory, maximum-segment-length-request=0, maximum-segment-length-response=0, method-id=4101
        GetId_Method: method=PackageManagement/GetId, maximum-segment-length-response=0, method-id=4102
        GetSwClusterChangeInfo_Method: method=PackageManagement/GetSwClusterChangeInfo, maximum-segment-length-response=0, method-id=4103
        GetSwClusterDescription_Method: method=PackageManagement/GetSwClusterDescription, maximum-segment-length-response=0, method-id=4104
        GetSwClusterInfo_Method: method=PackageManagement/GetSwClusterInfo, maximum-segment-length-response=0, method-id=4105
        GetSwPackages_Method: method=PackageManagement/GetSwPackages, maximum-segment-length-response=0, method-id=4106
        GetSwProcessProgress_Method: method=PackageManagement/GetSwProcessProgress, maximum-segment-length-request=0, maximum-segment-length-response=0, method-id=4107
        Initialize_Method: method=PackageManagement/Initialize, maximum-segment-length-request=0, method-id=4114
        ProcessSwPackage_Method: method=PackageManagement/ProcessSwPackage, maximum-segment-length-request=0, method-id=4108
        RemoveAppSwPackage_Method: method=PackageManagement/RemoveAppSwPackage, maximum-segment-length-request=0, method-id=4117
        RequestRDBI_Method: method=PackageManagement/RequestRDBI, maximum-segment-length-request=0, maximum-segment-length-response=0, method-id=4118
        RevertProcessedSwPackages_Method: method=PackageManagement/RevertProcessedSwPackages, maximum-segment-length-request=0, method-id=4109
        Rollback_Method: method=PackageManagement/Rollback, maximum-segment-length-request=0, method-id=4110
        TransferData_Method: method=PackageManagement/TransferData, maximum-segment-length-request=0, method-id=4111
        TransferExit_Method: method=PackageManagement/TransferExit, maximum-segment-length-request=0, method-id=4112
        TransferFilePath_Method: method=PackageManagement/TransferFilePath, maximum-segment-length-request=0, method-id=4115
        TransferStart_Method: method=PackageManagement/TransferStart, maximum-segment-length-request=0, maximum-segment-length-response=0, method-id=4113
      someip event group NewEventGroup: event-group-id=1, event=CurrentStatus_Field/notifier
      someip event group NewEventGroup1: event-group-id=2, event=RollbackResult_Field/notifier
      someip event group NewEventGroup2: event-group-id=3, event=PreInstallRequiredAppsInfo_Field/notifier
    Policy_Someip: service-interface=Service/Policy, service-interface-id=3115, service-interface-version={major-version=1, minor-version=3}
      12 x someip method deployment, all with transport-protocol=UDP:
        AllowCANStreaming_Method: method=AllowCANStreaming, maximum-segment-length-request=0, method-id=4106
        AllowDLTStreaming_Method: method=AllowDLTStreaming, maximum-segment-length-request=0, method-id=4105
        ChangeIVNRule_Method: method=ChangeIVNRule, maximum-segment-length-request=0, maximum-segment-length-response=0, method-id=4107
        GetAPNStatus_Method: method=Policy/GetAPNStatus, maximum-segment-length-request=0, maximum-segment-length-response=0, method-id=4099
        GetAllAPNStatus_Method: method=GetAllAPNStatus, maximum-segment-length-response=0, method-id=4097
        GetAllServiceGroupsAPN_Method: method=GetAllServiceGroupsAPN, maximum-segment-length-response=0, method-id=4098
        GetCumulativeVccStats_Method: method=GetCumulativeVccStats, maximum-segment-length-request=0, maximum-segment-length-response=0, method-id=4100
        GetPolicyStatus_Method: method=GetPolicyStatus, maximum-segment-length-response=0, method-id=4101
        GetRegionStatus_Method: method=GetRegionStatus, maximum-segment-length-response=0, method-id=4102
        GetServiceGroupAPN_Method: method=GetServiceGroupAPN, maximum-segment-length-request=0, maximum-segment-length-response=0, method-id=4103
        GetVccStats_Method: method=GetVccStats, maximum-segment-length-request=0, maximum-segment-length-response=0, method-id=4104
        SetContainerRules_Method: method=SetContainerRules, maximum-segment-length-request=0, maximum-segment-length-response=0, method-id=4108
    Policy_Someip: service-interface=Service/Policy, service-interface-id=3080, service-interface-version={major-version=1, minor-version=0}
      11 x someip event deployment, all with maximum-segment-length=0, transport-protocol=UDP:
        CIDSLogRetrieve_Event: event=CIDSLogRetrieve, event-id=4109
        CIDSPolicyDownloaded_Event: event=CIDSPolicyDownloaded, event-id=4104
        CmPolicyDownloaded_Event: event=CmPolicyDownloaded, event-id=4107
        EIDSLogRetrieve_Event: event=EIDSLogRetrieve, event-id=4110
        EIDSPolicyDownloaded_Event: event=EIDSPolicyDownloaded, event-id=4106
        KvsPolicyDownloaded_Event: event=KvsPolicyDownloaded, event-id=4108
        NssPolicyDownloaded_Event: event=NssPolicyDownloaded, event-id=4097
        TePolicyDownloaded_Event: event=TePolicyDownloaded, event-id=4098
        VamRecipeDownloaded_Event: event=VamRecipeDownloaded, event-id=4099
        VccPolicyDownloaded_Event: event=VccPolicyDownloaded, event-id=4100
        VdcPolicyDownloaded_Event: event=VdcPolicyDownloaded, event-id=4111
      someip method deployment PolicyUpdateComplete_Method: method=PolicyUpdateComplete, maximum-segment-length-request=0, maximum-segment-length-response=0, method-id=4097, transport-protocol=UDP
      11 x someip event group:
        NewEventGroup: event-group-id=1, event=CIDSLogRetrieve_Event
        NewEventGroup1: event-group-id=2, event=CIDSPolicyDownloaded_Event
        NewEventGroup10: event-group-id=11, event=VdcPolicyDownloaded_Event
        NewEventGroup2: event-group-id=3, event=CmPolicyDownloaded_Event
        NewEventGroup3: event-group-id=4, event=EIDSLogRetrieve_Event
        NewEventGroup4: event-group-id=5, event=EIDSPolicyDownloaded_Event
        NewEventGroup5: event-group-id=6, event=KvsPolicyDownloaded_Event
        NewEventGroup6: event-group-id=7, event=NssPolicyDownloaded_Event
        NewEventGroup7: event-group-id=8, event=TePolicyDownloaded_Event
        NewEventGroup8: event-group-id=9, event=VamRecipeDownloaded_Event
        NewEventGroup9: event-group-id=10, event=VccPolicyDownloaded_Event
    PowerManagement_Someip: service-interface=PowerManagement, service-interface-id=6402, service-interface-version={major-version=2, minor-version=2}
      someip field deployment ModemPowerStatus_Field: field=ModemPowerStatus
        get getter: maximum-segment-length-request=0, maximum-segment-length-response=0, method-id=8193, transport-protocol=TCP
        notifier notifier: event-id=8193, maximum-segment-length=0, transport-protocol=TCP
      someip field deployment SystemBootReason_Field: field=SystemBootReason
        get getter: maximum-segment-length-request=0, maximum-segment-length-response=0, method-id=8194, transport-protocol=TCP
        notifier notifier: event-id=8194, maximum-segment-length=0, transport-protocol=TCP
      someip method deployment GetRemoteControlWaitingTime_Method: method=PowerManagement/GetRemoteControlWaitingTime, maximum-segment-length-response=0, method-id=4098, transport-protocol=TCP
      someip method deployment SetRemoteControlWaitingTime_Method: method=SetRemoteControlWaitingTime, maximum-segment-length-request=0, maximum-segment-length-response=0, method-id=4097, transport-protocol=TCP
      someip method deployment SetWakeupPinStatus_Method: method=SetWakeupPinStatus, maximum-segment-length-response=0, method-id=4099, transport-protocol=TCP
      someip event group SomeIpEventGroups: event-group-id=4097, event=[ModemPowerStatus_Field/notifier, SystemBootReason_Field/notifier]
    PowerTrain1_Someip: service-interface=PowerTrain1, service-interface-id=3102, service-interface-version={major-version=1, minor-version=1}
      someip event deployment VCU_01_10ms_Event: event=VCU_01_10ms, event-id=4097, maximum-segment-length=0, transport-protocol=UDP
      25 x someip field deployment:
        ACInputPower_Field: field=ACInputPower
          get getter: maximum-segment-length-request=0, maximum-segment-length-response=0, method-id=8213, transport-protocol=UDP
          notifier notifier: event-id=8213, maximum-segment-length=0, transport-protocol=UDP
        AutoPowerOffInfo_Field: field=AutoPowerOffInfo
          get getter: maximum-segment-length-request=0, maximum-segment-length-response=0, method-id=8193, transport-protocol=UDP
          notifier notifier: event-id=8193, maximum-segment-length=0, transport-protocol=UDP
        AutoPowerOffTimerInfo_Field: field=AutoPowerOffTimerInfo
          get getter: maximum-segment-length-request=0, maximum-segment-length-response=0, method-id=8194, transport-protocol=UDP
          notifier notifier: event-id=8194, maximum-segment-length=0, transport-protocol=UDP
        CCSLeakNotification_Field: field=CCSLeakNotification
          get getter: maximum-segment-length-request=0, maximum-segment-length-response=0, method-id=8216, transport-protocol=UDP
          notifier notifier: event-id=8216, maximum-segment-length=0, transport-protocol=UDP
        CO2ReductionAmount_Field: field=CO2ReductionAmount
          get getter: maximum-segment-length-request=0, maximum-segment-length-response=0, method-id=8199, transport-protocol=UDP
          notifier notifier: event-id=8199, maximum-segment-length=0, transport-protocol=UDP
        CO2ReductionTripDistance_Field: field=CO2ReductionTripDistance
          get getter: maximum-segment-length-request=0, maximum-segment-length-response=0, method-id=8200, transport-protocol=UDP
          notifier notifier: event-id=8200, maximum-segment-length=0, transport-protocol=UDP
        ChargeAlarmState_Field: field=ChargeAlarmState
          get getter: maximum-segment-length-request=0, maximum-segment-length-response=0, method-id=8211, transport-protocol=UDP
          notifier notifier: event-id=8211, maximum-segment-length=0, transport-protocol=UDP
        ChargeAlarmSubcode_Field: field=ChargeAlarmSubcode
          get getter: maximum-segment-length-request=0, maximum-segment-length-response=0, method-id=8212, transport-protocol=UDP
          notifier notifier: event-id=8212, maximum-segment-length=0, transport-protocol=UDP
        EngineOilLevelLampState_Field: field=EngineOilLevelLampState
          get getter: maximum-segment-length-request=0, maximum-segment-length-response=0, method-id=8195, transport-protocol=UDP
          notifier notifier: event-id=8195, maximum-segment-length=0, transport-protocol=UDP
        EngineRPM_Field: field=EngineRPM
          get getter: maximum-segment-length-request=0, maximum-segment-length-response=0, method-id=8196, transport-protocol=UDP
          notifier notifier: event-id=8196, maximum-segment-length=0, transport-protocol=UDP
        FuelH2State_Field: field=FuelH2State
          get getter: maximum-segment-length-request=0, maximum-segment-length-response=0, method-id=8202, transport-protocol=UDP
          notifier notifier: event-id=8202, maximum-segment-length=0, transport-protocol=UDP
        GearPosition_Field: field=PowerTrain1/GearPosition
          get getter: maximum-segment-length-request=0, maximum-segment-length-response=0, method-id=8197, transport-protocol=UDP
          notifier notifier: event-id=8197, maximum-segment-length=0, transport-protocol=UDP
        H2Status_Field: field=H2Status
          get getter: maximum-segment-length-request=0, maximum-segment-length-response=0, method-id=8218, transport-protocol=UDP
          notifier notifier: event-id=8218, maximum-segment-length=0, transport-protocol=UDP
        HEVEngineOilLevelLampState_Field: field=HEVEngineOilLevelLampState
          get getter: maximum-segment-length-request=0, maximum-segment-length-response=0, method-id=8204, transport-protocol=UDP
          notifier notifier: event-id=8204, maximum-segment-length=0, transport-protocol=UDP
        HEVEngineRPM_Field: field=HEVEngineRPM
          get getter: maximum-segment-length-request=0, maximum-segment-length-response=0, method-id=8205, transport-protocol=UDP
          notifier notifier: event-id=8205, maximum-segment-length=0, transport-protocol=UDP
        HeadsBreathingbyPurAir_Field: field=HeadsBreathingbyPurAir
          get getter: maximum-segment-length-request=0, maximum-segment-length-response=0, method-id=8203, transport-protocol=UDP
          notifier notifier: event-id=8203, maximum-segment-length=0, transport-protocol=UDP
        HydrogenLeakStatus_Field: field=HydrogenLeakStatus
          get getter: maximum-segment-length-request=0, maximum-segment-length-response=0, method-id=8219, transport-protocol=UDP
          notifier notifier: event-id=8219, maximum-segment-length=0, transport-protocol=UDP
        ParkingReleaseState_Field: field=ParkingReleaseState
          get getter: maximum-segment-length-request=0, maximum-segment-length-response=0, method-id=8198, transport-protocol=UDP
          notifier notifier: event-id=8198, maximum-segment-length=0, transport-protocol=UDP
        PurifiedAirAmount_Field: field=PurifiedAirAmount
          get getter: maximum-segment-length-request=0, maximum-segment-length-response=0, method-id=8206, transport-protocol=UDP
          notifier notifier: event-id=8206, maximum-segment-length=0, transport-protocol=UDP
        SCU_FF_IG3WakeUpStatus_Field: field=SCU_FF_IG3WakeUpStatus
          get getter: maximum-segment-length-request=0, maximum-segment-length-response=0, method-id=8210, transport-protocol=UDP
          notifier notifier: event-id=8210, maximum-segment-length=0, transport-protocol=UDP
        SCU_FF_PositionActStatus_Field: field=SCU_FF_PositionActStatus
          get getter: maximum-segment-length-request=0, maximum-segment-length-response=0, method-id=8209, transport-protocol=UDP
          notifier notifier: event-id=8209, maximum-segment-length=0, transport-protocol=UDP
        UREALevel_Field: field=UREALevel
          get getter: maximum-segment-length-request=0, maximum-segment-length-response=0, method-id=8208, transport-protocol=UDP
          notifier notifier: event-id=8208, maximum-segment-length=0, transport-protocol=UDP
        V2LRemainTime_Field: field=V2LRemainTime
          get getter: maximum-segment-length-request=0, maximum-segment-length-response=0, method-id=8214, transport-protocol=UDP
          notifier notifier: event-id=8214, maximum-segment-length=0, transport-protocol=UDP
        V2XDisplayOptionFlag_Field: field=V2XDisplayOptionFlag
          get getter: maximum-segment-length-request=0, maximum-segment-length-response=0, method-id=8215, transport-protocol=UDP
          notifier notifier: event-id=8215, maximum-segment-length=0, transport-protocol=UDP
        WCCUReadyState_Field: field=WCCUReadyState
          get getter: maximum-segment-length-request=0, maximum-segment-length-response=0, method-id=8207, transport-protocol=UDP
          notifier notifier: event-id=8207, maximum-segment-length=0, transport-protocol=UDP
      26 x someip event group:
        NewEventGroup: event-group-id=1, event=ACInputPower_Field/notifier
        NewEventGroup1: event-group-id=2, event=AutoPowerOffInfo_Field/notifier
        NewEventGroup10: event-group-id=11, event=FuelH2State_Field/notifier
        NewEventGroup11: event-group-id=12, event=GearPosition_Field/notifier
        NewEventGroup12: event-group-id=13, event=H2Status_Field/notifier
        NewEventGroup13: event-group-id=14, event=HEVEngineOilLevelLampState_Field/notifier
        NewEventGroup14: event-group-id=15, event=HEVEngineRPM_Field/notifier
        NewEventGroup15: event-group-id=16, event=HeadsBreathingbyPurAir_Field/notifier
        NewEventGroup16: event-group-id=17, event=HydrogenLeakStatus_Field/notifier
        NewEventGroup17: event-group-id=18, event=ParkingReleaseState_Field/notifier
        NewEventGroup18: event-group-id=19, event=PurifiedAirAmount_Field/notifier
        NewEventGroup19: event-group-id=20, event=SCU_FF_IG3WakeUpStatus_Field/notifier
        NewEventGroup2: event-group-id=3, event=AutoPowerOffTimerInfo_Field/notifier
        NewEventGroup20: event-group-id=21, event=SCU_FF_PositionActStatus_Field/notifier
        NewEventGroup21: event-group-id=22, event=UREALevel_Field/notifier
        NewEventGroup22: event-group-id=23, event=V2LRemainTime_Field/notifier
        NewEventGroup24: event-group-id=25, event=V2XDisplayOptionFlag_Field/notifier
        NewEventGroup25: event-group-id=26, event=WCCUReadyState_Field/notifier
        NewEventGroup26: event-group-id=27, event=VCU_01_10ms_Event
        NewEventGroup3: event-group-id=4, event=CCSLeakNotification_Field/notifier
        NewEventGroup4: event-group-id=5, event=CO2ReductionAmount_Field/notifier
        NewEventGroup5: event-group-id=6, event=CO2ReductionTripDistance_Field/notifier
        NewEventGroup6: event-group-id=7, event=ChargeAlarmState_Field/notifier
        NewEventGroup7: event-group-id=8, event=ChargeAlarmSubcode_Field/notifier
        NewEventGroup8: event-group-id=9, event=EngineOilLevelLampState_Field/notifier
        NewEventGroup9: event-group-id=10, event=EngineRPM_Field/notifier
    PowerTrain2_Someip: service-interface=PowerTrain2, service-interface-id=3103, service-interface-version={major-version=2, minor-version=1}
      355 x someip field deployment:
        ACChargingStatus_Field: field=ACChargingStatus
          get getter: maximum-segment-length-request=0, maximum-segment-length-response=0, method-id=8343, transport-protocol=UDP
          notifier notifier: event-id=8343, maximum-segment-length=0, transport-protocol=UDP
        ACNPermissionPower_Field: field=ACNPermissionPower
          get getter: maximum-segment-length-request=0, maximum-segment-length-response=0, method-id=8413, transport-protocol=UDP
          notifier notifier: event-id=8413, maximum-segment-length=0, transport-protocol=UDP
        AVNDTECorrelationFactorValue_Field: field=AVNDTECorrelationFactorValue
          get getter: maximum-segment-length-request=0, maximum-segment-length-response=0, method-id=8410, transport-protocol=UDP
          notifier notifier: event-id=8410, maximum-segment-length=0, transport-protocol=UDP
        AirconditionerActivation_Field: field=AirconditionerActivation
          get getter: maximum-segment-length-request=0, maximum-segment-length-response=0, method-id=8394, transport-protocol=UDP
          notifier notifier: event-id=8394, maximum-segment-length=0, transport-protocol=UDP
        AirconditionerControlStatus_Field: field=AirconditionerControlStatus
          get getter: maximum-segment-length-request=0, maximum-segment-length-response=0, method-id=8396, transport-protocol=UDP
          notifier notifier: event-id=8396, maximum-segment-length=0, transport-protocol=UDP
        AirconditioningFinishAlarmStatus_Field: field=AirconditioningFinishAlarmStatus
          get getter: maximum-segment-length-request=0, maximum-segment-length-response=0, method-id=8395, transport-protocol=UDP
          notifier notifier: event-id=8395, maximum-segment-length=0, transport-protocol=UDP
        AutoPowerOff_Field: field=AutoPowerOff
          get getter: maximum-segment-length-request=0, maximum-segment-length-response=0, method-id=8193, transport-protocol=UDP
          notifier notifier: event-id=8193, maximum-segment-length=0, transport-protocol=UDP
        AutoShutOffTime_Field: field=AutoShutOffTime
          get getter: maximum-segment-length-request=0, maximum-segment-length-response=0, method-id=8194, transport-protocol=UDP
          notifier notifier: event-id=8194, maximum-segment-length=0, transport-protocol=UDP
        AuxiliaryBattChargeInhibitCauseType_Field: field=AuxiliaryBattChargeInhibitCauseType
          get getter: maximum-segment-length-request=0, maximum-segment-length-response=0, method-id=8279, transport-protocol=UDP
          notifier notifier: event-id=8279, maximum-segment-length=0, transport-protocol=UDP
        AvailableEnergyValue_Field: field=AvailableEnergyValue
          get getter: maximum-segment-length-request=0, maximum-segment-length-response=0, method-id=8195, transport-protocol=UDP
          notifier notifier: event-id=8195, maximum-segment-length=0, transport-protocol=UDP
        BMSSWversion_Field: field=BMSSWversion
          get getter: maximum-segment-length-request=0, maximum-segment-length-response=0, method-id=8400, transport-protocol=UDP
          notifier notifier: event-id=8400, maximum-segment-length=0, transport-protocol=UDP
        BatChllrTgtRpm_Field: field=BatChllrTgtRpm
          get getter: maximum-segment-length-request=0, maximum-segment-length-response=0, method-id=8411, transport-protocol=UDP
          notifier notifier: event-id=8411, maximum-segment-length=0, transport-protocol=UDP
        BatWcsHeaterOnReq_Field: field=BatWcsHeaterOnReq
          get getter: maximum-segment-length-request=0, maximum-segment-length-response=0, method-id=8412, transport-protocol=UDP
          notifier notifier: event-id=8412, maximum-segment-length=0, transport-protocol=UDP
        BattCell10VoltVal_Field: field=BattCell10VoltVal
          get getter: maximum-segment-length-request=0, maximum-segment-length-response=0, method-id=8440, transport-protocol=UDP
          notifier notifier: event-id=8440, maximum-segment-length=0, transport-protocol=UDP
        BattCell11VoltVal_Field: field=BattCell11VoltVal
          get getter: maximum-segment-length-request=0, maximum-segment-length-response=0, method-id=8441, transport-protocol=UDP
          notifier notifier: event-id=8441, maximum-segment-length=0, transport-protocol=UDP
        BattCell12VoltVal_Field: field=BattCell12VoltVal
          get getter: maximum-segment-length-request=0, maximum-segment-length-response=0, method-id=8442, transport-protocol=UDP
          notifier notifier: event-id=8442, maximum-segment-length=0, transport-protocol=UDP
        BattCell13VoltVal_Field: field=BattCell13VoltVal
          get getter: maximum-segment-length-request=0, maximum-segment-length-response=0, method-id=8443, transport-protocol=UDP
          notifier notifier: event-id=8443, maximum-segment-length=0, transport-protocol=UDP
        BattCell14VoltVal_Field: field=BattCell14VoltVal
          get getter: maximum-segment-length-request=0, maximum-segment-length-response=0, method-id=8444, transport-protocol=UDP
          notifier notifier: event-id=8444, maximum-segment-length=0, transport-protocol=UDP
        BattCell15VoltVal_Field: field=BattCell15VoltVal
          get getter: maximum-segment-length-request=0, maximum-segment-length-response=0, method-id=8446, transport-protocol=UDP
          notifier notifier: event-id=8446, maximum-segment-length=0, transport-protocol=UDP
        BattCell16VoltVal_Field: field=BattCell16VoltVal
          get getter: maximum-segment-length-request=0, maximum-segment-length-response=0, method-id=8447, transport-protocol=UDP
          notifier notifier: event-id=8447, maximum-segment-length=0, transport-protocol=UDP
        BattCell17VoltVal_Field: field=BattCell17VoltVal
          get getter: maximum-segment-length-request=0, maximum-segment-length-response=0, method-id=8448, transport-protocol=UDP
          notifier notifier: event-id=8448, maximum-segment-length=0, transport-protocol=UDP
        BattCell18VoltVal_Field: field=BattCell18VoltVal
          get getter: maximum-segment-length-request=0, maximum-segment-length-response=0, method-id=8449, transport-protocol=UDP
          notifier notifier: event-id=8449, maximum-segment-length=0, transport-protocol=UDP
        BattCell19VoltVal_Field: field=BattCell19VoltVal
          get getter: maximum-segment-length-request=0, maximum-segment-length-response=0, method-id=8450, transport-protocol=UDP
          notifier notifier: event-id=8450, maximum-segment-length=0, transport-protocol=UDP
        BattCell1VoltVal_Field: field=BattCell1VoltVal
          get getter: maximum-segment-length-request=0, maximum-segment-length-response=0, method-id=8431, transport-protocol=UDP
          notifier notifier: event-id=8431, maximum-segment-length=0, transport-protocol=UDP
        BattCell1_Index_Field: field=BattCell1_Index
          get getter: maximum-segment-length-request=0, maximum-segment-length-response=0, method-id=8430, transport-protocol=UDP
          notifier notifier: event-id=8430, maximum-segment-length=0, transport-protocol=UDP
        BattCell20VoltVal_Field: field=BattCell20VoltVal
          get getter: maximum-segment-length-request=0, maximum-segment-length-response=0, method-id=8451, transport-protocol=UDP
          notifier notifier: event-id=8451, maximum-segment-length=0, transport-protocol=UDP
        BattCell21VoltVal_Field: field=BattCell21VoltVal
          get getter: maximum-segment-length-request=0, maximum-segment-length-response=0, method-id=8452, transport-protocol=UDP
          notifier notifier: event-id=8452, maximum-segment-length=0, transport-protocol=UDP
        BattCell22VoltVal_Field: field=BattCell22VoltVal
          get getter: maximum-segment-length-request=0, maximum-segment-length-response=0, method-id=8453, transport-protocol=UDP
          notifier notifier: event-id=8453, maximum-segment-length=0, transport-protocol=UDP
        BattCell23VoltVal_Field: field=BattCell23VoltVal
          get getter: maximum-segment-length-request=0, maximum-segment-length-response=0, method-id=8454, transport-protocol=UDP
          notifier notifier: event-id=8454, maximum-segment-length=0, transport-protocol=UDP
        BattCell24VoltVal_Field: field=BattCell24VoltVal
          get getter: maximum-segment-length-request=0, maximum-segment-length-response=0, method-id=8455, transport-protocol=UDP
          notifier notifier: event-id=8455, maximum-segment-length=0, transport-protocol=UDP
        BattCell25VoltVal_Field: field=BattCell25VoltVal
          get getter: maximum-segment-length-request=0, maximum-segment-length-response=0, method-id=8456, transport-protocol=UDP
          notifier notifier: event-id=8456, maximum-segment-length=0, transport-protocol=UDP
        BattCell26VoltVal_Field: field=BattCell26VoltVal
          get getter: maximum-segment-length-request=0, maximum-segment-length-response=0, method-id=8457, transport-protocol=UDP
          notifier notifier: event-id=8457, maximum-segment-length=0, transport-protocol=UDP
        BattCell27VoltVal_Field: field=BattCell27VoltVal
          get getter: maximum-segment-length-request=0, maximum-segment-length-response=0, method-id=8458, transport-protocol=UDP
          notifier notifier: event-id=8458, maximum-segment-length=0, transport-protocol=UDP
        BattCell28VoltVal_Field: field=BattCell28VoltVal
          get getter: maximum-segment-length-request=0, maximum-segment-length-response=0, method-id=8459, transport-protocol=UDP
          notifier notifier: event-id=8459, maximum-segment-length=0, transport-protocol=UDP
        BattCell29VoltVal_Field: field=BattCell29VoltVal
          get getter: maximum-segment-length-request=0, maximum-segment-length-response=0, method-id=8461, transport-protocol=UDP
          notifier notifier: event-id=8461, maximum-segment-length=0, transport-protocol=UDP
        BattCell2VoltVal_Field: field=BattCell2VoltVal
          get getter: maximum-segment-length-request=0, maximum-segment-length-response=0, method-id=8432, transport-protocol=UDP
          notifier notifier: event-id=8432, maximum-segment-length=0, transport-protocol=UDP
        BattCell2_Index_Field: field=BattCell2_Index
          get getter: maximum-segment-length-request=0, maximum-segment-length-response=0, method-id=8445, transport-protocol=UDP
          notifier notifier: event-id=8445, maximum-segment-length=0, transport-protocol=UDP
        BattCell30VoltVal_Field: field=BattCell30VoltVal
          get getter: maximum-segment-length-request=0, maximum-segment-length-response=0, method-id=8462, transport-protocol=UDP
          notifier notifier: event-id=8462, maximum-segment-length=0, transport-protocol=UDP
        BattCell31VoltVal_Field: field=BattCell31VoltVal
          get getter: maximum-segment-length-request=0, maximum-segment-length-response=0, method-id=8463, transport-protocol=UDP
          notifier notifier: event-id=8463, maximum-segment-length=0, transport-protocol=UDP
        BattCell32VoltVal_Field: field=BattCell32VoltVal
          get getter: maximum-segment-length-request=0, maximum-segment-length-response=0, method-id=8464, transport-protocol=UDP
          notifier notifier: event-id=8464, maximum-segment-length=0, transport-protocol=UDP
        BattCell33VoltVal_Field: field=BattCell33VoltVal
          get getter: maximum-segment-length-request=0, maximum-segment-length-response=0, method-id=8465, transport-protocol=UDP
          notifier notifier: event-id=8465, maximum-segment-length=0, transport-protocol=UDP
        BattCell34VoltVal_Field: field=BattCell34VoltVal
          get getter: maximum-segment-length-request=0, maximum-segment-length-response=0, method-id=8466, transport-protocol=UDP
          notifier notifier: event-id=8466, maximum-segment-length=0, transport-protocol=UDP
        BattCell35VoltVal_Field: field=BattCell35VoltVal
          get getter: maximum-segment-length-request=0, maximum-segment-length-response=0, method-id=8467, transport-protocol=UDP
          notifier notifier: event-id=8467, maximum-segment-length=0, transport-protocol=UDP
        BattCell36VoltVal_Field: field=BattCell36VoltVal
          get getter: maximum-segment-length-request=0, maximum-segment-length-response=0, method-id=8468, transport-protocol=UDP
          notifier notifier: event-id=8468, maximum-segment-length=0, transport-protocol=UDP
        BattCell37VoltVal_Field: field=BattCell37VoltVal
          get getter: maximum-segment-length-request=0, maximum-segment-length-response=0, method-id=8469, transport-protocol=UDP
          notifier notifier: event-id=8469, maximum-segment-length=0, transport-protocol=UDP
        BattCell38VoltVal_Field: field=BattCell38VoltVal
          get getter: maximum-segment-length-request=0, maximum-segment-length-response=0, method-id=8470, transport-protocol=UDP
          notifier notifier: event-id=8470, maximum-segment-length=0, transport-protocol=UDP
        BattCell39VoltVal_Field: field=BattCell39VoltVal
          get getter: maximum-segment-length-request=0, maximum-segment-length-response=0, method-id=8471, transport-protocol=UDP
          notifier notifier: event-id=8471, maximum-segment-length=0, transport-protocol=UDP
        BattCell3VoltVal_Field: field=BattCell3VoltVal
          get getter: maximum-segment-length-request=0, maximum-segment-length-response=0, method-id=8433, transport-protocol=UDP
          notifier notifier: event-id=8433, maximum-segment-length=0, transport-protocol=UDP
        BattCell3_Index_Field: field=BattCell3_Index
          get getter: maximum-segment-length-request=0, maximum-segment-length-response=0, method-id=8460, transport-protocol=UDP
          notifier notifier: event-id=8460, maximum-segment-length=0, transport-protocol=UDP
        BattCell40VoltVal_Field: field=BattCell40VoltVal
          get getter: maximum-segment-length-request=0, maximum-segment-length-response=0, method-id=8472, transport-protocol=UDP
          notifier notifier: event-id=8472, maximum-segment-length=0, transport-protocol=UDP
        BattCell41VoltVal_Field: field=BattCell41VoltVal
          get getter: maximum-segment-length-request=0, maximum-segment-length-response=0, method-id=8473, transport-protocol=UDP
          notifier notifier: event-id=8473, maximum-segment-length=0, transport-protocol=UDP
        BattCell42VoltVal_Field: field=BattCell42VoltVal
          get getter: maximum-segment-length-request=0, maximum-segment-length-response=0, method-id=8474, transport-protocol=UDP
          notifier notifier: event-id=8474, maximum-segment-length=0, transport-protocol=UDP
        BattCell43VoltVal_Field: field=BattCell43VoltVal
          get getter: maximum-segment-length-request=0, maximum-segment-length-response=0, method-id=8476, transport-protocol=UDP
          notifier notifier: event-id=8476, maximum-segment-length=0, transport-protocol=UDP
        BattCell44VoltVal_Field: field=BattCell44VoltVal
          get getter: maximum-segment-length-request=0, maximum-segment-length-response=0, method-id=8477, transport-protocol=UDP
          notifier notifier: event-id=8477, maximum-segment-length=0, transport-protocol=UDP
        BattCell45VoltVal_Field: field=BattCell45VoltVal
          get getter: maximum-segment-length-request=0, maximum-segment-length-response=0, method-id=8478, transport-protocol=UDP
          notifier notifier: event-id=8478, maximum-segment-length=0, transport-protocol=UDP
        BattCell46VoltVal_Field: field=BattCell46VoltVal
          get getter: maximum-segment-length-request=0, maximum-segment-length-response=0, method-id=8479, transport-protocol=UDP
          notifier notifier: event-id=8479, maximum-segment-length=0, transport-protocol=UDP
        BattCell47VoltVal_Field: field=BattCell47VoltVal
          get getter: maximum-segment-length-request=0, maximum-segment-length-response=0, method-id=8480, transport-protocol=UDP
          notifier notifier: event-id=8480, maximum-segment-length=0, transport-protocol=UDP
        BattCell48VoltVal_Field: field=BattCell48VoltVal
          get getter: maximum-segment-length-request=0, maximum-segment-length-response=0, method-id=8481, transport-protocol=UDP
          notifier notifier: event-id=8481, maximum-segment-length=0, transport-protocol=UDP
        BattCell49VoltVal_Field: field=BattCell49VoltVal
          get getter: maximum-segment-length-request=0, maximum-segment-length-response=0, method-id=8482, transport-protocol=UDP
          notifier notifier: event-id=8482, maximum-segment-length=0, transport-protocol=UDP
        BattCell4VoltVal_Field: field=BattCell4VoltVal
          get getter: maximum-segment-length-request=0, maximum-segment-length-response=0, method-id=8434, transport-protocol=UDP
          notifier notifier: event-id=8434, maximum-segment-length=0, transport-protocol=UDP
        BattCell4_Index_Field: field=BattCell4_Index
          get getter: maximum-segment-length-request=0, maximum-segment-length-response=0, method-id=8475, transport-protocol=UDP
          notifier notifier: event-id=8475, maximum-segment-length=0, transport-protocol=UDP
        BattCell50VoltVal_Field: field=BattCell50VoltVal
          get getter: maximum-segment-length-request=0, maximum-segment-length-response=0, method-id=8483, transport-protocol=UDP
          notifier notifier: event-id=8483, maximum-segment-length=0, transport-protocol=UDP
        BattCell51VoltVal_Field: field=BattCell51VoltVal
          get getter: maximum-segment-length-request=0, maximum-segment-length-response=0, method-id=8484, transport-protocol=UDP
          notifier notifier: event-id=8484, maximum-segment-length=0, transport-protocol=UDP
        BattCell52VoltVal_Field: field=BattCell52VoltVal
          get getter: maximum-segment-length-request=0, maximum-segment-length-response=0, method-id=8485, transport-protocol=UDP
          notifier notifier: event-id=8485, maximum-segment-length=0, transport-protocol=UDP
        BattCell53VoltVal_Field: field=BattCell53VoltVal
          get getter: maximum-segment-length-request=0, maximum-segment-length-response=0, method-id=8486, transport-protocol=UDP
          notifier notifier: event-id=8486, maximum-segment-length=0, transport-protocol=UDP
        BattCell54VoltVal_Field: field=BattCell54VoltVal
          get getter: maximum-segment-length-request=0, maximum-segment-length-response=0, method-id=8487, transport-protocol=UDP
          notifier notifier: event-id=8487, maximum-segment-length=0, transport-protocol=UDP
        BattCell55VoltVal_Field: field=BattCell55VoltVal
          get getter: maximum-segment-length-request=0, maximum-segment-length-response=0, method-id=8488, transport-protocol=UDP
          notifier notifier: event-id=8488, maximum-segment-length=0, transport-protocol=UDP
        BattCell56VoltVal_Field: field=BattCell56VoltVal
          get getter: maximum-segment-length-request=0, maximum-segment-length-response=0, method-id=8489, transport-protocol=UDP
          notifier notifier: event-id=8489, maximum-segment-length=0, transport-protocol=UDP
        BattCell57VoltVal_Field: field=BattCell57VoltVal
          get getter: maximum-segment-length-request=0, maximum-segment-length-response=0, method-id=8491, transport-protocol=UDP
          notifier notifier: event-id=8491, maximum-segment-length=0, transport-protocol=UDP
        BattCell58VoltVal_Field: field=BattCell58VoltVal
          get getter: maximum-segment-length-request=0, maximum-segment-length-response=0, method-id=8492, transport-protocol=UDP
          notifier notifier: event-id=8492, maximum-segment-length=0, transport-protocol=UDP
        BattCell59VoltVal_Field: field=BattCell59VoltVal
          get getter: maximum-segment-length-request=0, maximum-segment-length-response=0, method-id=8493, transport-protocol=UDP
          notifier notifier: event-id=8493, maximum-segment-length=0, transport-protocol=UDP
        BattCell5VoltVal_Field: field=BattCell5VoltVal
          get getter: maximum-segment-length-request=0, maximum-segment-length-response=0, method-id=8435, transport-protocol=UDP
          notifier notifier: event-id=8435, maximum-segment-length=0, transport-protocol=UDP
        BattCell5_Index_Field: field=BattCell5_Index
          get getter: maximum-segment-length-request=0, maximum-segment-length-response=0, method-id=8490, transport-protocol=UDP
          notifier notifier: event-id=8490, maximum-segment-length=0, transport-protocol=UDP
        BattCell60VoltVal_Field: field=BattCell60VoltVal
          get getter: maximum-segment-length-request=0, maximum-segment-length-response=0, method-id=8494, transport-protocol=UDP
          notifier notifier: event-id=8494, maximum-segment-length=0, transport-protocol=UDP
        BattCell61VoltVal_Field: field=BattCell61VoltVal
          get getter: maximum-segment-length-request=0, maximum-segment-length-response=0, method-id=8495, transport-protocol=UDP
          notifier notifier: event-id=8495, maximum-segment-length=0, transport-protocol=UDP
        BattCell62VoltVal_Field: field=BattCell62VoltVal
          get getter: maximum-segment-length-request=0, maximum-segment-length-response=0, method-id=8496, transport-protocol=UDP
          notifier notifier: event-id=8496, maximum-segment-length=0, transport-protocol=UDP
        BattCell63VoltVal_Field: field=BattCell63VoltVal
          get getter: maximum-segment-length-request=0, maximum-segment-length-response=0, method-id=8497, transport-protocol=UDP
          notifier notifier: event-id=8497, maximum-segment-length=0, transport-protocol=UDP
        BattCell64VoltVal_Field: field=BattCell64VoltVal
          get getter: maximum-segment-length-request=0, maximum-segment-length-response=0, method-id=8498, transport-protocol=UDP
          notifier notifier: event-id=8498, maximum-segment-length=0, transport-protocol=UDP
        BattCell65VoltVal_Field: field=BattCell65VoltVal
          get getter: maximum-segment-length-request=0, maximum-segment-length-response=0, method-id=8499, transport-protocol=UDP
          notifier notifier: event-id=8499, maximum-segment-length=0, transport-protocol=UDP
        BattCell66VoltVal_Field: field=BattCell66VoltVal
          get getter: maximum-segment-length-request=0, maximum-segment-length-response=0, method-id=8500, transport-protocol=UDP
          notifier notifier: event-id=8500, maximum-segment-length=0, transport-protocol=UDP
        BattCell67VoltVal_Field: field=BattCell67VoltVal
          get getter: maximum-segment-length-request=0, maximum-segment-length-response=0, method-id=8501, transport-protocol=UDP
          notifier notifier: event-id=8501, maximum-segment-length=0, transport-protocol=UDP
        BattCell68VoltVal_Field: field=BattCell68VoltVal
          get getter: maximum-segment-length-request=0, maximum-segment-length-response=0, method-id=8502, transport-protocol=UDP
          notifier notifier: event-id=8502, maximum-segment-length=0, transport-protocol=UDP
        BattCell69VoltVal_Field: field=BattCell69VoltVal
          get getter: maximum-segment-length-request=0, maximum-segment-length-response=0, method-id=8503, transport-protocol=UDP
          notifier notifier: event-id=8503, maximum-segment-length=0, transport-protocol=UDP
        BattCell6VoltVal_Field: field=BattCell6VoltVal
          get getter: maximum-segment-length-request=0, maximum-segment-length-response=0, method-id=8436, transport-protocol=UDP
          notifier notifier: event-id=8436, maximum-segment-length=0, transport-protocol=UDP
        BattCell6_Index_Field: field=BattCell6_Index
          get getter: maximum-segment-length-request=0, maximum-segment-length-response=0, method-id=8505, transport-protocol=UDP
          notifier notifier: event-id=8505, maximum-segment-length=0, transport-protocol=UDP
        BattCell70VoltVal_Field: field=BattCell70VoltVal
          get getter: maximum-segment-length-request=0, maximum-segment-length-response=0, method-id=8504, transport-protocol=UDP
          notifier notifier: event-id=8504, maximum-segment-length=0, transport-protocol=UDP
        BattCell71VoltVal_Field: field=BattCell71VoltVal
          get getter: maximum-segment-length-request=0, maximum-segment-length-response=0, method-id=8506, transport-protocol=UDP
          notifier notifier: event-id=8506, maximum-segment-length=0, transport-protocol=UDP
        BattCell72VoltVal_Field: field=BattCell72VoltVal
          get getter: maximum-segment-length-request=0, maximum-segment-length-response=0, method-id=8507, transport-protocol=UDP
          notifier notifier: event-id=8507, maximum-segment-length=0, transport-protocol=UDP
        BattCell73VoltVal_Field: field=BattCell73VoltVal
          get getter: maximum-segment-length-request=0, maximum-segment-length-response=0, method-id=8508, transport-protocol=UDP
          notifier notifier: event-id=8508, maximum-segment-length=0, transport-protocol=UDP
        BattCell74VoltVal_Field: field=BattCell74VoltVal
          get getter: maximum-segment-length-request=0, maximum-segment-length-response=0, method-id=8509, transport-protocol=UDP
          notifier notifier: event-id=8509, maximum-segment-length=0, transport-protocol=UDP
        BattCell75VoltVal_Field: field=BattCell75VoltVal
          get getter: maximum-segment-length-request=0, maximum-segment-length-response=0, method-id=8510, transport-protocol=UDP
          notifier notifier: event-id=8510, maximum-segment-length=0, transport-protocol=UDP
        BattCell76VoltVal_Field: field=BattCell76VoltVal
          get getter: maximum-segment-length-request=0, maximum-segment-length-response=0, method-id=8511, transport-protocol=UDP
          notifier notifier: event-id=8511, maximum-segment-length=0, transport-protocol=UDP
        BattCell77VoltVal_Field: field=BattCell77VoltVal
          get getter: maximum-segment-length-request=0, maximum-segment-length-response=0, method-id=8512, transport-protocol=UDP
          notifier notifier: event-id=8512, maximum-segment-length=0, transport-protocol=UDP
        BattCell78VoltVal_Field: field=BattCell78VoltVal
          get getter: maximum-segment-length-request=0, maximum-segment-length-response=0, method-id=8513, transport-protocol=UDP
          notifier notifier: event-id=8513, maximum-segment-length=0, transport-protocol=UDP
        BattCell79VoltVal_Field: field=BattCell79VoltVal
          get getter: maximum-segment-length-request=0, maximum-segment-length-response=0, method-id=8514, transport-protocol=UDP
          notifier notifier: event-id=8514, maximum-segment-length=0, transport-protocol=UDP
        BattCell7VoltVal_Field: field=BattCell7VoltVal
          get getter: maximum-segment-length-request=0, maximum-segment-length-response=0, method-id=8437, transport-protocol=UDP
          notifier notifier: event-id=8437, maximum-segment-length=0, transport-protocol=UDP
        BattCell7_Index_Field: field=BattCell7_Index
          get getter: maximum-segment-length-request=0, maximum-segment-length-response=0, method-id=8520, transport-protocol=UDP
          notifier notifier: event-id=8520, maximum-segment-length=0, transport-protocol=UDP
        BattCell80VoltVal_Field: field=BattCell80VoltVal
          get getter: maximum-segment-length-request=0, maximum-segment-length-response=0, method-id=8515, transport-protocol=UDP
          notifier notifier: event-id=8515, maximum-segment-length=0, transport-protocol=UDP
        BattCell81VoltVal_Field: field=BattCell81VoltVal
          get getter: maximum-segment-length-request=0, maximum-segment-length-response=0, method-id=8516, transport-protocol=UDP
          notifier notifier: event-id=8516, maximum-segment-length=0, transport-protocol=UDP
        BattCell82VoltVal_Field: field=BattCell82VoltVal
          get getter: maximum-segment-length-request=0, maximum-segment-length-response=0, method-id=8517, transport-protocol=UDP
          notifier notifier: event-id=8517, maximum-segment-length=0, transport-protocol=UDP
        BattCell83VoltVal_Field: field=BattCell83VoltVal
          get getter: maximum-segment-length-request=0, maximum-segment-length-response=0, method-id=8518, transport-protocol=UDP
          notifier notifier: event-id=8518, maximum-segment-length=0, transport-protocol=UDP
        BattCell84VoltVal_Field: field=BattCell84VoltVal
          get getter: maximum-segment-length-request=0, maximum-segment-length-response=0, method-id=8519, transport-protocol=UDP
          notifier notifier: event-id=8519, maximum-segment-length=0, transport-protocol=UDP
        BattCell85VoltVal_Field: field=BattCell85VoltVal
          get getter: maximum-segment-length-request=0, maximum-segment-length-response=0, method-id=8521, transport-protocol=UDP
          notifier notifier: event-id=8521, maximum-segment-length=0, transport-protocol=UDP
        BattCell86VoltVal_Field: field=BattCell86VoltVal
          get getter: maximum-segment-length-request=0, maximum-segment-length-response=0, method-id=8522, transport-protocol=UDP
          notifier notifier: event-id=8522, maximum-segment-length=0, transport-protocol=UDP
        BattCell87VoltVal_Field: field=BattCell87VoltVal
          get getter: maximum-segment-length-request=0, maximum-segment-length-response=0, method-id=8523, transport-protocol=UDP
          notifier notifier: event-id=8523, maximum-segment-length=0, transport-protocol=UDP
        BattCell88VoltVal_Field: field=BattCell88VoltVal
          get getter: maximum-segment-length-request=0, maximum-segment-length-response=0, method-id=8524, transport-protocol=UDP
          notifier notifier: event-id=8524, maximum-segment-length=0, transport-protocol=UDP
        BattCell89VoltVal_Field: field=BattCell89VoltVal
          get getter: maximum-segment-length-request=0, maximum-segment-length-response=0, method-id=8525, transport-protocol=UDP
          notifier notifier: event-id=8525, maximum-segment-length=0, transport-protocol=UDP
        BattCell8VoltVal_Field: field=BattCell8VoltVal
          get getter: maximum-segment-length-request=0, maximum-segment-length-response=0, method-id=8438, transport-protocol=UDP
          notifier notifier: event-id=8438, maximum-segment-length=0, transport-protocol=UDP
        BattCell90VoltVal_Field: field=BattCell90VoltVal
          get getter: maximum-segment-length-request=0, maximum-segment-length-response=0, method-id=8526, transport-protocol=UDP
          notifier notifier: event-id=8526, maximum-segment-length=0, transport-protocol=UDP
        BattCell91VoltVal_Field: field=BattCell91VoltVal
          get getter: maximum-segment-length-request=0, maximum-segment-length-response=0, method-id=8527, transport-protocol=UDP
          notifier notifier: event-id=8527, maximum-segment-length=0, transport-protocol=UDP
        BattCell92VoltVal_Field: field=BattCell92VoltVal
          get getter: maximum-segment-length-request=0, maximum-segment-length-response=0, method-id=8528, transport-protocol=UDP
          notifier notifier: event-id=8528, maximum-segment-length=0, transport-protocol=UDP
        BattCell93VoltVal_Field: field=BattCell93VoltVal
          get getter: maximum-segment-length-request=0, maximum-segment-length-response=0, method-id=8529, transport-protocol=UDP
          notifier notifier: event-id=8529, maximum-segment-length=0, transport-protocol=UDP
        BattCell94VoltVal_Field: field=BattCell94VoltVal
          get getter: maximum-segment-length-request=0, maximum-segment-length-response=0, method-id=8530, transport-protocol=UDP
          notifier notifier: event-id=8530, maximum-segment-length=0, transport-protocol=UDP
        BattCell95VoltVal_Field: field=BattCell95VoltVal
          get getter: maximum-segment-length-request=0, maximum-segment-length-response=0, method-id=8531, transport-protocol=UDP
          notifier notifier: event-id=8531, maximum-segment-length=0, transport-protocol=UDP
        BattCell96VoltVal_Field: field=BattCell96VoltVal
          get getter: maximum-segment-length-request=0, maximum-segment-length-response=0, method-id=8532, transport-protocol=UDP
          notifier notifier: event-id=8532, maximum-segment-length=0, transport-protocol=UDP
        BattCell97VoltVal_Field: field=BattCell97VoltVal
          get getter: maximum-segment-length-request=0, maximum-segment-length-response=0, method-id=8533, transport-protocol=UDP
          notifier notifier: event-id=8533, maximum-segment-length=0, transport-protocol=UDP
        BattCell98VoltVal_Field: field=BattCell98VoltVal
          get getter: maximum-segment-length-request=0, maximum-segment-length-response=0, method-id=8534, transport-protocol=UDP
          notifier notifier: event-id=8534, maximum-segment-length=0, transport-protocol=UDP
        BattCell9VoltVal_Field: field=BattCell9VoltVal
          get getter: maximum-segment-length-request=0, maximum-segment-length-response=0, method-id=8439, transport-protocol=UDP
          notifier notifier: event-id=8439, maximum-segment-length=0, transport-protocol=UDP
        BattConditioActState_Field: field=BattConditioActState
          get getter: maximum-segment-length-request=0, maximum-segment-length-response=0, method-id=8280, transport-protocol=UDP
          notifier notifier: event-id=8280, maximum-segment-length=0, transport-protocol=UDP
        BattCurrVal_Field: field=BattCurrVal
          get getter: maximum-segment-length-request=0, maximum-segment-length-response=0, method-id=8537, transport-protocol=UDP
          notifier notifier: event-id=8537, maximum-segment-length=0, transport-protocol=UDP
        BattTempMainMaxVal_Field: field=BattTempMainMaxVal
          get getter: maximum-segment-length-request=0, maximum-segment-length-response=0, method-id=8544, transport-protocol=UDP
          notifier notifier: event-id=8544, maximum-segment-length=0, transport-protocol=UDP
        BattTempMainMinVal_Field: field=BattTempMainMinVal
          get getter: maximum-segment-length-request=0, maximum-segment-length-response=0, method-id=8545, transport-protocol=UDP
          notifier notifier: event-id=8545, maximum-segment-length=0, transport-protocol=UDP
        BattTemperatureValue_Field: field=BattTemperatureValue
          get getter: maximum-segment-length-request=0, maximum-segment-length-response=0, method-id=8284, transport-protocol=UDP
          notifier notifier: event-id=8284, maximum-segment-length=0, transport-protocol=UDP
        BatteryConditioningApply_Field: field=BatteryConditioningApply
          get getter: maximum-segment-length-request=0, maximum-segment-length-response=0, method-id=8281, transport-protocol=UDP
          notifier notifier: event-id=8281, maximum-segment-length=0, transport-protocol=UDP
        BatteryConditioningState_Field: field=BatteryConditioningState
          get getter: maximum-segment-length-request=0, maximum-segment-length-response=0, method-id=8196, transport-protocol=UDP
          notifier notifier: event-id=8196, maximum-segment-length=0, transport-protocol=UDP
        BatteryEmergencyState_Field: field=PowerTrain2/BatteryEmergencyState
          get getter: maximum-segment-length-request=0, maximum-segment-length-response=0, method-id=8197, transport-protocol=UDP
          notifier notifier: event-id=8197, maximum-segment-length=0, transport-protocol=UDP
        BatteryHeaterInputPower_Field: field=BatteryHeaterInputPower
          get getter: maximum-segment-length-request=0, maximum-segment-length-response=0, method-id=8401, transport-protocol=UDP
          notifier notifier: event-id=8401, maximum-segment-length=0, transport-protocol=UDP
        BatteryOptionValue_Field: field=BatteryOptionValue
          get getter: maximum-segment-length-request=0, maximum-segment-length-response=0, method-id=8282, transport-protocol=UDP
          notifier notifier: event-id=8282, maximum-segment-length=0, transport-protocol=UDP
        BatteryPackVoltage_Field: field=BatteryPackVoltage
          get getter: maximum-segment-length-request=0, maximum-segment-length-response=0, method-id=8402, transport-protocol=UDP
          notifier notifier: event-id=8402, maximum-segment-length=0, transport-protocol=UDP
        BatteryPopupMessage_Field: field=BatteryPopupMessage
          get getter: maximum-segment-length-request=0, maximum-segment-length-response=0, method-id=8329, transport-protocol=UDP
          notifier notifier: event-id=8329, maximum-segment-length=0, transport-protocol=UDP
        BatterySpecInfo_Field: field=BatterySpecInfo
          get getter: maximum-segment-length-request=0, maximum-segment-length-response=0, method-id=8408, transport-protocol=UDP
          notifier notifier: event-id=8408, maximum-segment-length=0, transport-protocol=UDP
        BatteryTemperatureState_Field: field=BatteryTemperatureState
          get getter: maximum-segment-length-request=0, maximum-segment-length-response=0, method-id=8283, transport-protocol=UDP
          notifier notifier: event-id=8283, maximum-segment-length=0, transport-protocol=UDP
        Bms_H_avg_max_Field: field=Bms_H_avg_max
          get getter: maximum-segment-length-request=0, maximum-segment-length-response=0, method-id=8546, transport-protocol=UDP
          notifier notifier: event-id=8546, maximum-segment-length=0, transport-protocol=UDP
        Bms_H_ocv_max_Field: field=Bms_H_ocv_max
          get getter: maximum-segment-length-request=0, maximum-segment-length-response=0, method-id=8547, transport-protocol=UDP
          notifier notifier: event-id=8547, maximum-segment-length=0, transport-protocol=UDP
        Bms_Vmax_dec_Field: field=Bms_Vmax_dec
          get getter: maximum-segment-length-request=0, maximum-segment-length-response=0, method-id=8548, transport-protocol=UDP
          notifier notifier: event-id=8548, maximum-segment-length=0, transport-protocol=UDP
        Bms_Vmin_dec_Field: field=Bms_Vmin_dec
          get getter: maximum-segment-length-request=0, maximum-segment-length-response=0, method-id=8549, transport-protocol=UDP
          notifier notifier: event-id=8549, maximum-segment-length=0, transport-protocol=UDP
        CCMContCertChnStatus_Field: field=CCMContCertChnStatus
          get getter: maximum-segment-length-request=0, maximum-segment-length-response=0, method-id=8344, transport-protocol=UDP
          notifier notifier: event-id=8344, maximum-segment-length=0, transport-protocol=UDP
        CCMContCertInstNumber_Field: field=CCMContCertInstNumber
          get getter: maximum-segment-length-request=0, maximum-segment-length-response=0, method-id=8345, transport-protocol=UDP
          notifier notifier: event-id=8345, maximum-segment-length=0, transport-protocol=UDP
        CCM_ContCert_ChnDel_Result_Field: field=CCM_ContCert_ChnDel_Result
          get getter: maximum-segment-length-request=0, maximum-segment-length-response=0, method-id=8356, transport-protocol=UDP
          notifier notifier: event-id=8356, maximum-segment-length=0, transport-protocol=UDP
        CCM_PnCModeStatus_Field: field=CCM_PnCModeStatus
          get getter: maximum-segment-length-request=0, maximum-segment-length-response=0, method-id=8285, transport-protocol=UDP
          notifier notifier: event-id=8285, maximum-segment-length=0, transport-protocol=UDP
        CertificateReceiveOptionFlag_Field: field=CertificateReceiveOptionFlag
          get getter: maximum-segment-length-request=0, maximum-segment-length-response=0, method-id=8416, transport-protocol=UDP
          notifier notifier: event-id=8416, maximum-segment-length=0, transport-protocol=UDP
        CertificateReceiveStatus_Field: field=CertificateReceiveStatus
          get getter: maximum-segment-length-request=0, maximum-segment-length-response=0, method-id=8420, transport-protocol=UDP
          notifier notifier: event-id=8420, maximum-segment-length=0, transport-protocol=UDP
        ChargeCurrentMode_NoVCMS_Field: field=ChargeCurrentMode_NoVCMS
          get getter: maximum-segment-length-request=0, maximum-segment-length-response=0, method-id=8286, transport-protocol=UDP
          notifier notifier: event-id=8286, maximum-segment-length=0, transport-protocol=UDP
        ChargeCurrentMode_VCMS_Field: field=ChargeCurrentMode_VCMS
          get getter: maximum-segment-length-request=0, maximum-segment-length-response=0, method-id=8287, transport-protocol=UDP
          notifier notifier: event-id=8287, maximum-segment-length=0, transport-protocol=UDP
        ChargeRemainedTime120_Field: field=ChargeRemainedTime120
          get getter: maximum-segment-length-request=0, maximum-segment-length-response=0, method-id=8199, transport-protocol=UDP
          notifier notifier: event-id=8199, maximum-segment-length=0, transport-protocol=UDP
        ChargeRemainedTime240_Field: field=ChargeRemainedTime240
          get getter: maximum-segment-length-request=0, maximum-segment-length-response=0, method-id=8200, transport-protocol=UDP
          notifier notifier: event-id=8200, maximum-segment-length=0, transport-protocol=UDP
        ChargeRemainedTime240_VCRM_Field: field=ChargeRemainedTime240_VCRM
          get getter: maximum-segment-length-request=0, maximum-segment-length-response=0, method-id=8288, transport-protocol=UDP
          notifier notifier: event-id=8288, maximum-segment-length=0, transport-protocol=UDP
        ChargeRemainedTimeValue_Field: field=ChargeRemainedTimeValue
          get getter: maximum-segment-length-request=0, maximum-segment-length-response=0, method-id=8201, transport-protocol=UDP
          notifier notifier: event-id=8201, maximum-segment-length=0, transport-protocol=UDP
        ChargeRemainedTime_Field: field=ChargeRemainedTime
          get getter: maximum-segment-length-request=0, maximum-segment-length-response=0, method-id=8198, transport-protocol=UDP
          notifier notifier: event-id=8198, maximum-segment-length=0, transport-protocol=UDP
        ChargeSOCValue_Field: field=ChargeSOCValue
          get getter: maximum-segment-length-request=0, maximum-segment-length-response=0, method-id=8202, transport-protocol=UDP
          notifier notifier: event-id=8202, maximum-segment-length=0, transport-protocol=UDP
        ChargeStartStatus_Field: field=ChargeStartStatus
          get getter: maximum-segment-length-request=0, maximum-segment-length-response=0, method-id=8289, transport-protocol=UDP
          notifier notifier: event-id=8289, maximum-segment-length=0, transport-protocol=UDP
        ChargeStateforAlarm_Field: field=ChargeStateforAlarm
          get getter: maximum-segment-length-request=0, maximum-segment-length-response=0, method-id=8203, transport-protocol=UDP
          notifier notifier: event-id=8203, maximum-segment-length=0, transport-protocol=UDP
        ChargeStateforAlarm_Subcode_Field: field=ChargeStateforAlarm_Subcode
          get getter: maximum-segment-length-request=0, maximum-segment-length-response=0, method-id=8204, transport-protocol=UDP
          notifier notifier: event-id=8204, maximum-segment-length=0, transport-protocol=UDP
        ChargingFinishReason_Field: field=ChargingFinishReason
          get getter: maximum-segment-length-request=0, maximum-segment-length-response=0, method-id=8205, transport-protocol=UDP
          notifier notifier: event-id=8205, maximum-segment-length=0, transport-protocol=UDP
        ChargingFinishState_Field: field=ChargingFinishState
          get getter: maximum-segment-length-request=0, maximum-segment-length-response=0, method-id=8206, transport-protocol=UDP
          notifier notifier: event-id=8206, maximum-segment-length=0, transport-protocol=UDP
        ChargingPowerDerating_Field: field=ChargingPowerDerating
          get getter: maximum-segment-length-request=0, maximum-segment-length-response=0, method-id=8330, transport-protocol=UDP
          notifier notifier: event-id=8330, maximum-segment-length=0, transport-protocol=UDP
        ChargingState_Field: field=ChargingState
          get getter: maximum-segment-length-request=0, maximum-segment-length-response=0, method-id=8207, transport-protocol=UDP
          notifier notifier: event-id=8207, maximum-segment-length=0, transport-protocol=UDP
        ChgEnergyDis_Field: field=ChgEnergyDis
          get getter: maximum-segment-length-request=0, maximum-segment-length-response=0, method-id=8421, transport-protocol=UDP
          notifier notifier: event-id=8421, maximum-segment-length=0, transport-protocol=UDP
        ChrgInletTyp_Field: field=ChrgInletTyp
          get getter: maximum-segment-length-request=0, maximum-segment-length-response=0, method-id=8422, transport-protocol=UDP
          notifier notifier: event-id=8422, maximum-segment-length=0, transport-protocol=UDP
        ClimateControlState_Field: field=ClimateControlState
          get getter: maximum-segment-length-request=0, maximum-segment-length-response=0, method-id=8208, transport-protocol=UDP
          notifier notifier: event-id=8208, maximum-segment-length=0, transport-protocol=UDP
        ContractCertificate1Status_Field: field=ContractCertificate1Status
          get getter: maximum-segment-length-request=0, maximum-segment-length-response=0, method-id=8290, transport-protocol=UDP
          notifier notifier: event-id=8290, maximum-segment-length=0, transport-protocol=UDP
        ContractCertificate2Status_Field: field=ContractCertificate2Status
          get getter: maximum-segment-length-request=0, maximum-segment-length-response=0, method-id=8291, transport-protocol=UDP
          notifier notifier: event-id=8291, maximum-segment-length=0, transport-protocol=UDP
        ContractCertificate3Status_Field: field=ContractCertificate3Status
          get getter: maximum-segment-length-request=0, maximum-segment-length-response=0, method-id=8292, transport-protocol=UDP
          notifier notifier: event-id=8292, maximum-segment-length=0, transport-protocol=UDP
        ContractCertificate4Status_Field: field=ContractCertificate4Status
          get getter: maximum-segment-length-request=0, maximum-segment-length-response=0, method-id=8293, transport-protocol=UDP
          notifier notifier: event-id=8293, maximum-segment-length=0, transport-protocol=UDP
        ContractCertificate5Status_Field: field=ContractCertificate5Status
          get getter: maximum-segment-length-request=0, maximum-segment-length-response=0, method-id=8294, transport-protocol=UDP
          notifier notifier: event-id=8294, maximum-segment-length=0, transport-protocol=UDP
        ContractCertificateCompanyInfo1_Field: field=ContractCertificateCompanyInfo1
          get getter: maximum-segment-length-request=0, maximum-segment-length-response=0, method-id=8295, transport-protocol=UDP
          notifier notifier: event-id=8295, maximum-segment-length=0, transport-protocol=UDP
        ContractCertificateCompanyInfo2_Field: field=ContractCertificateCompanyInfo2
          get getter: maximum-segment-length-request=0, maximum-segment-length-response=0, method-id=8296, transport-protocol=UDP
          notifier notifier: event-id=8296, maximum-segment-length=0, transport-protocol=UDP
        ContractCertificateCompanyInfo3_Field: field=ContractCertificateCompanyInfo3
          get getter: maximum-segment-length-request=0, maximum-segment-length-response=0, method-id=8297, transport-protocol=UDP
          notifier notifier: event-id=8297, maximum-segment-length=0, transport-protocol=UDP
        ContractCertificateCompanyInfo4_Field: field=ContractCertificateCompanyInfo4
          get getter: maximum-segment-length-request=0, maximum-segment-length-response=0, method-id=8298, transport-protocol=UDP
          notifier notifier: event-id=8298, maximum-segment-length=0, transport-protocol=UDP
        ContractCertificateCompanyInfo5_Field: field=ContractCertificateCompanyInfo5
          get getter: maximum-segment-length-request=0, maximum-segment-length-response=0, method-id=8299, transport-protocol=UDP
          notifier notifier: event-id=8299, maximum-segment-length=0, transport-protocol=UDP
        ContractCertificateSelectionStatus_Field: field=ContractCertificateSelectionStatus
          get getter: maximum-segment-length-request=0, maximum-segment-length-response=0, method-id=8300, transport-protocol=UDP
          notifier notifier: event-id=8300, maximum-segment-length=0, transport-protocol=UDP
        ContractCertificateUserInfo1_Field: field=ContractCertificateUserInfo1
          get getter: maximum-segment-length-request=0, maximum-segment-length-response=0, method-id=8301, transport-protocol=UDP
          notifier notifier: event-id=8301, maximum-segment-length=0, transport-protocol=UDP
        ContractCertificateUserInfo2_Field: field=ContractCertificateUserInfo2
          get getter: maximum-segment-length-request=0, maximum-segment-length-response=0, method-id=8302, transport-protocol=UDP
          notifier notifier: event-id=8302, maximum-segment-length=0, transport-protocol=UDP
        ContractCertificateUserInfo3_1_Field: field=ContractCertificateUserInfo3_1
          get getter: maximum-segment-length-request=0, maximum-segment-length-response=0, method-id=8303, transport-protocol=UDP
          notifier notifier: event-id=8303, maximum-segment-length=0, transport-protocol=UDP
        ContractCertificateUserInfo3_2_Field: field=ContractCertificateUserInfo3_2
          get getter: maximum-segment-length-request=0, maximum-segment-length-response=0, method-id=8304, transport-protocol=UDP
          notifier notifier: event-id=8304, maximum-segment-length=0, transport-protocol=UDP
        ContractCertificateUserInfo4_Field: field=ContractCertificateUserInfo4
          get getter: maximum-segment-length-request=0, maximum-segment-length-response=0, method-id=8305, transport-protocol=UDP
          notifier notifier: event-id=8305, maximum-segment-length=0, transport-protocol=UDP
        ContractCertificateUserInfo5_Field: field=ContractCertificateUserInfo5
          get getter: maximum-segment-length-request=0, maximum-segment-length-response=0, method-id=8306, transport-protocol=UDP
          notifier notifier: event-id=8306, maximum-segment-length=0, transport-protocol=UDP
        DcChargingStatus_Field: field=DcChargingStatus
          get getter: maximum-segment-length-request=0, maximum-segment-length-response=0, method-id=8346, transport-protocol=UDP
          notifier notifier: event-id=8346, maximum-segment-length=0, transport-protocol=UDP
        DepartSet1EnableState_Field: field=DepartSet1EnableState
          get getter: maximum-segment-length-request=0, maximum-segment-length-response=0, method-id=8218, transport-protocol=UDP
          notifier notifier: event-id=8218, maximum-segment-length=0, transport-protocol=UDP
        DepartSet1_Fri_Field: field=DepartSet1_Fri
          get getter: maximum-segment-length-request=0, maximum-segment-length-response=0, method-id=8209, transport-protocol=UDP
          notifier notifier: event-id=8209, maximum-segment-length=0, transport-protocol=UDP
        DepartSet1_Hour_Field: field=DepartSet1_Hour
          get getter: maximum-segment-length-request=0, maximum-segment-length-response=0, method-id=8210, transport-protocol=UDP
          notifier notifier: event-id=8210, maximum-segment-length=0, transport-protocol=UDP
        DepartSet1_Min_Field: field=DepartSet1_Min
          get getter: maximum-segment-length-request=0, maximum-segment-length-response=0, method-id=8211, transport-protocol=UDP
          notifier notifier: event-id=8211, maximum-segment-length=0, transport-protocol=UDP
        DepartSet1_Mon_Field: field=DepartSet1_Mon
          get getter: maximum-segment-length-request=0, maximum-segment-length-response=0, method-id=8212, transport-protocol=UDP
          notifier notifier: event-id=8212, maximum-segment-length=0, transport-protocol=UDP
        DepartSet1_Sat_Field: field=DepartSet1_Sat
          get getter: maximum-segment-length-request=0, maximum-segment-length-response=0, method-id=8213, transport-protocol=UDP
          notifier notifier: event-id=8213, maximum-segment-length=0, transport-protocol=UDP
        DepartSet1_Sun_Field: field=DepartSet1_Sun
          get getter: maximum-segment-length-request=0, maximum-segment-length-response=0, method-id=8214, transport-protocol=UDP
          notifier notifier: event-id=8214, maximum-segment-length=0, transport-protocol=UDP
        DepartSet1_Thu_Field: field=DepartSet1_Thu
          get getter: maximum-segment-length-request=0, maximum-segment-length-response=0, method-id=8215, transport-protocol=UDP
          notifier notifier: event-id=8215, maximum-segment-length=0, transport-protocol=UDP
        DepartSet1_Tue_Field: field=DepartSet1_Tue
          get getter: maximum-segment-length-request=0, maximum-segment-length-response=0, method-id=8216, transport-protocol=UDP
          notifier notifier: event-id=8216, maximum-segment-length=0, transport-protocol=UDP
        DepartSet1_Wed_Field: field=DepartSet1_Wed
          get getter: maximum-segment-length-request=0, maximum-segment-length-response=0, method-id=8217, transport-protocol=UDP
          notifier notifier: event-id=8217, maximum-segment-length=0, transport-protocol=UDP
        DepartSet2EnableState_Field: field=DepartSet2EnableState
          get getter: maximum-segment-length-request=0, maximum-segment-length-response=0, method-id=8228, transport-protocol=UDP
          notifier notifier: event-id=8228, maximum-segment-length=0, transport-protocol=UDP
        DepartSet2_Fri_Field: field=DepartSet2_Fri
          get getter: maximum-segment-length-request=0, maximum-segment-length-response=0, method-id=8219, transport-protocol=UDP
          notifier notifier: event-id=8219, maximum-segment-length=0, transport-protocol=UDP
        DepartSet2_Hour_Field: field=DepartSet2_Hour
          get getter: maximum-segment-length-request=0, maximum-segment-length-response=0, method-id=8220, transport-protocol=UDP
          notifier notifier: event-id=8220, maximum-segment-length=0, transport-protocol=UDP
        DepartSet2_Min_Field: field=DepartSet2_Min
          get getter: maximum-segment-length-request=0, maximum-segment-length-response=0, method-id=8221, transport-protocol=UDP
          notifier notifier: event-id=8221, maximum-segment-length=0, transport-protocol=UDP
        DepartSet2_Mon_Field: field=DepartSet2_Mon
          get getter: maximum-segment-length-request=0, maximum-segment-length-response=0, method-id=8222, transport-protocol=UDP
          notifier notifier: event-id=8222, maximum-segment-length=0, transport-protocol=UDP
        DepartSet2_Sat_Field: field=DepartSet2_Sat
          get getter: maximum-segment-length-request=0, maximum-segment-length-response=0, method-id=8223, transport-protocol=UDP
          notifier notifier: event-id=8223, maximum-segment-length=0, transport-protocol=UDP
        DepartSet2_Sun_Field: field=DepartSet2_Sun
          get getter: maximum-segment-length-request=0, maximum-segment-length-response=0, method-id=8224, transport-protocol=UDP
          notifier notifier: event-id=8224, maximum-segment-length=0, transport-protocol=UDP
        DepartSet2_Thu_Field: field=DepartSet2_Thu
          get getter: maximum-segment-length-request=0, maximum-segment-length-response=0, method-id=8225, transport-protocol=UDP
          notifier notifier: event-id=8225, maximum-segment-length=0, transport-protocol=UDP
        DepartSet2_Tue_Field: field=DepartSet2_Tue
          get getter: maximum-segment-length-request=0, maximum-segment-length-response=0, method-id=8226, transport-protocol=UDP
          notifier notifier: event-id=8226, maximum-segment-length=0, transport-protocol=UDP
        DepartSet2_Wed_Field: field=DepartSet2_Wed
          get getter: maximum-segment-length-request=0, maximum-segment-length-response=0, method-id=8227, transport-protocol=UDP
          notifier notifier: event-id=8227, maximum-segment-length=0, transport-protocol=UDP
        DisplayOperationFlag_Field: field=DisplayOperationFlag
          get getter: maximum-segment-length-request=0, maximum-segment-length-response=0, method-id=8341, transport-protocol=UDP
          notifier notifier: event-id=8341, maximum-segment-length=0, transport-protocol=UDP
        DomesticChargeRemainedTime_Field: field=DomesticChargeRemainedTime
          get getter: maximum-segment-length-request=0, maximum-segment-length-response=0, method-id=8229, transport-protocol=UDP
          notifier notifier: event-id=8229, maximum-segment-length=0, transport-protocol=UDP
        DteBaseValue_Field: field=DteBaseValue
          get getter: maximum-segment-length-request=0, maximum-segment-length-response=0, method-id=8230, transport-protocol=UDP
          notifier notifier: event-id=8230, maximum-segment-length=0, transport-protocol=UDP
        DteOffDisplayState_Field: field=DteOffDisplayState
          get getter: maximum-segment-length-request=0, maximum-segment-length-response=0, method-id=8231, transport-protocol=UDP
          notifier notifier: event-id=8231, maximum-segment-length=0, transport-protocol=UDP
        DteOffDisplayState_HCU_Field: field=DteOffDisplayState_HCU
          get getter: maximum-segment-length-request=0, maximum-segment-length-response=0, method-id=8338, transport-protocol=UDP
          notifier notifier: event-id=8338, maximum-segment-length=0, transport-protocol=UDP
        DteV2LValue_Field: field=DteV2LValue
          get getter: maximum-segment-length-request=0, maximum-segment-length-response=0, method-id=8342, transport-protocol=UDP
          notifier notifier: event-id=8342, maximum-segment-length=0, transport-protocol=UDP
        EVBatteryConditioningState_Field: field=EVBatteryConditioningState
          get getter: maximum-segment-length-request=0, maximum-segment-length-response=0, method-id=8236, transport-protocol=UDP
          notifier notifier: event-id=8236, maximum-segment-length=0, transport-protocol=UDP
        EVModeDTEKmValue_Field: field=EVModeDTEKmValue
          get getter: maximum-segment-length-request=0, maximum-segment-length-response=0, method-id=8337, transport-protocol=UDP
          notifier notifier: event-id=8337, maximum-segment-length=0, transport-protocol=UDP
        EVModeDTEMileValue_Field: field=EVModeDTEMileValue
          get getter: maximum-segment-length-request=0, maximum-segment-length-response=0, method-id=8336, transport-protocol=UDP
          notifier notifier: event-id=8336, maximum-segment-length=0, transport-protocol=UDP
        ElectricDrivingReadyState_Field: field=ElectricDrivingReadyState
          get getter: maximum-segment-length-request=0, maximum-segment-length-response=0, method-id=8232, transport-protocol=UDP
          notifier notifier: event-id=8232, maximum-segment-length=0, transport-protocol=UDP
        ElectricSupplyStandReadyState_Field: field=ElectricSupplyStandReadyState
          get getter: maximum-segment-length-request=0, maximum-segment-length-response=0, method-id=8233, transport-protocol=UDP
          notifier notifier: event-id=8233, maximum-segment-length=0, transport-protocol=UDP
        EnergyCapacityValue_Field: field=EnergyCapacityValue
          get getter: maximum-segment-length-request=0, maximum-segment-length-response=0, method-id=8234, transport-protocol=UDP
          notifier notifier: event-id=8234, maximum-segment-length=0, transport-protocol=UDP
        EstimatedRamainTime_Field: field=EstimatedRamainTime
          get getter: maximum-segment-length-request=0, maximum-segment-length-response=0, method-id=8331, transport-protocol=UDP
          notifier notifier: event-id=8331, maximum-segment-length=0, transport-protocol=UDP
        EuroChargeRemainedTime_Field: field=EuroChargeRemainedTime
          get getter: maximum-segment-length-request=0, maximum-segment-length-response=0, method-id=8235, transport-protocol=UDP
          notifier notifier: event-id=8235, maximum-segment-length=0, transport-protocol=UDP
        EvseReadyStatus_Field: field=EvseReadyStatus
          get getter: maximum-segment-length-request=0, maximum-segment-length-response=0, method-id=8347, transport-protocol=UDP
          notifier notifier: event-id=8347, maximum-segment-length=0, transport-protocol=UDP
        ExpiredMonth1ofCertificate_Field: field=ExpiredMonth1ofCertificate
          get getter: maximum-segment-length-request=0, maximum-segment-length-response=0, method-id=8307, transport-protocol=UDP
          notifier notifier: event-id=8307, maximum-segment-length=0, transport-protocol=UDP
        ExpiredMonth2ofCertificate_Field: field=ExpiredMonth2ofCertificate
          get getter: maximum-segment-length-request=0, maximum-segment-length-response=0, method-id=8308, transport-protocol=UDP
          notifier notifier: event-id=8308, maximum-segment-length=0, transport-protocol=UDP
        ExpiredMonth3ofCertificate_Field: field=ExpiredMonth3ofCertificate
          get getter: maximum-segment-length-request=0, maximum-segment-length-response=0, method-id=8309, transport-protocol=UDP
          notifier notifier: event-id=8309, maximum-segment-length=0, transport-protocol=UDP
        ExpiredMonth4ofCertificate_Field: field=ExpiredMonth4ofCertificate
          get getter: maximum-segment-length-request=0, maximum-segment-length-response=0, method-id=8310, transport-protocol=UDP
          notifier notifier: event-id=8310, maximum-segment-length=0, transport-protocol=UDP
        ExpiredMonth5ofCertificate_Field: field=ExpiredMonth5ofCertificate
          get getter: maximum-segment-length-request=0, maximum-segment-length-response=0, method-id=8311, transport-protocol=UDP
          notifier notifier: event-id=8311, maximum-segment-length=0, transport-protocol=UDP
        Expiredyear1ofCertificate_Field: field=Expiredyear1ofCertificate
          get getter: maximum-segment-length-request=0, maximum-segment-length-response=0, method-id=8312, transport-protocol=UDP
          notifier notifier: event-id=8312, maximum-segment-length=0, transport-protocol=UDP
        Expiredyear2ofCertificate_Field: field=Expiredyear2ofCertificate
          get getter: maximum-segment-length-request=0, maximum-segment-length-response=0, method-id=8313, transport-protocol=UDP
          notifier notifier: event-id=8313, maximum-segment-length=0, transport-protocol=UDP
        Expiredyear3ofCertificate_Field: field=Expiredyear3ofCertificate
          get getter: maximum-segment-length-request=0, maximum-segment-length-response=0, method-id=8314, transport-protocol=UDP
          notifier notifier: event-id=8314, maximum-segment-length=0, transport-protocol=UDP
        Expiredyear4ofCertificate_Field: field=Expiredyear4ofCertificate
          get getter: maximum-segment-length-request=0, maximum-segment-length-response=0, method-id=8315, transport-protocol=UDP
          notifier notifier: event-id=8315, maximum-segment-length=0, transport-protocol=UDP
        Expiredyear5ofCertificate_Field: field=Expiredyear5ofCertificate
          get getter: maximum-segment-length-request=0, maximum-segment-length-response=0, method-id=8316, transport-protocol=UDP
          notifier notifier: event-id=8316, maximum-segment-length=0, transport-protocol=UDP
        FCU_H2LkLmp_Field: field=FCU_H2LkLmp
          get getter: maximum-segment-length-request=0, maximum-segment-length-response=0, method-id=8425, transport-protocol=UDP
          notifier notifier: event-id=8425, maximum-segment-length=0, transport-protocol=UDP
        FCU_H2LkSte_Field: field=FCU_H2LkSte
          get getter: maximum-segment-length-request=0, maximum-segment-length-response=0, method-id=8424, transport-protocol=UDP
          notifier notifier: event-id=8424, maximum-segment-length=0, transport-protocol=UDP
        FCU_HeatCoopRspn_Field: field=FCU_HeatCoopRspn
          get getter: maximum-segment-length-request=0, maximum-segment-length-response=0, method-id=8426, transport-protocol=UDP
          notifier notifier: event-id=8426, maximum-segment-length=0, transport-protocol=UDP
        FastChargeSOCValue_Field: field=FastChargeSOCValue
          get getter: maximum-segment-length-request=0, maximum-segment-length-response=0, method-id=8237, transport-protocol=UDP
          notifier notifier: event-id=8237, maximum-segment-length=0, transport-protocol=UDP
        FastChargingState_Field: field=FastChargingState
          get getter: maximum-segment-length-request=0, maximum-segment-length-response=0, method-id=8238, transport-protocol=UDP
          notifier notifier: event-id=8238, maximum-segment-length=0, transport-protocol=UDP
        FatcPowerUseValue_Field: field=FatcPowerUseValue
          get getter: maximum-segment-length-request=0, maximum-segment-length-response=0, method-id=8239, transport-protocol=UDP
          notifier notifier: event-id=8239, maximum-segment-length=0, transport-protocol=UDP
        Fcu_WkuFncFailInfo_Field: field=Fcu_WkuFncFailInfo
          get getter: maximum-segment-length-request=0, maximum-segment-length-response=0, method-id=8427, transport-protocol=UDP
          notifier notifier: event-id=8427, maximum-segment-length=0, transport-protocol=UDP
        FlatTowModeChargePowerUsmState_Field: field=FlatTowModeChargePowerUsmState
          get getter: maximum-segment-length-request=0, maximum-segment-length-response=0, method-id=8348, transport-protocol=UDP
          notifier notifier: event-id=8348, maximum-segment-length=0, transport-protocol=UDP
        FlatTowModeCondtionState_Field: field=FlatTowModeCondtionState
          get getter: maximum-segment-length-request=0, maximum-segment-length-response=0, method-id=8349, transport-protocol=UDP
          notifier notifier: event-id=8349, maximum-segment-length=0, transport-protocol=UDP
        FlatTowModeEquipmentState_Field: field=FlatTowModeEquipmentState
          get getter: maximum-segment-length-request=0, maximum-segment-length-response=0, method-id=8350, transport-protocol=UDP
          notifier notifier: event-id=8350, maximum-segment-length=0, transport-protocol=UDP
        FlatTowModeTargetSocUsmState_Field: field=FlatTowModeTargetSocUsmState
          get getter: maximum-segment-length-request=0, maximum-segment-length-response=0, method-id=8351, transport-protocol=UDP
          notifier notifier: event-id=8351, maximum-segment-length=0, transport-protocol=UDP
        FlatTowModeUsmState_Field: field=FlatTowModeUsmState
          get getter: maximum-segment-length-request=0, maximum-segment-length-response=0, method-id=8352, transport-protocol=UDP
          notifier notifier: event-id=8352, maximum-segment-length=0, transport-protocol=UDP
        FuelCellColdStartUp_Field: field=FuelCellColdStartUp
          get getter: maximum-segment-length-request=0, maximum-segment-length-response=0, method-id=8317, transport-protocol=UDP
          notifier notifier: event-id=8317, maximum-segment-length=0, transport-protocol=UDP
        GearPosition_Field: field=PowerTrain2/GearPosition
          get getter: maximum-segment-length-request=0, maximum-segment-length-response=0, method-id=8240, transport-protocol=UDP
          notifier notifier: event-id=8240, maximum-segment-length=0, transport-protocol=UDP
        HCU_ChrgCtrlModStayus_Field: field=HCU_ChrgCtrlModStayus
          get getter: maximum-segment-length-request=0, maximum-segment-length-response=0, method-id=8391, transport-protocol=UDP
          notifier notifier: event-id=8391, maximum-segment-length=0, transport-protocol=UDP
        HCU_DptEnaSet1FriStatus_Field: field=HCU_DptEnaSet1FriStatus
          get getter: maximum-segment-length-request=0, maximum-segment-length-response=0, method-id=8361, transport-protocol=UDP
          notifier notifier: event-id=8361, maximum-segment-length=0, transport-protocol=UDP
        HCU_DptEnaSet1MonStatus_Field: field=HCU_DptEnaSet1MonStatus
          get getter: maximum-segment-length-request=0, maximum-segment-length-response=0, method-id=8357, transport-protocol=UDP
          notifier notifier: event-id=8357, maximum-segment-length=0, transport-protocol=UDP
        HCU_DptEnaSet1SatStatus_Field: field=HCU_DptEnaSet1SatStatus
          get getter: maximum-segment-length-request=0, maximum-segment-length-response=0, method-id=8362, transport-protocol=UDP
          notifier notifier: event-id=8362, maximum-segment-length=0, transport-protocol=UDP
        HCU_DptEnaSet1Status_Field: field=HCU_DptEnaSet1Status
          get getter: maximum-segment-length-request=0, maximum-segment-length-response=0, method-id=8366, transport-protocol=UDP
          notifier notifier: event-id=8366, maximum-segment-length=0, transport-protocol=UDP
        HCU_DptEnaSet1SunStatus_Field: field=HCU_DptEnaSet1SunStatus
          get getter: maximum-segment-length-request=0, maximum-segment-length-response=0, method-id=8363, transport-protocol=UDP
          notifier notifier: event-id=8363, maximum-segment-length=0, transport-protocol=UDP
        HCU_DptEnaSet1ThuStatus_Field: field=HCU_DptEnaSet1ThuStatus
          get getter: maximum-segment-length-request=0, maximum-segment-length-response=0, method-id=8360, transport-protocol=UDP
          notifier notifier: event-id=8360, maximum-segment-length=0, transport-protocol=UDP
        HCU_DptEnaSet1TueStatus_Field: field=HCU_DptEnaSet1TueStatus
          get getter: maximum-segment-length-request=0, maximum-segment-length-response=0, method-id=8358, transport-protocol=UDP
          notifier notifier: event-id=8358, maximum-segment-length=0, transport-protocol=UDP
        HCU_DptEnaSet1WedStatus_Field: field=HCU_DptEnaSet1WedStatus
          get getter: maximum-segment-length-request=0, maximum-segment-length-response=0, method-id=8359, transport-protocol=UDP
          notifier notifier: event-id=8359, maximum-segment-length=0, transport-protocol=UDP
        HCU_DptEnaSet2FriStatus_Field: field=HCU_DptEnaSet2FriStatus
          get getter: maximum-segment-length-request=0, maximum-segment-length-response=0, method-id=8371, transport-protocol=UDP
          notifier notifier: event-id=8371, maximum-segment-length=0, transport-protocol=UDP
        HCU_DptEnaSet2MonStatus_Field: field=HCU_DptEnaSet2MonStatus
          get getter: maximum-segment-length-request=0, maximum-segment-length-response=0, method-id=8367, transport-protocol=UDP
          notifier notifier: event-id=8367, maximum-segment-length=0, transport-protocol=UDP
        HCU_DptEnaSet2SatStatus_Field: field=HCU_DptEnaSet2SatStatus
          get getter: maximum-segment-length-request=0, maximum-segment-length-response=0, method-id=8372, transport-protocol=UDP
          notifier notifier: event-id=8372, maximum-segment-length=0, transport-protocol=UDP
        HCU_DptEnaSet2Status_Field: field=HCU_DptEnaSet2Status
          get getter: maximum-segment-length-request=0, maximum-segment-length-response=0, method-id=8376, transport-protocol=UDP
          notifier notifier: event-id=8376, maximum-segment-length=0, transport-protocol=UDP
        HCU_DptEnaSet2SunStatus_Field: field=HCU_DptEnaSet2SunStatus
          get getter: maximum-segment-length-request=0, maximum-segment-length-response=0, method-id=8373, transport-protocol=UDP
          notifier notifier: event-id=8373, maximum-segment-length=0, transport-protocol=UDP
        HCU_DptEnaSet2ThuStatus_Field: field=HCU_DptEnaSet2ThuStatus
          get getter: maximum-segment-length-request=0, maximum-segment-length-response=0, method-id=8370, transport-protocol=UDP
          notifier notifier: event-id=8370, maximum-segment-length=0, transport-protocol=UDP
        HCU_DptEnaSet2TueStatus_Field: field=HCU_DptEnaSet2TueStatus
          get getter: maximum-segment-length-request=0, maximum-segment-length-response=0, method-id=8368, transport-protocol=UDP
          notifier notifier: event-id=8368, maximum-segment-length=0, transport-protocol=UDP
        HCU_DptEnaSet2WedStatus_Field: field=HCU_DptEnaSet2WedStatus
          get getter: maximum-segment-length-request=0, maximum-segment-length-response=0, method-id=8369, transport-protocol=UDP
          notifier notifier: event-id=8369, maximum-segment-length=0, transport-protocol=UDP
        HCU_DptHrSet1Value_Field: field=HCU_DptHrSet1Value
          get getter: maximum-segment-length-request=0, maximum-segment-length-response=0, method-id=8364, transport-protocol=UDP
          notifier notifier: event-id=8364, maximum-segment-length=0, transport-protocol=UDP
        HCU_DptHrSet2Value_Field: field=HCU_DptHrSet2Value
          get getter: maximum-segment-length-request=0, maximum-segment-length-response=0, method-id=8374, transport-protocol=UDP
          notifier notifier: event-id=8374, maximum-segment-length=0, transport-protocol=UDP
        HCU_DptMinSet1Value_Field: field=HCU_DptMinSet1Value
          get getter: maximum-segment-length-request=0, maximum-segment-length-response=0, method-id=8365, transport-protocol=UDP
          notifier notifier: event-id=8365, maximum-segment-length=0, transport-protocol=UDP
        HCU_DptMinSet2Value_Field: field=HCU_DptMinSet2Value
          get getter: maximum-segment-length-request=0, maximum-segment-length-response=0, method-id=8375, transport-protocol=UDP
          notifier notifier: event-id=8375, maximum-segment-length=0, transport-protocol=UDP
        HCU_EcoChrgEndHrValue_Field: field=HCU_EcoChrgEndHrValue
          get getter: maximum-segment-length-request=0, maximum-segment-length-response=0, method-id=8381, transport-protocol=UDP
          notifier notifier: event-id=8381, maximum-segment-length=0, transport-protocol=UDP
        HCU_EcoChrgEndHrWeekendValue_Field: field=HCU_EcoChrgEndHrWeekendValue
          get getter: maximum-segment-length-request=0, maximum-segment-length-response=0, method-id=8382, transport-protocol=UDP
          notifier notifier: event-id=8382, maximum-segment-length=0, transport-protocol=UDP
        HCU_EcoChrgEndMinValue_Field: field=HCU_EcoChrgEndMinValue
          get getter: maximum-segment-length-request=0, maximum-segment-length-response=0, method-id=8383, transport-protocol=UDP
          notifier notifier: event-id=8383, maximum-segment-length=0, transport-protocol=UDP
        HCU_EcoChrgEndMinWeekendValue_Field: field=HCU_EcoChrgEndMinWeekendValue
          get getter: maximum-segment-length-request=0, maximum-segment-length-response=0, method-id=8384, transport-protocol=UDP
          notifier notifier: event-id=8384, maximum-segment-length=0, transport-protocol=UDP
        HCU_EcoChrgStrtHrValue_Field: field=HCU_EcoChrgStrtHrValue
          get getter: maximum-segment-length-request=0, maximum-segment-length-response=0, method-id=8377, transport-protocol=UDP
          notifier notifier: event-id=8377, maximum-segment-length=0, transport-protocol=UDP
        HCU_EcoChrgStrtHrWeekendValue_Field: field=HCU_EcoChrgStrtHrWeekendValue
          get getter: maximum-segment-length-request=0, maximum-segment-length-response=0, method-id=8378, transport-protocol=UDP
          notifier notifier: event-id=8378, maximum-segment-length=0, transport-protocol=UDP
        HCU_EcoChrgStrtMinValue_Field: field=HCU_EcoChrgStrtMinValue
          get getter: maximum-segment-length-request=0, maximum-segment-length-response=0, method-id=8379, transport-protocol=UDP
          notifier notifier: event-id=8379, maximum-segment-length=0, transport-protocol=UDP
        HCU_EcoChrgStrtMinWeekendValue_Field: field=HCU_EcoChrgStrtMinWeekendValue
          get getter: maximum-segment-length-request=0, maximum-segment-length-response=0, method-id=8380, transport-protocol=UDP
          notifier notifier: event-id=8380, maximum-segment-length=0, transport-protocol=UDP
        HCU_IG1Status_Field: field=HCU_IG1Status
          get getter: maximum-segment-length-request=0, maximum-segment-length-response=0, method-id=8393, transport-protocol=UDP
          notifier notifier: event-id=8393, maximum-segment-length=0, transport-protocol=UDP
        HCU_SchedChgEndDayValue_Field: field=HCU_SchedChgEndDayValue
          get getter: maximum-segment-length-request=0, maximum-segment-length-response=0, method-id=8388, transport-protocol=UDP
          notifier notifier: event-id=8388, maximum-segment-length=0, transport-protocol=UDP
        HCU_SchedChgEndHrValue_Field: field=HCU_SchedChgEndHrValue
          get getter: maximum-segment-length-request=0, maximum-segment-length-response=0, method-id=8389, transport-protocol=UDP
          notifier notifier: event-id=8389, maximum-segment-length=0, transport-protocol=UDP
        HCU_SchedChgEndMinValue_Field: field=HCU_SchedChgEndMinValue
          get getter: maximum-segment-length-request=0, maximum-segment-length-response=0, method-id=8390, transport-protocol=UDP
          notifier notifier: event-id=8390, maximum-segment-length=0, transport-protocol=UDP
        HCU_SchedChgStrtDayValue_Field: field=HCU_SchedChgStrtDayValue
          get getter: maximum-segment-length-request=0, maximum-segment-length-response=0, method-id=8385, transport-protocol=UDP
          notifier notifier: event-id=8385, maximum-segment-length=0, transport-protocol=UDP
        HCU_SchedChgStrtHrValue_Field: field=HCU_SchedChgStrtHrValue
          get getter: maximum-segment-length-request=0, maximum-segment-length-response=0, method-id=8386, transport-protocol=UDP
          notifier notifier: event-id=8386, maximum-segment-length=0, transport-protocol=UDP
        HCU_SchedChgStrtMinValue_Field: field=HCU_SchedChgStrtMinValue
          get getter: maximum-segment-length-request=0, maximum-segment-length-response=0, method-id=8387, transport-protocol=UDP
          notifier notifier: event-id=8387, maximum-segment-length=0, transport-protocol=UDP
        HybridVehicleReadyState_Field: field=HybridVehicleReadyState
          get getter: maximum-segment-length-request=0, maximum-segment-length-response=0, method-id=8241, transport-protocol=UDP
          notifier notifier: event-id=8241, maximum-segment-length=0, transport-protocol=UDP
        IG3RelayModeState_Field: field=IG3RelayModeState
          get getter: maximum-segment-length-request=0, maximum-segment-length-response=0, method-id=8339, transport-protocol=UDP
          notifier notifier: event-id=8339, maximum-segment-length=0, transport-protocol=UDP
        IG3RelayOnlyStatus_Field: field=IG3RelayOnlyStatus
          get getter: maximum-segment-length-request=0, maximum-segment-length-response=0, method-id=8392, transport-protocol=UDP
          notifier notifier: event-id=8392, maximum-segment-length=0, transport-protocol=UDP
        InletLockModeStatus_Field: field=InletLockModeStatus
          get getter: maximum-segment-length-request=0, maximum-segment-length-response=0, method-id=8242, transport-protocol=UDP
          notifier notifier: event-id=8242, maximum-segment-length=0, transport-protocol=UDP
        InletTemperature_Field: field=InletTemperature
          get getter: maximum-segment-length-request=0, maximum-segment-length-response=0, method-id=8406, transport-protocol=UDP
          notifier notifier: event-id=8406, maximum-segment-length=0, transport-protocol=UDP
        IsolResistVal_Field: field=IsolResistVal
          get getter: maximum-segment-length-request=0, maximum-segment-length-response=0, method-id=8536, transport-protocol=UDP
          notifier notifier: event-id=8536, maximum-segment-length=0, transport-protocol=UDP
        LDCSystemFaultState_Field: field=LDCSystemFaultState
          get getter: maximum-segment-length-request=0, maximum-segment-length-response=0, method-id=8243, transport-protocol=UDP
          notifier notifier: event-id=8243, maximum-segment-length=0, transport-protocol=UDP
        MainRelayVehicleCondition_Field: field=MainRelayVehicleCondition
          get getter: maximum-segment-length-request=0, maximum-segment-length-response=0, method-id=8332, transport-protocol=UDP
          notifier notifier: event-id=8332, maximum-segment-length=0, transport-protocol=UDP
        MainRlyOnSta_Field: field=MainRlyOnSta
          get getter: maximum-segment-length-request=0, maximum-segment-length-response=0, method-id=8535, transport-protocol=UDP
          notifier notifier: event-id=8535, maximum-segment-length=0, transport-protocol=UDP
        MaxBattCelVoltVal_Field: field=MaxBattCelVoltVal
          get getter: maximum-segment-length-request=0, maximum-segment-length-response=0, method-id=8538, transport-protocol=UDP
          notifier notifier: event-id=8538, maximum-segment-length=0, transport-protocol=UDP
        MaximumBatteryTemperature_Dec_Field: field=MaximumBatteryTemperature_Dec
          get getter: maximum-segment-length-request=0, maximum-segment-length-response=0, method-id=8405, transport-protocol=UDP
          notifier notifier: event-id=8405, maximum-segment-length=0, transport-protocol=UDP
        MaximumBatteryTemperature_Field: field=MaximumBatteryTemperature
          get getter: maximum-segment-length-request=0, maximum-segment-length-response=0, method-id=8403, transport-protocol=UDP
          notifier notifier: event-id=8403, maximum-segment-length=0, transport-protocol=UDP
        Mg1InvtCtrlRdySta_Field: field=Mg1InvtCtrlRdySta
          get getter: maximum-segment-length-request=0, maximum-segment-length-response=0, method-id=8398, transport-protocol=UDP
          notifier notifier: event-id=8398, maximum-segment-length=0, transport-protocol=UDP
        Mg2InvtRdySta_Field: field=Mg2InvtRdySta
          get getter: maximum-segment-length-request=0, maximum-segment-length-response=0, method-id=8399, transport-protocol=UDP
          notifier notifier: event-id=8399, maximum-segment-length=0, transport-protocol=UDP
        MinBattCelVoltVal_Field: field=MinBattCelVoltVal
          get getter: maximum-segment-length-request=0, maximum-segment-length-response=0, method-id=8539, transport-protocol=UDP
          notifier notifier: event-id=8539, maximum-segment-length=0, transport-protocol=UDP
        MinimumBatteryTemperature_Dec_Field: field=MinimumBatteryTemperature_Dec
          get getter: maximum-segment-length-request=0, maximum-segment-length-response=0, method-id=8404, transport-protocol=UDP
          notifier notifier: event-id=8404, maximum-segment-length=0, transport-protocol=UDP
        MinimumBatteryTemperature_Field: field=MinimumBatteryTemperature
          get getter: maximum-segment-length-request=0, maximum-segment-length-response=0, method-id=8244, transport-protocol=UDP
          notifier notifier: event-id=8244, maximum-segment-length=0, transport-protocol=UDP
        OBCAcPowerDisplay_Field: field=OBCAcPowerDisplay
          get getter: maximum-segment-length-request=0, maximum-segment-length-response=0, method-id=8353, transport-protocol=UDP
          notifier notifier: event-id=8353, maximum-segment-length=0, transport-protocol=UDP
        OBCSystemFaultState_Field: field=OBCSystemFaultState
          get getter: maximum-segment-length-request=0, maximum-segment-length-response=0, method-id=8245, transport-protocol=UDP
          notifier notifier: event-id=8245, maximum-segment-length=0, transport-protocol=UDP
        OffPeakTimeEndHour_Field: field=OffPeakTimeEndHour
          get getter: maximum-segment-length-request=0, maximum-segment-length-response=0, method-id=8246, transport-protocol=UDP
          notifier notifier: event-id=8246, maximum-segment-length=0, transport-protocol=UDP
        OffPeakTimeEndMin_Field: field=OffPeakTimeEndMin
          get getter: maximum-segment-length-request=0, maximum-segment-length-response=0, method-id=8247, transport-protocol=UDP
          notifier notifier: event-id=8247, maximum-segment-length=0, transport-protocol=UDP
        OffPeakTimeStartHour_Field: field=OffPeakTimeStartHour
          get getter: maximum-segment-length-request=0, maximum-segment-length-response=0, method-id=8248, transport-protocol=UDP
          notifier notifier: event-id=8248, maximum-segment-length=0, transport-protocol=UDP
        OffPeakTimeStartMin_Field: field=OffPeakTimeStartMin
          get getter: maximum-segment-length-request=0, maximum-segment-length-response=0, method-id=8249, transport-protocol=UDP
          notifier notifier: event-id=8249, maximum-segment-length=0, transport-protocol=UDP
        OnBoardChargerReady_Field: field=OnBoardChargerReady
          get getter: maximum-segment-length-request=0, maximum-segment-length-response=0, method-id=8250, transport-protocol=UDP
          notifier notifier: event-id=8250, maximum-segment-length=0, transport-protocol=UDP
        PdState_Field: field=PdState
          get getter: maximum-segment-length-request=0, maximum-segment-length-response=0, method-id=8340, transport-protocol=UDP
          notifier notifier: event-id=8340, maximum-segment-length=0, transport-protocol=UDP
        PnCPCID1_Field: field=PnCPCID1
          get getter: maximum-segment-length-request=0, maximum-segment-length-response=0, method-id=8417, transport-protocol=UDP
          notifier notifier: event-id=8417, maximum-segment-length=0, transport-protocol=UDP
        PnCPCID2_Field: field=PnCPCID2
          get getter: maximum-segment-length-request=0, maximum-segment-length-response=0, method-id=8418, transport-protocol=UDP
          notifier notifier: event-id=8418, maximum-segment-length=0, transport-protocol=UDP
        PnCPCID3_Field: field=PnCPCID3
          get getter: maximum-segment-length-request=0, maximum-segment-length-response=0, method-id=8419, transport-protocol=UDP
          notifier notifier: event-id=8419, maximum-segment-length=0, transport-protocol=UDP
        QuickChargeRemainedTime_Field: field=QuickChargeRemainedTime
          get getter: maximum-segment-length-request=0, maximum-segment-length-response=0, method-id=8251, transport-protocol=UDP
          notifier notifier: event-id=8251, maximum-segment-length=0, transport-protocol=UDP
        RemainBattery_Field: field=RemainBattery
          get getter: maximum-segment-length-request=0, maximum-segment-length-response=0, method-id=8252, transport-protocol=UDP
          notifier notifier: event-id=8252, maximum-segment-length=0, transport-protocol=UDP
        RemoteAirconOptionInfo_Field: field=RemoteAirconOptionInfo
          get getter: maximum-segment-length-request=0, maximum-segment-length-response=0, method-id=8397, transport-protocol=UDP
          notifier notifier: event-id=8397, maximum-segment-length=0, transport-protocol=UDP
        RemoteClimateState_Field: field=RemoteClimateState
          get getter: maximum-segment-length-request=0, maximum-segment-length-response=0, method-id=8333, transport-protocol=UDP
          notifier notifier: event-id=8333, maximum-segment-length=0, transport-protocol=UDP
        SOCValue_Dec_Field: field=SOCValue_Dec
          get getter: maximum-segment-length-request=0, maximum-segment-length-response=0, method-id=8409, transport-protocol=UDP
          notifier notifier: event-id=8409, maximum-segment-length=0, transport-protocol=UDP
        SOC_V2Xdischargelimitation_Field: field=SOC_V2Xdischargelimitation
          get getter: maximum-segment-length-request=0, maximum-segment-length-response=0, method-id=8319, transport-protocol=UDP
          notifier notifier: event-id=8319, maximum-segment-length=0, transport-protocol=UDP
        SOC_VCMSV2Xdischargelimitation_Field: field=SOC_VCMSV2Xdischargelimitation
          get getter: maximum-segment-length-request=0, maximum-segment-length-response=0, method-id=8335, transport-protocol=UDP
          notifier notifier: event-id=8335, maximum-segment-length=0, transport-protocol=UDP
        ScheduleRemoteFunctionState_Field: field=ScheduleRemoteFunctionState
          get getter: maximum-segment-length-request=0, maximum-segment-length-response=0, method-id=8264, transport-protocol=UDP
          notifier notifier: event-id=8264, maximum-segment-length=0, transport-protocol=UDP
        ScheduledChargeMode_Field: field=ScheduledChargeMode
          get getter: maximum-segment-length-request=0, maximum-segment-length-response=0, method-id=8259, transport-protocol=UDP
          notifier notifier: event-id=8259, maximum-segment-length=0, transport-protocol=UDP
        ScheduledCharge_EndDay_Field: field=ScheduledCharge_EndDay
          get getter: maximum-segment-length-request=0, maximum-segment-length-response=0, method-id=8253, transport-protocol=UDP
          notifier notifier: event-id=8253, maximum-segment-length=0, transport-protocol=UDP
        ScheduledCharge_EndHour_Field: field=ScheduledCharge_EndHour
          get getter: maximum-segment-length-request=0, maximum-segment-length-response=0, method-id=8254, transport-protocol=UDP
          notifier notifier: event-id=8254, maximum-segment-length=0, transport-protocol=UDP
        ScheduledCharge_EndMin_Field: field=ScheduledCharge_EndMin
          get getter: maximum-segment-length-request=0, maximum-segment-length-response=0, method-id=8255, transport-protocol=UDP
          notifier notifier: event-id=8255, maximum-segment-length=0, transport-protocol=UDP
        ScheduledCharge_StartDay_Field: field=ScheduledCharge_StartDay
          get getter: maximum-segment-length-request=0, maximum-segment-length-response=0, method-id=8256, transport-protocol=UDP
          notifier notifier: event-id=8256, maximum-segment-length=0, transport-protocol=UDP
        ScheduledCharge_StartHour_Field: field=ScheduledCharge_StartHour
          get getter: maximum-segment-length-request=0, maximum-segment-length-response=0, method-id=8257, transport-protocol=UDP
          notifier notifier: event-id=8257, maximum-segment-length=0, transport-protocol=UDP
        ScheduledCharge_StartMin_Field: field=ScheduledCharge_StartMin
          get getter: maximum-segment-length-request=0, maximum-segment-length-response=0, method-id=8258, transport-protocol=UDP
          notifier notifier: event-id=8258, maximum-segment-length=0, transport-protocol=UDP
        ScheduledClimateDefrostEnableState_Field: field=ScheduledClimateDefrostEnableState
          get getter: maximum-segment-length-request=0, maximum-segment-length-response=0, method-id=8260, transport-protocol=UDP
          notifier notifier: event-id=8260, maximum-segment-length=0, transport-protocol=UDP
        ScheduledClimateEnableState_Field: field=ScheduledClimateEnableState
          get getter: maximum-segment-length-request=0, maximum-segment-length-response=0, method-id=8261, transport-protocol=UDP
          notifier notifier: event-id=8261, maximum-segment-length=0, transport-protocol=UDP
        ScheduledClimateState_Field: field=ScheduledClimateState
          get getter: maximum-segment-length-request=0, maximum-segment-length-response=0, method-id=8334, transport-protocol=UDP
          notifier notifier: event-id=8334, maximum-segment-length=0, transport-protocol=UDP
        ScheduledClimateTemperatureUnit_Field: field=ScheduledClimateTemperatureUnit
          get getter: maximum-segment-length-request=0, maximum-segment-length-response=0, method-id=8263, transport-protocol=UDP
          notifier notifier: event-id=8263, maximum-segment-length=0, transport-protocol=UDP
        ScheduledClimateTemperature_Field: field=ScheduledClimateTemperature
          get getter: maximum-segment-length-request=0, maximum-segment-length-response=0, method-id=8262, transport-protocol=UDP
          notifier notifier: event-id=8262, maximum-segment-length=0, transport-protocol=UDP
        StandardChargeConnectState_Field: field=StandardChargeConnectState
          get getter: maximum-segment-length-request=0, maximum-segment-length-response=0, method-id=8265, transport-protocol=UDP
          notifier notifier: event-id=8265, maximum-segment-length=0, transport-protocol=UDP
        StandardChargingState_Field: field=StandardChargingState
          get getter: maximum-segment-length-request=0, maximum-segment-length-response=0, method-id=8266, transport-protocol=UDP
          notifier notifier: event-id=8266, maximum-segment-length=0, transport-protocol=UDP
        StateOfChargeDisplay_Field: field=StateOfChargeDisplay
          get getter: maximum-segment-length-request=0, maximum-segment-length-response=0, method-id=8267, transport-protocol=UDP
          notifier notifier: event-id=8267, maximum-segment-length=0, transport-protocol=UDP
        StateOfChargeValue_Field: field=StateOfChargeValue
          get getter: maximum-segment-length-request=0, maximum-segment-length-response=0, method-id=8268, transport-protocol=UDP
          notifier notifier: event-id=8268, maximum-segment-length=0, transport-protocol=UDP
        TargetSocDteAcChargerValue_Field: field=TargetSocDteAcChargerValue
          get getter: maximum-segment-length-request=0, maximum-segment-length-response=0, method-id=8269, transport-protocol=UDP
          notifier notifier: event-id=8269, maximum-segment-length=0, transport-protocol=UDP
        TargetSocDteDcChargerValue_Field: field=TargetSocDteDcChargerValue
          get getter: maximum-segment-length-request=0, maximum-segment-length-response=0, method-id=8270, transport-protocol=UDP
          notifier notifier: event-id=8270, maximum-segment-length=0, transport-protocol=UDP
        USMState_Field: field=USMState
          get getter: maximum-segment-length-request=0, maximum-segment-length-response=0, method-id=8320, transport-protocol=UDP
          notifier notifier: event-id=8320, maximum-segment-length=0, transport-protocol=UDP
        USMStatus_RestModeFunction_Field: field=USMStatus_RestModeFunction
          get getter: maximum-segment-length-request=0, maximum-segment-length-response=0, method-id=8321, transport-protocol=UDP
          notifier notifier: event-id=8321, maximum-segment-length=0, transport-protocol=UDP
        V2GModeInfo_Field: field=V2GModeInfo
          get getter: maximum-segment-length-request=0, maximum-segment-length-response=0, method-id=8271, transport-protocol=UDP
          notifier notifier: event-id=8271, maximum-segment-length=0, transport-protocol=UDP
        V2LModeInfo_Field: field=V2LModeInfo
          get getter: maximum-segment-length-request=0, maximum-segment-length-response=0, method-id=8272, transport-protocol=UDP
          notifier notifier: event-id=8272, maximum-segment-length=0, transport-protocol=UDP
        V2LSOCLowLimmit_FCU_Field: field=V2LSOCLowLimmit_FCU
          get getter: maximum-segment-length-request=0, maximum-segment-length-response=0, method-id=8414, transport-protocol=UDP
          notifier notifier: event-id=8414, maximum-segment-length=0, transport-protocol=UDP
        V2LSOCLowLimmit_HCU_Field: field=V2LSOCLowLimmit_HCU
          get getter: maximum-segment-length-request=0, maximum-segment-length-response=0, method-id=8415, transport-protocol=UDP
          notifier notifier: event-id=8415, maximum-segment-length=0, transport-protocol=UDP
        V2LSocketStatus_Field: field=V2LSocketStatus
          get getter: maximum-segment-length-request=0, maximum-segment-length-response=0, method-id=8423, transport-protocol=UDP
          notifier notifier: event-id=8423, maximum-segment-length=0, transport-protocol=UDP
        VCMSConnectorStatus_Field: field=VCMSConnectorStatus
          get getter: maximum-segment-length-request=0, maximum-segment-length-response=0, method-id=8322, transport-protocol=UDP
          notifier notifier: event-id=8322, maximum-segment-length=0, transport-protocol=UDP
        VCMSConnectorStatus_forGBT_Field: field=VCMSConnectorStatus_forGBT
          get getter: maximum-segment-length-request=0, maximum-segment-length-response=0, method-id=8323, transport-protocol=UDP
          notifier notifier: event-id=8323, maximum-segment-length=0, transport-protocol=UDP
        VCMSFaultState_Field: field=VCMSFaultState
          get getter: maximum-segment-length-request=0, maximum-segment-length-response=0, method-id=8273, transport-protocol=UDP
          notifier notifier: event-id=8273, maximum-segment-length=0, transport-protocol=UDP
        VCMSPowerDisplay_Field: field=VCMSPowerDisplay
          get getter: maximum-segment-length-request=0, maximum-segment-length-response=0, method-id=8355, transport-protocol=UDP
          notifier notifier: event-id=8355, maximum-segment-length=0, transport-protocol=UDP
        VCMS_InletLockStatus_Field: field=VCMS_InletLockStatus
          get getter: maximum-segment-length-request=0, maximum-segment-length-response=0, method-id=8428, transport-protocol=UDP
          notifier notifier: event-id=8428, maximum-segment-length=0, transport-protocol=UDP
        VCRMJapenStndChargingRemainTimeValue_Field: field=VCRMJapenStndChargingRemainTimeValue
          get getter: maximum-segment-length-request=0, maximum-segment-length-response=0, method-id=8354, transport-protocol=UDP
          notifier notifier: event-id=8354, maximum-segment-length=0, transport-protocol=UDP
        VCRMSystemFaultState_Field: field=VCRMSystemFaultState
          get getter: maximum-segment-length-request=0, maximum-segment-length-response=0, method-id=8274, transport-protocol=UDP
          notifier notifier: event-id=8274, maximum-segment-length=0, transport-protocol=UDP
        VCRM_BatMonitorFaultcode_Field: field=VCRM_BatMonitorFaultcode
          get getter: maximum-segment-length-request=0, maximum-segment-length-response=0, method-id=8540, transport-protocol=UDP
          notifier notifier: event-id=8540, maximum-segment-length=0, transport-protocol=UDP
        VCRM_DiagGrpVal_Field: field=VCRM_DiagGrpVal
          get getter: maximum-segment-length-request=0, maximum-segment-length-response=0, method-id=8541, transport-protocol=UDP
          notifier notifier: event-id=8541, maximum-segment-length=0, transport-protocol=UDP
        VCRM_MaxBattTempVal_Field: field=VCRM_MaxBattTempVal
          get getter: maximum-segment-length-request=0, maximum-segment-length-response=0, method-id=8542, transport-protocol=UDP
          notifier notifier: event-id=8542, maximum-segment-length=0, transport-protocol=UDP
        VCRM_MinBattTempVal_Field: field=VCRM_MinBattTempVal
          get getter: maximum-segment-length-request=0, maximum-segment-length-response=0, method-id=8543, transport-protocol=UDP
          notifier notifier: event-id=8543, maximum-segment-length=0, transport-protocol=UDP
        VCUClimateOperationState_Field: field=VCUClimateOperationState
          get getter: maximum-segment-length-request=0, maximum-segment-length-response=0, method-id=8275, transport-protocol=UDP
          notifier notifier: event-id=8275, maximum-segment-length=0, transport-protocol=UDP
        VCUOffClimate_Field: field=VCUOffClimate
          get getter: maximum-segment-length-request=0, maximum-segment-length-response=0, method-id=8276, transport-protocol=UDP
          notifier notifier: event-id=8276, maximum-segment-length=0, transport-protocol=UDP
        VCUReadyState_Field: field=VCUReadyState
          get getter: maximum-segment-length-request=0, maximum-segment-length-response=0, method-id=8277, transport-protocol=UDP
          notifier notifier: event-id=8277, maximum-segment-length=0, transport-protocol=UDP
        VCURemoteClimateVersion_Field: field=VCURemoteClimateVersion
          get getter: maximum-segment-length-request=0, maximum-segment-length-response=0, method-id=8324, transport-protocol=UDP
          notifier notifier: event-id=8324, maximum-segment-length=0, transport-protocol=UDP
        VCUscheduledclimateDefrostFlag_Field: field=VCUscheduledclimateDefrostFlag
          get getter: maximum-segment-length-request=0, maximum-segment-length-response=0, method-id=8325, transport-protocol=UDP
          notifier notifier: event-id=8325, maximum-segment-length=0, transport-protocol=UDP
        VCUscheduledclimateEnableFlag_Field: field=VCUscheduledclimateEnableFlag
          get getter: maximum-segment-length-request=0, maximum-segment-length-response=0, method-id=8328, transport-protocol=UDP
          notifier notifier: event-id=8328, maximum-segment-length=0, transport-protocol=UDP
        VCUscheduledclimateTemperature_Field: field=VCUscheduledclimateTemperature
          get getter: maximum-segment-length-request=0, maximum-segment-length-response=0, method-id=8327, transport-protocol=UDP
          notifier notifier: event-id=8327, maximum-segment-length=0, transport-protocol=UDP
        WinterModeStatus_Field: field=WinterModeStatus
          get getter: maximum-segment-length-request=0, maximum-segment-length-response=0, method-id=8407, transport-protocol=UDP
          notifier notifier: event-id=8407, maximum-segment-length=0, transport-protocol=UDP
        WirelessChargeRemainedTime_Field: field=WirelessChargeRemainedTime
          get getter: maximum-segment-length-request=0, maximum-segment-length-response=0, method-id=8278, transport-protocol=UDP
          notifier notifier: event-id=8278, maximum-segment-length=0, transport-protocol=UDP
        XEV_DiagGrpVal_Field: field=XEV_DiagGrpVal
          get getter: maximum-segment-length-request=0, maximum-segment-length-response=0, method-id=8429, transport-protocol=UDP
          notifier notifier: event-id=8429, maximum-segment-length=0, transport-protocol=UDP
      355 x someip event group:
        NewEventGroup: event-group-id=1, event=ACChargingStatus_Field/notifier
        NewEventGroup1: event-group-id=2, event=ACNPermissionPower_Field/notifier
        NewEventGroup10: event-group-id=11, event=BMSSWversion_Field/notifier
        NewEventGroup100: event-group-id=101, event=ExpiredMonth2ofCertificate_Field/notifier
        NewEventGroup101: event-group-id=102, event=ExpiredMonth3ofCertificate_Field/notifier
        NewEventGroup102: event-group-id=103, event=ExpiredMonth4ofCertificate_Field/notifier
        NewEventGroup103: event-group-id=104, event=ExpiredMonth5ofCertificate_Field/notifier
        NewEventGroup104: event-group-id=105, event=Expiredyear1ofCertificate_Field/notifier
        NewEventGroup105: event-group-id=106, event=Expiredyear2ofCertificate_Field/notifier
        NewEventGroup106: event-group-id=107, event=Expiredyear3ofCertificate_Field/notifier
        NewEventGroup107: event-group-id=108, event=Expiredyear4ofCertificate_Field/notifier
        NewEventGroup108: event-group-id=109, event=Expiredyear5ofCertificate_Field/notifier
        NewEventGroup109: event-group-id=110, event=FastChargeSOCValue_Field/notifier
        NewEventGroup11: event-group-id=12, event=BatChllrTgtRpm_Field/notifier
        NewEventGroup110: event-group-id=111, event=FastChargingState_Field/notifier
        NewEventGroup111: event-group-id=112, event=FatcPowerUseValue_Field/notifier
        NewEventGroup112: event-group-id=113, event=FlatTowModeChargePowerUsmState_Field/notifier
        NewEventGroup113: event-group-id=114, event=FlatTowModeCondtionState_Field/notifier
        NewEventGroup114: event-group-id=115, event=FlatTowModeEquipmentState_Field/notifier
        NewEventGroup115: event-group-id=116, event=FlatTowModeTargetSocUsmState_Field/notifier
        NewEventGroup116: event-group-id=117, event=FlatTowModeUsmState_Field/notifier
        NewEventGroup117: event-group-id=118, event=FuelCellColdStartUp_Field/notifier
        NewEventGroup118: event-group-id=119, event=GearPosition_Field/notifier
        NewEventGroup119: event-group-id=120, event=HCU_ChrgCtrlModStayus_Field/notifier
        NewEventGroup12: event-group-id=13, event=BatWcsHeaterOnReq_Field/notifier
        NewEventGroup120: event-group-id=121, event=HCU_DptEnaSet1FriStatus_Field/notifier
        NewEventGroup121: event-group-id=122, event=HCU_DptEnaSet1MonStatus_Field/notifier
        NewEventGroup122: event-group-id=123, event=HCU_DptEnaSet1SatStatus_Field/notifier
        NewEventGroup123: event-group-id=124, event=HCU_DptEnaSet1Status_Field/notifier
        NewEventGroup124: event-group-id=125, event=HCU_DptEnaSet1SunStatus_Field/notifier
        NewEventGroup125: event-group-id=126, event=HCU_DptEnaSet1ThuStatus_Field/notifier
        NewEventGroup126: event-group-id=127, event=HCU_DptEnaSet1TueStatus_Field/notifier
        NewEventGroup127: event-group-id=128, event=HCU_DptEnaSet1WedStatus_Field/notifier
        NewEventGroup128: event-group-id=129, event=HCU_DptEnaSet2FriStatus_Field/notifier
        NewEventGroup129: event-group-id=130, event=HCU_DptEnaSet2MonStatus_Field/notifier
        NewEventGroup13: event-group-id=14, event=BattConditioActState_Field/notifier
        NewEventGroup130: event-group-id=131, event=HCU_DptEnaSet2SatStatus_Field/notifier
        NewEventGroup131: event-group-id=132, event=HCU_DptEnaSet2Status_Field/notifier
        NewEventGroup132: event-group-id=133, event=HCU_DptEnaSet2SunStatus_Field/notifier
        NewEventGroup133: event-group-id=134, event=HCU_DptEnaSet2ThuStatus_Field/notifier
        NewEventGroup134: event-group-id=135, event=HCU_DptEnaSet2TueStatus_Field/notifier
        NewEventGroup135: event-group-id=136, event=HCU_DptEnaSet2WedStatus_Field/notifier
        NewEventGroup136: event-group-id=137, event=HCU_DptHrSet1Value_Field/notifier
        NewEventGroup137: event-group-id=138, event=HCU_DptHrSet2Value_Field/notifier
        NewEventGroup138: event-group-id=139, event=HCU_DptMinSet1Value_Field/notifier
        NewEventGroup139: event-group-id=140, event=HCU_DptMinSet2Value_Field/notifier
        NewEventGroup14: event-group-id=15, event=BattTemperatureValue_Field/notifier
        NewEventGroup140: event-group-id=141, event=HCU_EcoChrgEndHrValue_Field/notifier
        NewEventGroup141: event-group-id=142, event=HCU_EcoChrgEndHrWeekendValue_Field/notifier
        NewEventGroup142: event-group-id=143, event=HCU_EcoChrgEndMinValue_Field/notifier
        NewEventGroup143: event-group-id=144, event=HCU_EcoChrgEndMinWeekendValue_Field/notifier
        NewEventGroup144: event-group-id=145, event=HCU_EcoChrgStrtHrValue_Field/notifier
        NewEventGroup145: event-group-id=146, event=HCU_EcoChrgStrtHrWeekendValue_Field/notifier
        NewEventGroup146: event-group-id=147, event=HCU_EcoChrgStrtMinValue_Field/notifier
        NewEventGroup147: event-group-id=148, event=HCU_EcoChrgStrtMinWeekendValue_Field/notifier
        NewEventGroup148: event-group-id=149, event=HCU_IG1Status_Field/notifier
        NewEventGroup149: event-group-id=150, event=HCU_SchedChgEndDayValue_Field/notifier
        NewEventGroup15: event-group-id=16, event=BatteryConditioningApply_Field/notifier
        NewEventGroup150: event-group-id=151, event=HCU_SchedChgEndHrValue_Field/notifier
        NewEventGroup151: event-group-id=152, event=HCU_SchedChgEndMinValue_Field/notifier
        NewEventGroup152: event-group-id=153, event=HCU_SchedChgStrtDayValue_Field/notifier
        NewEventGroup153: event-group-id=154, event=HCU_SchedChgStrtHrValue_Field/notifier
        NewEventGroup154: event-group-id=155, event=HCU_SchedChgStrtMinValue_Field/notifier
        NewEventGroup156: event-group-id=157, event=HybridVehicleReadyState_Field/notifier
        NewEventGroup157: event-group-id=158, event=IG3RelayModeState_Field/notifier
        NewEventGroup158: event-group-id=159, event=IG3RelayOnlyStatus_Field/notifier
        NewEventGroup159: event-group-id=160, event=InletLockModeStatus_Field/notifier
        NewEventGroup16: event-group-id=17, event=BatteryConditioningState_Field/notifier
        NewEventGroup160: event-group-id=161, event=InletTemperature_Field/notifier
        NewEventGroup161: event-group-id=162, event=LDCSystemFaultState_Field/notifier
        NewEventGroup162: event-group-id=163, event=MainRelayVehicleCondition_Field/notifier
        NewEventGroup163: event-group-id=164, event=MaximumBatteryTemperature_Field/notifier
        NewEventGroup164: event-group-id=165, event=MaximumBatteryTemperature_Dec_Field/notifier
        NewEventGroup165: event-group-id=166, event=Mg1InvtCtrlRdySta_Field/notifier
        NewEventGroup166: event-group-id=167, event=Mg2InvtRdySta_Field/notifier
        NewEventGroup167: event-group-id=168, event=MinimumBatteryTemperature_Field/notifier
        NewEventGroup168: event-group-id=169, event=MinimumBatteryTemperature_Dec_Field/notifier
        NewEventGroup169: event-group-id=170, event=OBCAcPowerDisplay_Field/notifier
        NewEventGroup17: event-group-id=18, event=BatteryEmergencyState_Field/notifier
        NewEventGroup170: event-group-id=171, event=OBCSystemFaultState_Field/notifier
        NewEventGroup171: event-group-id=172, event=OffPeakTimeEndHour_Field/notifier
        NewEventGroup172: event-group-id=173, event=OffPeakTimeEndMin_Field/notifier
        NewEventGroup173: event-group-id=174, event=OffPeakTimeStartHour_Field/notifier
        NewEventGroup174: event-group-id=175, event=OffPeakTimeStartMin_Field/notifier
        NewEventGroup175: event-group-id=176, event=OnBoardChargerReady_Field/notifier
        NewEventGroup176: event-group-id=177, event=PdState_Field/notifier
        NewEventGroup177: event-group-id=178, event=PnCPCID1_Field/notifier
        NewEventGroup178: event-group-id=179, event=PnCPCID2_Field/notifier
        NewEventGroup179: event-group-id=180, event=PnCPCID3_Field/notifier
        NewEventGroup18: event-group-id=19, event=BatteryHeaterInputPower_Field/notifier
        NewEventGroup180: event-group-id=181, event=QuickChargeRemainedTime_Field/notifier
        NewEventGroup181: event-group-id=182, event=RemainBattery_Field/notifier
        NewEventGroup182: event-group-id=183, event=RemoteAirconOptionInfo_Field/notifier
        NewEventGroup183: event-group-id=184, event=RemoteClimateState_Field/notifier
        NewEventGroup184: event-group-id=185, event=SOCValue_Dec_Field/notifier
        NewEventGroup185: event-group-id=186, event=SOC_V2Xdischargelimitation_Field/notifier
        NewEventGroup186: event-group-id=187, event=SOC_VCMSV2Xdischargelimitation_Field/notifier
        NewEventGroup187: event-group-id=188, event=ScheduleRemoteFunctionState_Field/notifier
        NewEventGroup188: event-group-id=189, event=ScheduledChargeMode_Field/notifier
        NewEventGroup189: event-group-id=190, event=ScheduledCharge_EndDay_Field/notifier
        NewEventGroup19: event-group-id=20, event=BatteryOptionValue_Field/notifier
        NewEventGroup190: event-group-id=191, event=ScheduledCharge_EndHour_Field/notifier
        NewEventGroup191: event-group-id=192, event=ScheduledCharge_EndMin_Field/notifier
        NewEventGroup192: event-group-id=193, event=ScheduledCharge_StartDay_Field/notifier
        NewEventGroup193: event-group-id=194, event=ScheduledCharge_StartHour_Field/notifier
        NewEventGroup194: event-group-id=195, event=ScheduledCharge_StartMin_Field/notifier
        NewEventGroup195: event-group-id=196, event=ScheduledClimateDefrostEnableState_Field/notifier
        NewEventGroup196: event-group-id=197, event=ScheduledClimateEnableState_Field/notifier
        NewEventGroup197: event-group-id=198, event=ScheduledClimateState_Field/notifier
        NewEventGroup198: event-group-id=199, event=ScheduledClimateTemperature_Field/notifier
        NewEventGroup199: event-group-id=200, event=ScheduledClimateTemperatureUnit_Field/notifier
        NewEventGroup2: event-group-id=3, event=AVNDTECorrelationFactorValue_Field/notifier
        NewEventGroup20: event-group-id=21, event=BatteryPackVoltage_Field/notifier
        NewEventGroup200: event-group-id=201, event=StandardChargeConnectState_Field/notifier
        NewEventGroup201: event-group-id=202, event=StandardChargingState_Field/notifier
        NewEventGroup202: event-group-id=203, event=StateOfChargeDisplay_Field/notifier
        NewEventGroup203: event-group-id=204, event=StateOfChargeValue_Field/notifier
        NewEventGroup204: event-group-id=205, event=TargetSocDteAcChargerValue_Field/notifier
        NewEventGroup205: event-group-id=206, event=TargetSocDteDcChargerValue_Field/notifier
        NewEventGroup206: event-group-id=207, event=USMState_Field/notifier
        NewEventGroup207: event-group-id=208, event=USMStatus_RestModeFunction_Field/notifier
        NewEventGroup208: event-group-id=209, event=V2GModeInfo_Field/notifier
        NewEventGroup209: event-group-id=210, event=V2LModeInfo_Field/notifier
        NewEventGroup21: event-group-id=22, event=BatteryPopupMessage_Field/notifier
        NewEventGroup210: event-group-id=211, event=V2LSOCLowLimmit_FCU_Field/notifier
        NewEventGroup211: event-group-id=212, event=V2LSOCLowLimmit_HCU_Field/notifier
        NewEventGroup212: event-group-id=213, event=VCMSConnectorStatus_Field/notifier
        NewEventGroup213: event-group-id=214, event=VCMSConnectorStatus_forGBT_Field/notifier
        NewEventGroup214: event-group-id=215, event=VCMSFaultState_Field/notifier
        NewEventGroup215: event-group-id=216, event=VCMSPowerDisplay_Field/notifier
        NewEventGroup216: event-group-id=217, event=VCRMJapenStndChargingRemainTimeValue_Field/notifier
        NewEventGroup217: event-group-id=218, event=VCRMSystemFaultState_Field/notifier
        NewEventGroup218: event-group-id=219, event=VCUClimateOperationState_Field/notifier
        NewEventGroup219: event-group-id=220, event=VCUOffClimate_Field/notifier
        NewEventGroup22: event-group-id=23, event=BatterySpecInfo_Field/notifier
        NewEventGroup220: event-group-id=221, event=VCUReadyState_Field/notifier
        NewEventGroup221: event-group-id=222, event=VCURemoteClimateVersion_Field/notifier
        NewEventGroup222: event-group-id=223, event=VCUscheduledclimateDefrostFlag_Field/notifier
        NewEventGroup223: event-group-id=224, event=VCUscheduledclimateEnableFlag_Field/notifier
        NewEventGroup224: event-group-id=225, event=VCUscheduledclimateTemperature_Field/notifier
        NewEventGroup225: event-group-id=226, event=WinterModeStatus_Field/notifier
        NewEventGroup226: event-group-id=227, event=WirelessChargeRemainedTime_Field/notifier
        NewEventGroup227: event-group-id=228, event=ChgEnergyDis_Field/notifier
        NewEventGroup228: event-group-id=229, event=ChrgInletTyp_Field/notifier
        NewEventGroup229: event-group-id=230, event=V2LSocketStatus_Field/notifier
        NewEventGroup23: event-group-id=24, event=BatteryTemperatureState_Field/notifier
        NewEventGroup230: event-group-id=231, event=FCU_H2LkSte_Field/notifier
        NewEventGroup231: event-group-id=232, event=FCU_H2LkLmp_Field/notifier
        NewEventGroup232: event-group-id=233, event=FCU_HeatCoopRspn_Field/notifier
        NewEventGroup233: event-group-id=234, event=Fcu_WkuFncFailInfo_Field/notifier
        NewEventGroup234: event-group-id=235, event=VCMS_InletLockStatus_Field/notifier
        NewEventGroup235: event-group-id=236, event=XEV_DiagGrpVal_Field/notifier
        NewEventGroup236: event-group-id=237, event=BattCell1_Index_Field/notifier
        NewEventGroup237: event-group-id=238, event=BattCell1VoltVal_Field/notifier
        NewEventGroup238: event-group-id=239, event=BattCell2VoltVal_Field/notifier
        NewEventGroup239: event-group-id=240, event=BattCell3VoltVal_Field/notifier
        NewEventGroup24: event-group-id=25, event=CCMContCertChnStatus_Field/notifier
        NewEventGroup240: event-group-id=241, event=BattCell4VoltVal_Field/notifier
        NewEventGroup241: event-group-id=242, event=BattCell5VoltVal_Field/notifier
        NewEventGroup242: event-group-id=243, event=BattCell6VoltVal_Field/notifier
        NewEventGroup243: event-group-id=244, event=BattCell7VoltVal_Field/notifier
        NewEventGroup244: event-group-id=245, event=BattCell8VoltVal_Field/notifier
        NewEventGroup245: event-group-id=246, event=BattCell9VoltVal_Field/notifier
        NewEventGroup246: event-group-id=247, event=BattCell10VoltVal_Field/notifier
        NewEventGroup247: event-group-id=248, event=BattCell11VoltVal_Field/notifier
        NewEventGroup248: event-group-id=249, event=BattCell12VoltVal_Field/notifier
        NewEventGroup249: event-group-id=250, event=BattCell13VoltVal_Field/notifier
        NewEventGroup25: event-group-id=26, event=CCMContCertInstNumber_Field/notifier
        NewEventGroup250: event-group-id=251, event=BattCell14VoltVal_Field/notifier
        NewEventGroup251: event-group-id=252, event=BattCell2_Index_Field/notifier
        NewEventGroup252: event-group-id=253, event=BattCell15VoltVal_Field/notifier
        NewEventGroup253: event-group-id=254, event=BattCell16VoltVal_Field/notifier
        NewEventGroup254: event-group-id=255, event=BattCell17VoltVal_Field/notifier
        NewEventGroup255: event-group-id=256, event=BattCell18VoltVal_Field/notifier
        NewEventGroup256: event-group-id=257, event=BattCell19VoltVal_Field/notifier
        NewEventGroup257: event-group-id=258, event=BattCell20VoltVal_Field/notifier
        NewEventGroup258: event-group-id=259, event=BattCell21VoltVal_Field/notifier
        NewEventGroup259: event-group-id=260, event=BattCell22VoltVal_Field/notifier
        NewEventGroup26: event-group-id=27, event=CCM_ContCert_ChnDel_Result_Field/notifier
        NewEventGroup260: event-group-id=261, event=BattCell23VoltVal_Field/notifier
        NewEventGroup261: event-group-id=262, event=BattCell24VoltVal_Field/notifier
        NewEventGroup262: event-group-id=263, event=BattCell25VoltVal_Field/notifier
        NewEventGroup263: event-group-id=264, event=BattCell26VoltVal_Field/notifier
        NewEventGroup264: event-group-id=265, event=BattCell27VoltVal_Field/notifier
        NewEventGroup265: event-group-id=266, event=BattCell28VoltVal_Field/notifier
        NewEventGroup266: event-group-id=267, event=BattCell3_Index_Field/notifier
        NewEventGroup267: event-group-id=268, event=BattCell29VoltVal_Field/notifier
        NewEventGroup268: event-group-id=269, event=BattCell30VoltVal_Field/notifier
        NewEventGroup269: event-group-id=270, event=BattCell31VoltVal_Field/notifier
        NewEventGroup27: event-group-id=28, event=CCM_PnCModeStatus_Field/notifier
        NewEventGroup270: event-group-id=271, event=BattCell32VoltVal_Field/notifier
        NewEventGroup271: event-group-id=272, event=BattCell33VoltVal_Field/notifier
        NewEventGroup272: event-group-id=273, event=BattCell34VoltVal_Field/notifier
        NewEventGroup273: event-group-id=274, event=BattCell35VoltVal_Field/notifier
        NewEventGroup274: event-group-id=275, event=BattCell36VoltVal_Field/notifier
        NewEventGroup275: event-group-id=276, event=BattCell37VoltVal_Field/notifier
        NewEventGroup276: event-group-id=277, event=BattCell38VoltVal_Field/notifier
        NewEventGroup277: event-group-id=278, event=BattCell39VoltVal_Field/notifier
        NewEventGroup278: event-group-id=279, event=BattCell40VoltVal_Field/notifier
        NewEventGroup279: event-group-id=280, event=BattCell41VoltVal_Field/notifier
        NewEventGroup28: event-group-id=29, event=CertificateReceiveOptionFlag_Field/notifier
        NewEventGroup280: event-group-id=281, event=BattCell42VoltVal_Field/notifier
        NewEventGroup281: event-group-id=282, event=BattCell4_Index_Field/notifier
        NewEventGroup282: event-group-id=283, event=BattCell43VoltVal_Field/notifier
        NewEventGroup283: event-group-id=284, event=BattCell44VoltVal_Field/notifier
        NewEventGroup284: event-group-id=285, event=BattCell45VoltVal_Field/notifier
        NewEventGroup285: event-group-id=286, event=BattCell46VoltVal_Field/notifier
        NewEventGroup286: event-group-id=287, event=BattCell47VoltVal_Field/notifier
        NewEventGroup287: event-group-id=288, event=BattCell48VoltVal_Field/notifier
        NewEventGroup288: event-group-id=289, event=BattCell49VoltVal_Field/notifier
        NewEventGroup289: event-group-id=290, event=BattCell50VoltVal_Field/notifier
        NewEventGroup29: event-group-id=30, event=CertificateReceiveStatus_Field/notifier
        NewEventGroup290: event-group-id=291, event=BattCell51VoltVal_Field/notifier
        NewEventGroup291: event-group-id=292, event=BattCell52VoltVal_Field/notifier
        NewEventGroup292: event-group-id=293, event=BattCell53VoltVal_Field/notifier
        NewEventGroup293: event-group-id=294, event=BattCell54VoltVal_Field/notifier
        NewEventGroup294: event-group-id=295, event=BattCell55VoltVal_Field/notifier
        NewEventGroup295: event-group-id=296, event=BattCell56VoltVal_Field/notifier
        NewEventGroup296: event-group-id=297, event=BattCell5_Index_Field/notifier
        NewEventGroup297: event-group-id=298, event=BattCell57VoltVal_Field/notifier
        NewEventGroup298: event-group-id=299, event=BattCell58VoltVal_Field/notifier
        NewEventGroup299: event-group-id=300, event=BattCell59VoltVal_Field/notifier
        NewEventGroup3: event-group-id=4, event=AirconditionerActivation_Field/notifier
        NewEventGroup30: event-group-id=31, event=ChargeCurrentMode_NoVCMS_Field/notifier
        NewEventGroup300: event-group-id=301, event=BattCell60VoltVal_Field/notifier
        NewEventGroup301: event-group-id=302, event=BattCell61VoltVal_Field/notifier
        NewEventGroup302: event-group-id=303, event=BattCell62VoltVal_Field/notifier
        NewEventGroup303: event-group-id=304, event=BattCell63VoltVal_Field/notifier
        NewEventGroup304: event-group-id=305, event=BattCell64VoltVal_Field/notifier
        NewEventGroup305: event-group-id=306, event=BattCell65VoltVal_Field/notifier
        NewEventGroup306: event-group-id=307, event=BattCell66VoltVal_Field/notifier
        NewEventGroup307: event-group-id=308, event=BattCell67VoltVal_Field/notifier
        NewEventGroup308: event-group-id=309, event=BattCell68VoltVal_Field/notifier
        NewEventGroup309: event-group-id=310, event=BattCell69VoltVal_Field/notifier
        NewEventGroup31: event-group-id=32, event=ChargeCurrentMode_VCMS_Field/notifier
        NewEventGroup310: event-group-id=311, event=BattCell70VoltVal_Field/notifier
        NewEventGroup311: event-group-id=312, event=BattCell6_Index_Field/notifier
        NewEventGroup312: event-group-id=313, event=BattCell71VoltVal_Field/notifier
        NewEventGroup313: event-group-id=314, event=BattCell72VoltVal_Field/notifier
        NewEventGroup314: event-group-id=315, event=BattCell73VoltVal_Field/notifier
        NewEventGroup315: event-group-id=316, event=BattCell74VoltVal_Field/notifier
        NewEventGroup316: event-group-id=317, event=BattCell75VoltVal_Field/notifier
        NewEventGroup317: event-group-id=318, event=BattCell76VoltVal_Field/notifier
        NewEventGroup318: event-group-id=319, event=BattCell77VoltVal_Field/notifier
        NewEventGroup319: event-group-id=320, event=BattCell78VoltVal_Field/notifier
        NewEventGroup32: event-group-id=33, event=ChargeRemainedTime_Field/notifier
        NewEventGroup320: event-group-id=321, event=BattCell79VoltVal_Field/notifier
        NewEventGroup321: event-group-id=322, event=BattCell80VoltVal_Field/notifier
        NewEventGroup322: event-group-id=323, event=BattCell81VoltVal_Field/notifier
        NewEventGroup323: event-group-id=324, event=BattCell82VoltVal_Field/notifier
        NewEventGroup324: event-group-id=325, event=BattCell83VoltVal_Field/notifier
        NewEventGroup325: event-group-id=326, event=BattCell84VoltVal_Field/notifier
        NewEventGroup326: event-group-id=327, event=BattCell7_Index_Field/notifier
        NewEventGroup327: event-group-id=328, event=BattCell85VoltVal_Field/notifier
        NewEventGroup328: event-group-id=329, event=BattCell86VoltVal_Field/notifier
        NewEventGroup329: event-group-id=330, event=BattCell87VoltVal_Field/notifier
        NewEventGroup33: event-group-id=34, event=ChargeRemainedTime120_Field/notifier
        NewEventGroup330: event-group-id=331, event=BattCell88VoltVal_Field/notifier
        NewEventGroup331: event-group-id=332, event=BattCell89VoltVal_Field/notifier
        NewEventGroup332: event-group-id=333, event=BattCell90VoltVal_Field/notifier
        NewEventGroup333: event-group-id=334, event=BattCell91VoltVal_Field/notifier
        NewEventGroup334: event-group-id=335, event=BattCell92VoltVal_Field/notifier
        NewEventGroup335: event-group-id=336, event=BattCell93VoltVal_Field/notifier
        NewEventGroup336: event-group-id=337, event=BattCell94VoltVal_Field/notifier
        NewEventGroup337: event-group-id=338, event=BattCell95VoltVal_Field/notifier
        NewEventGroup338: event-group-id=339, event=BattCell96VoltVal_Field/notifier
        NewEventGroup339: event-group-id=340, event=BattCell97VoltVal_Field/notifier
        NewEventGroup34: event-group-id=35, event=ChargeRemainedTime240_Field/notifier
        NewEventGroup340: event-group-id=341, event=BattCell98VoltVal_Field/notifier
        NewEventGroup341: event-group-id=342, event=MainRlyOnSta_Field/notifier
        NewEventGroup342: event-group-id=343, event=IsolResistVal_Field/notifier
        NewEventGroup343: event-group-id=344, event=BattCurrVal_Field/notifier
        NewEventGroup344: event-group-id=345, event=MaxBattCelVoltVal_Field/notifier
        NewEventGroup345: event-group-id=346, event=MinBattCelVoltVal_Field/notifier
        NewEventGroup346: event-group-id=347, event=VCRM_BatMonitorFaultcode_Field/notifier
        NewEventGroup347: event-group-id=348, event=VCRM_DiagGrpVal_Field/notifier
        NewEventGroup348: event-group-id=349, event=VCRM_MaxBattTempVal_Field/notifier
        NewEventGroup349: event-group-id=350, event=VCRM_MinBattTempVal_Field/notifier
        NewEventGroup35: event-group-id=36, event=ChargeRemainedTime240_VCRM_Field/notifier
        NewEventGroup350: event-group-id=351, event=BattTempMainMaxVal_Field/notifier
        NewEventGroup351: event-group-id=352, event=BattTempMainMinVal_Field/notifier
        NewEventGroup352: event-group-id=353, event=Bms_H_avg_max_Field/notifier
        NewEventGroup353: event-group-id=354, event=Bms_H_ocv_max_Field/notifier
        NewEventGroup354: event-group-id=355, event=Bms_Vmax_dec_Field/notifier
        NewEventGroup355: event-group-id=356, event=Bms_Vmin_dec_Field/notifier
        NewEventGroup36: event-group-id=37, event=ChargeRemainedTimeValue_Field/notifier
        NewEventGroup37: event-group-id=38, event=ChargeSOCValue_Field/notifier
        NewEventGroup38: event-group-id=39, event=ChargeStartStatus_Field/notifier
        NewEventGroup39: event-group-id=40, event=ChargeStateforAlarm_Field/notifier
        NewEventGroup4: event-group-id=5, event=AirconditionerControlStatus_Field/notifier
        NewEventGroup40: event-group-id=41, event=ChargeStateforAlarm_Subcode_Field/notifier
        NewEventGroup41: event-group-id=42, event=ChargingFinishReason_Field/notifier
        NewEventGroup42: event-group-id=43, event=ChargingFinishState_Field/notifier
        NewEventGroup43: event-group-id=44, event=ChargingPowerDerating_Field/notifier
        NewEventGroup44: event-group-id=45, event=ChargingState_Field/notifier
        NewEventGroup45: event-group-id=46, event=ClimateControlState_Field/notifier
        NewEventGroup46: event-group-id=47, event=ContractCertificate1Status_Field/notifier
        NewEventGroup47: event-group-id=48, event=ContractCertificate2Status_Field/notifier
        NewEventGroup48: event-group-id=49, event=ContractCertificate3Status_Field/notifier
        NewEventGroup49: event-group-id=50, event=ContractCertificate4Status_Field/notifier
        NewEventGroup5: event-group-id=6, event=AirconditioningFinishAlarmStatus_Field/notifier
        NewEventGroup50: event-group-id=51, event=ContractCertificate5Status_Field/notifier
        NewEventGroup51: event-group-id=52, event=ContractCertificateCompanyInfo1_Field/notifier
        NewEventGroup52: event-group-id=53, event=ContractCertificateCompanyInfo2_Field/notifier
        NewEventGroup53: event-group-id=54, event=ContractCertificateCompanyInfo3_Field/notifier
        NewEventGroup54: event-group-id=55, event=ContractCertificateCompanyInfo4_Field/notifier
        NewEventGroup55: event-group-id=56, event=ContractCertificateCompanyInfo5_Field/notifier
        NewEventGroup56: event-group-id=57, event=ContractCertificateSelectionStatus_Field/notifier
        NewEventGroup57: event-group-id=58, event=ContractCertificateUserInfo1_Field/notifier
        NewEventGroup58: event-group-id=59, event=ContractCertificateUserInfo2_Field/notifier
        NewEventGroup59: event-group-id=60, event=ContractCertificateUserInfo3_1_Field/notifier
        NewEventGroup6: event-group-id=7, event=AutoPowerOff_Field/notifier
        NewEventGroup60: event-group-id=61, event=ContractCertificateUserInfo3_2_Field/notifier
        NewEventGroup61: event-group-id=62, event=ContractCertificateUserInfo4_Field/notifier
        NewEventGroup62: event-group-id=63, event=ContractCertificateUserInfo5_Field/notifier
        NewEventGroup63: event-group-id=64, event=DcChargingStatus_Field/notifier
        NewEventGroup64: event-group-id=65, event=DepartSet1EnableState_Field/notifier
        NewEventGroup65: event-group-id=66, event=DepartSet1_Fri_Field/notifier
        NewEventGroup66: event-group-id=67, event=DepartSet1_Hour_Field/notifier
        NewEventGroup67: event-group-id=68, event=DepartSet1_Min_Field/notifier
        NewEventGroup68: event-group-id=69, event=DepartSet1_Mon_Field/notifier
        NewEventGroup69: event-group-id=70, event=DepartSet1_Sat_Field/notifier
        NewEventGroup7: event-group-id=8, event=AutoShutOffTime_Field/notifier
        NewEventGroup70: event-group-id=71, event=DepartSet1_Sun_Field/notifier
        NewEventGroup71: event-group-id=72, event=DepartSet1_Thu_Field/notifier
        NewEventGroup72: event-group-id=73, event=DepartSet1_Tue_Field/notifier
        NewEventGroup73: event-group-id=74, event=DepartSet1_Wed_Field/notifier
        NewEventGroup74: event-group-id=75, event=DepartSet2EnableState_Field/notifier
        NewEventGroup75: event-group-id=76, event=DepartSet2_Fri_Field/notifier
        NewEventGroup76: event-group-id=77, event=DepartSet2_Hour_Field/notifier
        NewEventGroup77: event-group-id=78, event=DepartSet2_Min_Field/notifier
        NewEventGroup78: event-group-id=79, event=DepartSet2_Mon_Field/notifier
        NewEventGroup79: event-group-id=80, event=DepartSet2_Sat_Field/notifier
        NewEventGroup8: event-group-id=9, event=AuxiliaryBattChargeInhibitCauseType_Field/notifier
        NewEventGroup80: event-group-id=81, event=DepartSet2_Sun_Field/notifier
        NewEventGroup81: event-group-id=82, event=DepartSet2_Thu_Field/notifier
        NewEventGroup82: event-group-id=83, event=DepartSet2_Tue_Field/notifier
        NewEventGroup83: event-group-id=84, event=DepartSet2_Wed_Field/notifier
        NewEventGroup84: event-group-id=85, event=DisplayOperationFlag_Field/notifier
        NewEventGroup85: event-group-id=86, event=DomesticChargeRemainedTime_Field/notifier
        NewEventGroup86: event-group-id=87, event=DteBaseValue_Field/notifier
        NewEventGroup87: event-group-id=88, event=DteOffDisplayState_Field/notifier
        NewEventGroup88: event-group-id=89, event=DteOffDisplayState_HCU_Field/notifier
        NewEventGroup89: event-group-id=90, event=DteV2LValue_Field/notifier
        NewEventGroup9: event-group-id=10, event=AvailableEnergyValue_Field/notifier
        NewEventGroup90: event-group-id=91, event=EVBatteryConditioningState_Field/notifier
        NewEventGroup91: event-group-id=92, event=EVModeDTEKmValue_Field/notifier
        NewEventGroup92: event-group-id=93, event=EVModeDTEMileValue_Field/notifier
        NewEventGroup93: event-group-id=94, event=ElectricDrivingReadyState_Field/notifier
        NewEventGroup94: event-group-id=95, event=ElectricSupplyStandReadyState_Field/notifier
        NewEventGroup95: event-group-id=96, event=EnergyCapacityValue_Field/notifier
        NewEventGroup96: event-group-id=97, event=EstimatedRamainTime_Field/notifier
        NewEventGroup97: event-group-id=98, event=EuroChargeRemainedTime_Field/notifier
        NewEventGroup98: event-group-id=99, event=EvseReadyStatus_Field/notifier
        NewEventGroup99: event-group-id=100, event=ExpiredMonth1ofCertificate_Field/notifier
