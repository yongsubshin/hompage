[part 8 of 9: packages /System/Service/Deployment to /System/Service/Endpoint]
AUTOSAR XML (schema 00049)
package /System/Service/Deployment  (continued)
  114 x someip service interface deployment:  (continued)
    ProvisioningTable_Someip: service-interface=Service/ProvisioningTable, service-interface-id=7361, service-interface-version={major-version=2, minor-version=1}
      5 x someip field deployment:
        CallCenterNumber_Field: field=ProvisioningTable/CallCenterNumber
          get getter: maximum-segment-length-request=0, maximum-segment-length-response=0, method-id=8195, transport-protocol=TCP
          notifier notifier: event-id=8195, maximum-segment-length=0, transport-protocol=TCP
        PrivacyOfflineMode_Field: field=ProvisioningTable/PrivacyOfflineMode
          get getter: maximum-segment-length-request=0, maximum-segment-length-response=0, method-id=8197, transport-protocol=TCP
          notifier notifier: event-id=8197, maximum-segment-length=0, transport-protocol=TCP
        ProvisioningStatus_Field: field=ProvisioningTable/ProvisioningStatus
          get getter: maximum-segment-length-request=0, maximum-segment-length-response=0, method-id=8193, transport-protocol=TCP
          notifier notifier: event-id=8193, maximum-segment-length=0, transport-protocol=TCP
        SMSCenterNumber_Field: field=ProvisioningTable/SMSCenterNumber
          get getter: maximum-segment-length-request=0, maximum-segment-length-response=0, method-id=8196, transport-protocol=TCP
          notifier notifier: event-id=8196, maximum-segment-length=0, transport-protocol=TCP
        TimeStamp_Field: field=ProvisioningTable/TimeStamp
          get getter: maximum-segment-length-request=0, maximum-segment-length-response=0, method-id=8194, transport-protocol=TCP
          notifier notifier: event-id=8194, maximum-segment-length=0, transport-protocol=TCP
      someip event group SomeIpEventGroups: event-group-id=4097, event=[CallCenterNumber_Field/notifier, PrivacyOfflineMode_Field/notifier, ProvisioningStatus_Field/notifier, SMSCenterNumber_Field/notifier, TimeStamp_Field/notifier]
    ProvisioningTable_Someip: service-interface=Service/ProvisioningTable, service-interface-id=5443, service-interface-version={major-version=3, minor-version=3}
      12 x someip field deployment:
        CCSBrandName_Field: field=CCSBrandName
          get getter: maximum-segment-length-request=0, maximum-segment-length-response=0, method-id=8204, transport-protocol=TCP
          notifier notifier: event-id=8204, maximum-segment-length=0, transport-protocol=TCP
        CallCenterNumber_Field: field=ProvisioningTable/CallCenterNumber
          get getter: maximum-segment-length-request=0, maximum-segment-length-response=0, method-id=8196, transport-protocol=TCP
          notifier notifier: event-id=8196, maximum-segment-length=0, transport-protocol=TCP
        DataPlanProducts_Field: field=DataPlanProducts
          get getter: maximum-segment-length-request=0, maximum-segment-length-response=0, method-id=8203, transport-protocol=TCP
          notifier notifier: event-id=8203, maximum-segment-length=0, transport-protocol=TCP
        EnvironmentsAddress_Field: field=ProvisioningTable/EnvironmentsAddress
          get getter: maximum-segment-length-request=0, maximum-segment-length-response=0, method-id=8201, transport-protocol=TCP
          notifier notifier: event-id=8201, maximum-segment-length=0, transport-protocol=TCP
        Environments_Field: field=ProvisioningTable/Environments
          get getter: maximum-segment-length-request=0, maximum-segment-length-response=0, method-id=8200, transport-protocol=TCP
          notifier notifier: event-id=8200, maximum-segment-length=0, transport-protocol=TCP
        OptionInfo_Field: field=OptionInfo
          get getter: maximum-segment-length-request=0, maximum-segment-length-response=0, method-id=8202, transport-protocol=TCP
          notifier notifier: event-id=8202, maximum-segment-length=0, transport-protocol=TCP
        PrivacyOfflineMode_Field: field=ProvisioningTable/PrivacyOfflineMode
          get getter: maximum-segment-length-request=0, maximum-segment-length-response=0, method-id=8193, transport-protocol=TCP
          notifier notifier: event-id=8193, maximum-segment-length=0, transport-protocol=TCP
        ProvisioningItems_Field: field=ProvisioningItems
          get getter: maximum-segment-length-request=0, maximum-segment-length-response=0, method-id=8195, transport-protocol=TCP
          notifier notifier: event-id=8195, maximum-segment-length=0, transport-protocol=TCP
        ProvisioningStatus_Field: field=ProvisioningTable/ProvisioningStatus
          get getter: maximum-segment-length-request=0, maximum-segment-length-response=0, method-id=8194, transport-protocol=TCP
          notifier notifier: event-id=8194, maximum-segment-length=0, transport-protocol=TCP
        SMSCenterNumber_Field: field=ProvisioningTable/SMSCenterNumber
          get getter: maximum-segment-length-request=0, maximum-segment-length-response=0, method-id=8197, transport-protocol=TCP
          notifier notifier: event-id=8197, maximum-segment-length=0, transport-protocol=TCP
        TimeStamp_Field: field=ProvisioningTable/TimeStamp
          get getter: maximum-segment-length-request=0, maximum-segment-length-response=0, method-id=8198, transport-protocol=TCP
          notifier notifier: event-id=8198, maximum-segment-length=0, transport-protocol=TCP
        VoLTEMode_Field: field=ProvisioningTable/VoLTEMode
          get getter: maximum-segment-length-request=0, maximum-segment-length-response=0, method-id=8199, transport-protocol=TCP
          notifier notifier: event-id=8199, maximum-segment-length=0, transport-protocol=TCP
      someip method deployment GetAllProvisioningTable_Method: method=GetAllProvisioningTable, maximum-segment-length-response=0, method-id=4097, transport-protocol=TCP
      someip method deployment SetOptionInfo_Method: method=SetOptionInfo, maximum-segment-length-request=0, maximum-segment-length-response=0, method-id=4098, transport-protocol=TCP
      someip event group SomeIpEventGroups: event-group-id=8193, event=[CCSBrandName_Field/notifier, CallCenterNumber_Field/notifier, DataPlanProducts_Field/notifier, EnvironmentsAddress_Field/notifier, Environments_Field/notifier, OptionInfo_Field/notifier, PrivacyOfflineMode_Field/notifier, ProvisioningItems_Field/notifier, ProvisioningStatus_Field/notifier, SMSCenterNumber_Field/notifier, TimeStamp_Field/notifier, VoLTEMode_Field/notifier]
    Provisioning_Someip: service-interface=Provisioning, service-interface-id=3109, service-interface-version={major-version=1, minor-version=1}
      someip event deployment ProvisioningTableChanged_Event: event=ProvisioningTableChanged, event-id=4098, maximum-segment-length=0, transport-protocol=UDP
      someip event deployment UpdateToken_Event: event=UpdateToken, event-id=4097, maximum-segment-length=0, transport-protocol=UDP
      5 x someip field deployment:
        InfrastructureEnvironments_Field: field=InfrastructureEnvironments
          get getter: maximum-segment-length-request=0, maximum-segment-length-response=0, method-id=8195, transport-protocol=UDP
          notifier notifier: event-id=8195, maximum-segment-length=0, transport-protocol=UDP
        NADID_Field: field=NADID
          get getter: maximum-segment-length-request=0, maximum-segment-length-response=0, method-id=8197, transport-protocol=UDP
          notifier notifier: event-id=8197, maximum-segment-length=0, transport-protocol=UDP
        ProvisioningContext_Field: field=ProvisioningContext
          get getter: maximum-segment-length-request=0, maximum-segment-length-response=0, method-id=8194, transport-protocol=UDP
          notifier notifier: event-id=8194, maximum-segment-length=0, transport-protocol=UDP
        ProvisioningStatus_Field: field=Provisioning/ProvisioningStatus
          get getter: maximum-segment-length-request=0, maximum-segment-length-response=0, method-id=8193, transport-protocol=UDP
          notifier notifier: event-id=8193, maximum-segment-length=0, transport-protocol=UDP
        TeleVIN_Field: field=TeleVIN
          get getter: maximum-segment-length-request=0, maximum-segment-length-response=0, method-id=8198, transport-protocol=UDP
          notifier notifier: event-id=8198, maximum-segment-length=0, transport-protocol=UDP
      7 x someip method deployment, all with maximum-segment-length-response=0, transport-protocol=UDP:
        GetAccessToken_Method: method=GetAccessToken, maximum-segment-length-request=0, method-id=4102
        GetIsSHA256KeyGen_Method: method=GetIsSHA256KeyGen, method-id=4103
        GetMOFEntryByTableAndKey_Method: method=GetMOFEntryByTableAndKey, maximum-segment-length-request=0, method-id=4097
        GetMOFHostByKey_Method: method=GetMOFHostByKey, maximum-segment-length-request=0, method-id=4098
        GetMOFKeyListByTable_Method: method=GetMOFKeyListByTable, maximum-segment-length-request=0, method-id=4099
        GetMOFTableList_Method: method=GetMOFTableList, method-id=4100
        GetSVCHUBHostByKey_Method: method=GetSVCHUBHostByKey, method-id=4101
      7 x someip event group:
        NewEventGroup: event-group-id=1, event=InfrastructureEnvironments_Field/notifier
        NewEventGroup1: event-group-id=2, event=NADID_Field/notifier
        NewEventGroup2: event-group-id=3, event=ProvisioningContext_Field/notifier
        NewEventGroup3: event-group-id=4, event=ProvisioningStatus_Field/notifier
        NewEventGroup4: event-group-id=5, event=ProvisioningTableChanged_Event
        NewEventGroup5: event-group-id=6, event=UpdateToken_Event
        NewEventGroup6: event-group-id=7, event=TeleVIN_Field/notifier
    RFSManager_Someip: service-interface=RFSManager, service-interface-id=47, service-interface-version={major-version=1, minor-version=2}
      someip field deployment ExtractArchiveResult_Field: field=ExtractArchiveResult
        get getter: maximum-segment-length-request=0, maximum-segment-length-response=0, method-id=8193, transport-protocol=UDP
        notifier notifier: event-id=8193, maximum-segment-length=0, transport-protocol=UDP
      someip field deployment ServerState_Field: field=ServerState
        get getter: maximum-segment-length-request=0, maximum-segment-length-response=0, method-id=8194, transport-protocol=UDP
        notifier notifier: event-id=8194, maximum-segment-length=0, transport-protocol=UDP
      4 x someip method deployment, all with maximum-segment-length-response=0, transport-protocol=UDP:
        ClearResources_Method: method=ClearResources, maximum-segment-length-request=0, method-id=4098
        ExtractArchive_Method: method=ExtractArchive, maximum-segment-length-request=0, method-id=4097
        GetAvailableSpace_Method: method=GetAvailableSpace, method-id=4100
        SyncFile_Method: method=SyncFile, maximum-segment-length-request=0, method-id=4099
      someip event group SomeIpEventGroups: event-group-id=1, event=[ExtractArchiveResult_Field/notifier, ServerState_Field/notifier]
    RemoteFileSystemManager_Someip: service-interface=RemoteFileSystemManager, service-interface-id=3142, service-interface-version={major-version=1, minor-version=0}
      someip field deployment requestedEcuList_Field: field=requestedEcuList
        get getter: maximum-segment-length-request=0, maximum-segment-length-response=0, method-id=8193, transport-protocol=UDP
        notifier notifier: event-id=8193, maximum-segment-length=0, transport-protocol=UDP
      someip method deployment RemoteMount_Method: method=RemoteMount, maximum-segment-length-request=0, maximum-segment-length-response=0, method-id=4097, transport-protocol=UDP
      someip method deployment RemoteUnmount_Method: method=RemoteUnmount, maximum-segment-length-request=0, maximum-segment-length-response=0, method-id=4098, transport-protocol=UDP
      someip method deployment VerifyAccessibility_Method: method=VerifyAccessibility, maximum-segment-length-request=0, maximum-segment-length-response=0, method-id=4099, transport-protocol=UDP
      someip event group NewEventGroup: event-group-id=1, event=requestedEcuList_Field/notifier
    ReportSender_Someip: service-interface=Service/ReportSender, service-interface-id=3082, service-interface-version={major-version=1, minor-version=0}
      someip method deployment SendEidsReport_Method: method=SendEidsReport, maximum-segment-length-response=0, method-id=4097, transport-protocol=UDP
    ReportSender_Someip: service-interface=Service/ReportSender, service-interface-id=3078, service-interface-version={major-version=1, minor-version=0}
      someip method deployment SendCidsReport_Method: method=SendCidsReport, maximum-segment-length-response=0, method-id=4097, transport-protocol=UDP
    Routines_Someip: service-interface=Routines, service-interface-id=67, service-interface-version={major-version=3, minor-version=0}
      someip event deployment NeedToAgree_Event: event=NeedToAgree, event-id=4098, maximum-segment-length=0, transport-protocol=UDP
      someip event deployment RequestAction_Event: event=RequestAction, event-id=4097, maximum-segment-length=0, transport-protocol=TCP
      someip field deployment RoutineStatus_Field: field=RoutineStatus
        get getter: maximum-segment-length-request=0, maximum-segment-length-response=0, method-id=8193, transport-protocol=UDP
        notifier notifier: event-id=8193, maximum-segment-length=0, transport-protocol=UDP
      9 x someip method deployment, all with maximum-segment-length-request=0, maximum-segment-length-response=0:
        ActivateRoutine_Method: method=ActivateRoutine, method-id=4103, transport-protocol=UDP
        DeleteRoutine_Method: method=DeleteRoutine, method-id=4105, transport-protocol=UDP
        GetRoutine_Method: method=GetRoutine, method-id=4098, transport-protocol=TCP
        SetAgreeResult_Method: method=SetAgreeResult, method-id=4102, transport-protocol=UDP
        SetInfoConditionStatus_Method: method=SetInfoConditionStatus, method-id=4101, transport-protocol=TCP
        SetRoutine_Method: method=SetRoutine, method-id=4097, transport-protocol=TCP
        StartRoutine_Method: method=StartRoutine, method-id=4099, transport-protocol=UDP
        StopRoutine_Method: method=StopRoutine, method-id=4100, transport-protocol=UDP
        UpdateRoutine_Method: method=UpdateRoutine, method-id=4104, transport-protocol=TCP
      someip event group SomeIpEventGroups: event-group-id=1, event=[NeedToAgree_Event, RequestAction_Event, RoutineStatus_Field/notifier]
    RoutingDiag_Someip: service-interface=RoutingDiag, service-interface-id=3079, service-interface-version={major-version=1, minor-version=1}
      someip event deployment DiagResponseUpdated_Event: event=DiagResponseUpdated, event-id=4097, maximum-segment-length=0, transport-protocol=UDP
      someip field deployment ActiveDiagHandles_Field: field=ActiveDiagHandles
        get getter: maximum-segment-length-request=0, maximum-segment-length-response=0, method-id=8193, transport-protocol=UDP
        notifier notifier: event-id=8193, maximum-segment-length=0, transport-protocol=UDP
      9 x someip method deployment, all with maximum-segment-length-request=0, maximum-segment-length-response=0, transport-protocol=UDP:
        AcquireDiagHandle_Method: method=AcquireDiagHandle, method-id=4102
        AcquireDiagPrivilege_Method: method=AcquireDiagPrivilege, method-id=4103
        BroadcastDiag_Method: method=BroadcastDiag, method-id=4106
        MultiDiagPrivilege_Method: method=MultiDiagPrivilege, method-id=4109
        ReleaseDiagHandle_Method: method=ReleaseDiagHandle, method-id=4104
        ReleaseDiagPrivilege_Method: method=ReleaseDiagPrivilege, method-id=4099
        RequestDiag_Method: method=RequestDiag, method-id=4101
        SetFileOrDirInfo_Method: method=SetFileOrDirInfo, method-id=4108
        SetSWPackageFilePath_Method: method=SetSWPackageFilePath, method-id=4107
      someip event group NewEventGroup: event-group-id=1, event=ActiveDiagHandles_Field/notifier
      someip event group NewEventGroup1: event-group-id=2, event=DiagResponseUpdated_Event
    RoutingIPC_Someip: service-interface=RoutingIPC, service-interface-id=3085, service-interface-version={major-version=3, minor-version=0}
      6 x someip event deployment, all with maximum-segment-length=0, transport-protocol=UDP:
        EventMcuLogData_Event: event=EventMcuLogData, event-id=4099
        EventNSDResetData_Event: event=EventNSDResetData, event-id=4100
        EventNonSleepEcuIdx_Event: event=EventNonSleepEcuIdx, event-id=4098
        EventPbsFirstWk_Event: event=EventPbsFirstWk, event-id=4101
        PeriodicSystemInfoAdditional_Event: event=PeriodicSystemInfoAdditional, event-id=4102
        PeriodicSystemInfo_Event: event=PeriodicSystemInfo, event-id=4097
      someip field deployment EventSystemInfoAdditional_Field: field=EventSystemInfoAdditional
        get getter: maximum-segment-length-request=0, maximum-segment-length-response=0, method-id=8195, transport-protocol=UDP
        notifier notifier: event-id=8194, maximum-segment-length=0, transport-protocol=UDP
      someip field deployment EventSystemInfo_Field: field=EventSystemInfo
        get getter: maximum-segment-length-request=0, maximum-segment-length-response=0, method-id=8193, transport-protocol=UDP
        notifier notifier: event-id=8193, maximum-segment-length=0, transport-protocol=UDP
      someip field deployment TwaitBusSleepTime_Field: field=TwaitBusSleepTime
        get getter: maximum-segment-length-request=0, maximum-segment-length-response=0, method-id=8194, transport-protocol=UDP
        set setter: maximum-segment-length-request=0, maximum-segment-length-response=0, method-id=12289, transport-protocol=UDP
      24 x someip method deployment, all with transport-protocol=UDP:
        ASMInfoRequest_Method: method=ASMInfoRequest, maximum-segment-length-request=0, method-id=4097
        GetOneTimeSystemInfoAdditional_Method: method=GetOneTimeSystemInfoAdditional, maximum-segment-length-response=0, method-id=4118
        GetOneTimeSystemInfo_Method: method=GetOneTimeSystemInfo, maximum-segment-length-response=0, method-id=4098
        GetRdbCheckValue_Method: method=GetRdbCheckValue, maximum-segment-length-response=0, method-id=4109
        GetRtcWakeupTimer_Method: method=RoutingIPC/GetRtcWakeupTimer, maximum-segment-length-request=0, maximum-segment-length-response=0, method-id=4115
        GetSelfNmlData_Method: method=GetSelfNmlData, maximum-segment-length-response=0, method-id=4113
        OutputControlRequest_Method: method=OutputControlRequest, maximum-segment-length-request=0, method-id=4099
        RestorePnInfoMcu_Method: method=RestorePnInfoMcu, maximum-segment-length-request=0, method-id=4108
        SetAPSystemInfo_Method: method=SetAPSystemInfo, maximum-segment-length-request=0, method-id=4100
        SetApEthNetworkInfo_Method: method=SetApEthNetworkInfo, maximum-segment-length-request=0, method-id=4107
        SetDcuSystemTime_Method: method=SetDcuSystemTime, maximum-segment-length-request=0, method-id=4106
        SetInfoSystemTime_Method: method=SetInfoSystemTime, maximum-segment-length-request=0, method-id=4105
        SetNsdEventInfo_Method: method=SetNsdEventInfo, maximum-segment-length-request=0, method-id=4112
        SetOTAInfo_Method: method=SetOTAInfo, maximum-segment-length-request=0, method-id=4101
        SetOneTimeSystemInfoAdditional_Method: method=SetOneTimeSystemInfoAdditional, maximum-segment-length-request=0, method-id=4119
        SetOneTimeSystemInfo_Method: method=SetOneTimeSystemInfo, maximum-segment-length-request=0, method-id=4104
        SetPartialNetworkInfo_Method: method=SetPartialNetworkInfo, maximum-segment-length-request=0, method-id=4102
        SetRtcWakeupTimer_Method: method=RoutingIPC/SetRtcWakeupTimer, maximum-segment-length-request=0, maximum-segment-length-response=0, method-id=4114
        SetTempMonitorInfo_Method: method=SetTempMonitorInfo, maximum-segment-length-request=0, method-id=4117
        StopRtcWakeupTimer_Method: method=RoutingIPC/StopRtcWakeupTimer, maximum-segment-length-response=0, method-id=4116
        SystemControlResponse_Method: method=SystemControlResponse, maximum-segment-length-request=0, method-id=4103
        TriggerApHeartbeat_Method: method=TriggerApHeartbeat, maximum-segment-length-request=0, method-id=4111
        TriggerSelfUpdateHeartbeat_Method: method=RoutingIPC/TriggerSelfUpdateHeartbeat, maximum-segment-length-request=0, method-id=4110
        Update_IVP_Info_Method: method=Update_IVP_Info, maximum-segment-length-request=0, maximum-segment-length-response=0, method-id=4120
      8 x someip event group:
        NewEventGroup: event-group-id=1, event=EventMcuLogData_Event
        NewEventGroup1: event-group-id=2, event=EventNSDResetData_Event
        NewEventGroup2: event-group-id=3, event=EventNonSleepEcuIdx_Event
        NewEventGroup3: event-group-id=4, event=EventSystemInfo_Field/notifier
        NewEventGroup4: event-group-id=5, event=PeriodicSystemInfo_Event
        NewEventGroup5: event-group-id=6, event=EventPbsFirstWk_Event
        NewEventGroup6: event-group-id=7, event=PeriodicSystemInfoAdditional_Event
        NewEventGroup7: event-group-id=8, event=EventSystemInfoAdditional_Field/notifier
    RoutingTP_Someip: service-interface=RoutingTP, service-interface-id=3124, service-interface-version={major-version=1, minor-version=0}
      someip event deployment TP_IAU_CCU_Event: event=TP_IAU_CCU, event-id=4097, maximum-segment-length=0, transport-protocol=UDP
      someip method deployment TP_CCU_IAU_Method: method=TP_CCU_IAU, maximum-segment-length-request=0, maximum-segment-length-response=0, method-id=4097, transport-protocol=UDP
      someip event group NewEventGroup: event-group-id=1, event=TP_IAU_CCU_Event
    S2S_Someip: service-interface=S2S, service-interface-id=7425, service-interface-version={major-version=3, minor-version=9}
      8 x someip event deployment, all with transport-protocol=UDP:
        SendBatCellInfo_Event: event=SendBatCellInfo, event-id=4101, maximum-segment-length=1
        SendBatWarnData_Event: event=SendBatWarnData, event-id=4103, maximum-segment-length=0
        SendCommonData_Event: event=SendCommonData, event-id=4097, maximum-segment-length=0
        SendECallData_Event: event=SendECallData, event-id=4099, maximum-segment-length=0
        SendECallData_RealTime_Event: event=SendECallData_RealTime, event-id=4098, maximum-segment-length=0
        SendFCData_Event: event=SendFCData, event-id=4104, maximum-segment-length=0
        SendIdcCurrentData_Event: event=SendIdcCurrentData, event-id=4102, maximum-segment-length=0
        SendNemsData_Event: event=SendNemsData, event-id=4100, maximum-segment-length=0
      6 x someip method deployment, all with transport-protocol=UDP:
        GetACNSignallist_Method: method=GetACNSignallist, maximum-segment-length-response=0, method-id=4099
        GetBattNumInfo_Method: method=GetBattNumInfo, maximum-segment-length-response=0, method-id=4100
        GetEngineStatusInfo_Method: method=GetEngineStatusInfo, maximum-segment-length-response=0, method-id=4102
        GetPropulsionStorage_HEV_Method: method=GetPropulsionStorage_HEV, maximum-segment-length-response=0, method-id=4101
        GetPropulsionStorage_Method: method=GetPropulsionStorage, maximum-segment-length-response=0, method-id=4098
        SetVehicleSignal_Method: method=SetVehicleSignal, maximum-segment-length-request=0, method-id=4097
      someip event group SomeIpEventGroups: event-group-id=4097, event=[SendBatCellInfo_Event, SendBatWarnData_Event, SendCommonData_Event, SendECallData_Event, SendECallData_RealTime_Event, SendFCData_Event, SendIdcCurrentData_Event, SendNemsData_Event]
    SafeStatusManagement_Someip: service-interface=SafeStatusManagement, service-interface-id=3126, service-interface-version={major-version=1, minor-version=0}
      someip method deployment CheckSafetyStatus_Method: method=CheckSafetyStatus, maximum-segment-length-request=0, maximum-segment-length-response=0, method-id=4097, transport-protocol=UDP
    Screen_Someip: service-interface=Service/Screen, service-interface-id=4, service-interface-version={major-version=1, minor-version=4}
      6 x someip field deployment:
        FoDExecutionProgress_Field: field=FoDExecutionProgress
          get getter: maximum-segment-length-request=0, maximum-segment-length-response=0, method-id=8198, transport-protocol=UDP
          notifier notifier: event-id=8198, maximum-segment-length=0, transport-protocol=UDP
        FoDMenu_Field: field=FoDMenu
          get getter: maximum-segment-length-request=0, maximum-segment-length-response=0, method-id=8195, transport-protocol=TCP
          notifier notifier: event-id=8195, maximum-segment-length=0, transport-protocol=TCP
        FoDPackage_Field: field=FoDPackage
          get getter: maximum-segment-length-request=0, maximum-segment-length-response=0, method-id=8194, transport-protocol=TCP
          notifier notifier: event-id=8194, maximum-segment-length=0, transport-protocol=TCP
        FoDUIReadyRequest_Field: field=FoDUIReadyRequest
          get getter: maximum-segment-length-request=0, maximum-segment-length-response=0, method-id=8197, transport-protocol=UDP
          notifier notifier: event-id=8197, maximum-segment-length=0, transport-protocol=UDP
        IndexID_Field: field=Screen/IndexID
          get getter: maximum-segment-length-request=0, maximum-segment-length-response=0, method-id=8193, transport-protocol=TCP
          notifier notifier: event-id=8193, maximum-segment-length=0, transport-protocol=TCP
        UnrecognizedRejectReason_Field: field=Screen/UnrecognizedRejectReason
          get getter: maximum-segment-length-request=0, maximum-segment-length-response=0, method-id=8196, transport-protocol=UDP
          notifier notifier: event-id=8196, maximum-segment-length=0, transport-protocol=UDP
          set setter: maximum-segment-length-request=0, maximum-segment-length-response=0, method-id=12289, transport-protocol=UDP
      someip method deployment SetFoDPackage_Method: method=SetFoDPackage, maximum-segment-length-request=0, maximum-segment-length-response=0, method-id=4098, transport-protocol=TCP
      someip method deployment SetIndexID_Method: method=SetIndexID, maximum-segment-length-request=0, maximum-segment-length-response=0, method-id=4097, transport-protocol=TCP
      someip method deployment SetUnrecognizedRejectReason_Method: method=SetUnrecognizedRejectReason, maximum-segment-length-request=0, maximum-segment-length-response=0, method-id=4099, transport-protocol=UDP
      someip event group SomeIpEventGroups: event-group-id=4097, event=[FoDExecutionProgress_Field/notifier, FoDMenu_Field/notifier, FoDPackage_Field/notifier, FoDUIReadyRequest_Field/notifier, IndexID_Field/notifier, UnrecognizedRejectReason_Field/notifier]
    Screen_Someip: service-interface=Service/Screen, service-interface-id=7489, service-interface-version={major-version=1, minor-version=4}
      8 x someip field deployment:
        AVNVersion_Field: field=AVNVersion
          get getter: maximum-segment-length-request=0, maximum-segment-length-response=0, method-id=8197, transport-protocol=UDP
          notifier notifier: event-id=8197, maximum-segment-length=0, transport-protocol=UDP
        CCUVersion_Field: field=CCUVersion
          get getter: maximum-segment-length-request=0, maximum-segment-length-response=0, method-id=8196, transport-protocol=UDP
          notifier notifier: event-id=8196, maximum-segment-length=0, transport-protocol=UDP
        IndexID_Field: field=Screen/IndexID
          get getter: maximum-segment-length-request=0, maximum-segment-length-response=0, method-id=8193, transport-protocol=UDP
          notifier notifier: event-id=8193, maximum-segment-length=0, transport-protocol=UDP
        InitialControllerCheckStatus_Field: field=InitialControllerCheckStatus
          get getter: maximum-segment-length-request=0, maximum-segment-length-response=0, method-id=8198, transport-protocol=UDP
          notifier notifier: event-id=8198, maximum-segment-length=0, transport-protocol=UDP
        OTAResource_Field: field=OTAResource
          get getter: maximum-segment-length-request=0, maximum-segment-length-response=0, method-id=8195, transport-protocol=UDP
          notifier notifier: event-id=8195, maximum-segment-length=0, transport-protocol=UDP
        OTAStatus_Field: field=OTAStatus
          get getter: maximum-segment-length-request=0, maximum-segment-length-response=0, method-id=8194, transport-protocol=UDP
          notifier notifier: event-id=8194, maximum-segment-length=0, transport-protocol=UDP
        UnrecognizedRejectReason_Field: field=Screen/UnrecognizedRejectReason
          get getter: maximum-segment-length-request=0, maximum-segment-length-response=0, method-id=8200, transport-protocol=UDP
          notifier notifier: event-id=8200, maximum-segment-length=0, transport-protocol=UDP
          set setter: maximum-segment-length-request=0, maximum-segment-length-response=0, method-id=12289, transport-protocol=UDP
        UpdateCheckResult_Field: field=UpdateCheckResult
          get getter: maximum-segment-length-request=0, maximum-segment-length-response=0, method-id=8199, transport-protocol=UDP
          notifier notifier: event-id=8199, maximum-segment-length=0, transport-protocol=UDP
      someip method deployment RequestUpdateCheck_Method: method=RequestUpdateCheck, maximum-segment-length-response=0, method-id=4098, transport-protocol=UDP
      someip method deployment SetAVNVersion_Method: method=SetAVNVersion, maximum-segment-length-request=0, maximum-segment-length-response=0, method-id=4097, transport-protocol=UDP
      someip event group SomeIpEventGroups: event-group-id=4097, event=[AVNVersion_Field/notifier, CCUVersion_Field/notifier, IndexID_Field/notifier, InitialControllerCheckStatus_Field/notifier, OTAResource_Field/notifier, OTAStatus_Field/notifier, UnrecognizedRejectReason_Field/notifier, UpdateCheckResult_Field/notifier]
    SecureFlash2_Someip: service-interface=SecureFlash2, service-interface-id=3128, service-interface-version={major-version=1, minor-version=0}
      11 x someip method deployment, all with transport-protocol=UDP:
        Decrypt_Buf_Method: method=Decrypt_Buf, maximum-segment-length-request=0, maximum-segment-length-response=0, method-id=4100
        Decrypt_File_Method: method=Decrypt_File, maximum-segment-length-request=0, maximum-segment-length-response=0, method-id=4101
        FinishDecrypt_Method: method=FinishDecrypt, maximum-segment-length-request=0, maximum-segment-length-response=0, method-id=4102
        FinishVerify_Method: method=FinishVerify, maximum-segment-length-request=0, maximum-segment-length-response=0, method-id=4106
        SF20Version_Method: method=SF20Version, maximum-segment-length-response=0, method-id=4107
        StartDecrypt_Method: method=StartDecrypt, maximum-segment-length-request=0, maximum-segment-length-response=0, method-id=4099
        StartTeeSession_Method: method=StartTeeSession, maximum-segment-length-response=0, method-id=4097
        TerminateTeeSession_Method: method=TerminateTeeSession, maximum-segment-length-request=0, method-id=4098
        VerifyStart_Method: method=VerifyStart, maximum-segment-length-request=0, maximum-segment-length-response=0, method-id=4103
        VerifyUpdate_File_Method: method=VerifyUpdate_File, maximum-segment-length-request=0, maximum-segment-length-response=0, method-id=4105
        VerifyUpdate_Method: method=SecureFlash2/VerifyUpdate, maximum-segment-length-request=0, maximum-segment-length-response=0, method-id=4104
    SelfDiagnosis_Someip: service-interface=SelfDiagnosis, service-interface-id=3121, service-interface-version={major-version=1, minor-version=3}
      5 x someip field deployment:
        CureentSDSAuthenticationLevel_Field: field=SelfDiagnosis/CureentSDSAuthenticationLevel
          get getter: maximum-segment-length-request=0, maximum-segment-length-response=0, method-id=8197, transport-protocol=UDP
          notifier notifier: event-id=8197, maximum-segment-length=0, transport-protocol=UDP
        CurrentAuthenticationLevel_Field: field=SelfDiagnosis/CurrentAuthenticationLevel
          get getter: maximum-segment-length-request=0, maximum-segment-length-response=0, method-id=8196, transport-protocol=UDP
          notifier notifier: event-id=8196, maximum-segment-length=0, transport-protocol=UDP
        CurrentCommunicationMode_Field: field=CurrentCommunicationMode
          get getter: maximum-segment-length-request=0, maximum-segment-length-response=0, method-id=8195, transport-protocol=UDP
          notifier notifier: event-id=8195, maximum-segment-length=0, transport-protocol=UDP
        CurrentDiagSession_Field: field=SelfDiagnosis/CurrentDiagSession
          get getter: maximum-segment-length-request=0, maximum-segment-length-response=0, method-id=8193, transport-protocol=UDP
          notifier notifier: event-id=8193, maximum-segment-length=0, transport-protocol=UDP
        CurrentSecurityLevel_Field: field=SelfDiagnosis/CurrentSecurityLevel
          get getter: maximum-segment-length-request=0, maximum-segment-length-response=0, method-id=8194, transport-protocol=UDP
          notifier notifier: event-id=8194, maximum-segment-length=0, transport-protocol=UDP
      someip method deployment ExtendTestPresent_Method: method=ExtendTestPresent, maximum-segment-length-response=0, method-id=4099, transport-protocol=UDP
      someip method deployment SendDiagResponse_Method: method=SendDiagResponse, maximum-segment-length-request=0, method-id=4098, transport-protocol=UDP
      someip method deployment SetDTCStatus_Method: method=SetDTCStatus, maximum-segment-length-request=0, method-id=4097, transport-protocol=UDP
      5 x someip event group:
        NewEventGroup: event-group-id=1, event=CurrentAuthenticationLevel_Field/notifier
        NewEventGroup1: event-group-id=2, event=CurrentCommunicationMode_Field/notifier
        NewEventGroup2: event-group-id=3, event=CurrentDiagSession_Field/notifier
        NewEventGroup3: event-group-id=4, event=CurrentSecurityLevel_Field/notifier
        NewEventGroup5: event-group-id=5, event=CureentSDSAuthenticationLevel_Field/notifier
    ServiceGroup_Someip: service-interface=ServiceGroup, service-interface-id=3116, service-interface-version={major-version=1, minor-version=1}
      someip method deployment RemoveServiceGroupIP_Method: method=RemoveServiceGroupIP, maximum-segment-length-request=0, method-id=4098, transport-protocol=UDP
      someip method deployment RequestServiceGroupIP_Method: method=RequestServiceGroupIP, maximum-segment-length-request=0, maximum-segment-length-response=0, method-id=4097, transport-protocol=UDP
    Share_Someip: service-interface=Service/Share, service-interface-id=3136, service-interface-version={major-version=1, minor-version=0}
      someip event deployment OnShutdown_Event: event=Share/OnShutdown, event-id=4097, maximum-segment-length=0, transport-protocol=UDP
      someip field deployment PolicyApplied_Field: field=Share/PolicyApplied
        get getter: maximum-segment-length-request=0, maximum-segment-length-response=0, method-id=8193, transport-protocol=UDP
        notifier notifier: event-id=8193, maximum-segment-length=0, transport-protocol=UDP
      someip method deployment IsShareAvailable_Method: method=IsShareAvailable, maximum-segment-length-request=0, maximum-segment-length-response=0, method-id=4097, transport-protocol=UDP
      someip event group NewEventGroup: event-group-id=1, event=Share_Someip/OnShutdown_Event
      someip event group NewEventGroup1: event-group-id=2, event=PolicyApplied_Field/notifier
    Share_Someip: service-interface=Service/Share, service-interface-id=28, service-interface-version={major-version=1, minor-version=1}
      someip event deployment OnShutdown_Event: event=Share/OnShutdown, event-id=4097, maximum-segment-length=0, transport-protocol=UDP
      someip field deployment PolicyApplied_Field: field=Share/PolicyApplied
        get getter: maximum-segment-length-request=0, maximum-segment-length-response=0, method-id=8194, transport-protocol=UDP
        notifier notifier: event-id=8194, maximum-segment-length=0, transport-protocol=UDP
      4 x someip method deployment, all with maximum-segment-length-request=0, maximum-segment-length-response=0, transport-protocol=UDP:
        GetPolicyForClient_Method: method=GetPolicyForClient, method-id=4099
        ReportPolicyApplicationStatus_Method: method=ReportPolicyApplicationStatus, method-id=4100
        ReportStatistics_Method: method=ReportStatistics, method-id=4098
        SendClientShutdownStatus_Method: method=SendClientShutdownStatus, method-id=4101
      someip event group SomeIpEventGroups: event-group-id=1, event=[Share_Someip/OnShutdown_Event, PolicyApplied_Field/notifier]
    SimManager_Someip: service-interface=Service/SimManager, service-interface-id=6339, service-interface-version={major-version=2, minor-version=0}
      10 x someip field deployment:
        CardIdentifier_Field: field=CardIdentifier
          get getter: maximum-segment-length-request=0, maximum-segment-length-response=0, method-id=8198, transport-protocol=TCP
          notifier notifier: event-id=8198, maximum-segment-length=0, transport-protocol=TCP
        EID_Field: field=SimManager/EID
          get getter: maximum-segment-length-request=0, maximum-segment-length-response=0, method-id=8202, transport-protocol=TCP
          notifier notifier: event-id=8202, maximum-segment-length=0, transport-protocol=TCP
        MCC_Field: field=SimManager/MCC
          get getter: maximum-segment-length-request=0, maximum-segment-length-response=0, method-id=8196, transport-protocol=TCP
          notifier notifier: event-id=8196, maximum-segment-length=0, transport-protocol=TCP
        MNC_Field: field=SimManager/MNC
          get getter: maximum-segment-length-request=0, maximum-segment-length-response=0, method-id=8197, transport-protocol=TCP
          notifier notifier: event-id=8197, maximum-segment-length=0, transport-protocol=TCP
        MSISDN_Field: field=MSISDN
          get getter: maximum-segment-length-request=0, maximum-segment-length-response=0, method-id=8200, transport-protocol=TCP
          notifier notifier: event-id=8200, maximum-segment-length=0, transport-protocol=TCP
        NetworkOTAStatus_Field: field=NetworkOTAStatus
          get getter: maximum-segment-length-request=0, maximum-segment-length-response=0, method-id=8201, transport-protocol=TCP
          notifier notifier: event-id=8201, maximum-segment-length=0, transport-protocol=TCP
        PhoneNumber_Field: field=SimManager/PhoneNumber
          get getter: maximum-segment-length-request=0, maximum-segment-length-response=0, method-id=8199, transport-protocol=TCP
          notifier notifier: event-id=8199, maximum-segment-length=0, transport-protocol=TCP
        ServiceProviderName_Field: field=ServiceProviderName
          get getter: maximum-segment-length-request=0, maximum-segment-length-response=0, method-id=8195, transport-protocol=TCP
          notifier notifier: event-id=8195, maximum-segment-length=0, transport-protocol=TCP
        Status_Field: field=SimManager/Status
          get getter: maximum-segment-length-request=0, maximum-segment-length-response=0, method-id=8193, transport-protocol=TCP
          notifier notifier: event-id=8193, maximum-segment-length=0, transport-protocol=TCP
        SubscriberIdentity_Field: field=SubscriberIdentity
          get getter: maximum-segment-length-request=0, maximum-segment-length-response=0, method-id=8194, transport-protocol=TCP
          notifier notifier: event-id=8194, maximum-segment-length=0, transport-protocol=TCP
      someip method deployment OpeningDate_Method: method=OpeningDate, maximum-segment-length-response=0, method-id=4097, transport-protocol=TCP
      someip method deployment RequestNetworkOTA_Method: method=RequestNetworkOTA, method-id=4098, transport-protocol=TCP
      someip event group SomeIpEventGroups: event-group-id=8193, event=[CardIdentifier_Field/notifier, EID_Field/notifier, MCC_Field/notifier, MNC_Field/notifier, MSISDN_Field/notifier, NetworkOTAStatus_Field/notifier, PhoneNumber_Field/notifier, ServiceProviderName_Field/notifier, Status_Field/notifier, SubscriberIdentity_Field/notifier]
    SimManager_Someip: service-interface=Service/SimManager, service-interface-id=3090, service-interface-version={major-version=1, minor-version=2}
      6 x someip field deployment:
        EID_Field: field=SimManager/EID
          get getter: maximum-segment-length-request=0, maximum-segment-length-response=0, method-id=8198, transport-protocol=UDP
          notifier notifier: event-id=8198, maximum-segment-length=0, transport-protocol=UDP
        IccID_Field: field=IccID
          get getter: maximum-segment-length-request=0, maximum-segment-length-response=0, method-id=8195, transport-protocol=UDP
          notifier notifier: event-id=8195, maximum-segment-length=0, transport-protocol=UDP
        MCC_Field: field=SimManager/MCC
          get getter: maximum-segment-length-request=0, maximum-segment-length-response=0, method-id=8196, transport-protocol=UDP
          notifier notifier: event-id=8196, maximum-segment-length=0, transport-protocol=UDP
        MNC_Field: field=SimManager/MNC
          get getter: maximum-segment-length-request=0, maximum-segment-length-response=0, method-id=8197, transport-protocol=UDP
          notifier notifier: event-id=8197, maximum-segment-length=0, transport-protocol=UDP
        NetSerProv_Field: field=NetSerProv
          get getter: maximum-segment-length-request=0, maximum-segment-length-response=0, method-id=8193, transport-protocol=UDP
          notifier notifier: event-id=8193, maximum-segment-length=0, transport-protocol=UDP
        PhoneNumber_Field: field=SimManager/PhoneNumber
          get getter: maximum-segment-length-request=0, maximum-segment-length-response=0, method-id=8194, transport-protocol=UDP
          notifier notifier: event-id=8194, maximum-segment-length=0, transport-protocol=UDP
      6 x someip event group:
        NewEventGroup: event-group-id=1, event=IccID_Field/notifier
        NewEventGroup1: event-group-id=2, event=MCC_Field/notifier
        NewEventGroup2: event-group-id=3, event=MNC_Field/notifier
        NewEventGroup3: event-group-id=4, event=NetSerProv_Field/notifier
        NewEventGroup4: event-group-id=5, event=PhoneNumber_Field/notifier
        NewEventGroup5: event-group-id=6, event=EID_Field/notifier
    StateManager_Someip: service-interface=StateManager, service-interface-id=3092, service-interface-version={major-version=1, minor-version=1}
      someip field deployment APState_Field: field=APState
        get getter: maximum-segment-length-request=0, maximum-segment-length-response=0, method-id=8193, transport-protocol=UDP
        notifier notifier: event-id=8193, maximum-segment-length=0, transport-protocol=UDP
      someip field deployment NetRequest_Field: field=NetRequest
        get getter: maximum-segment-length-request=0, maximum-segment-length-response=0, method-id=8194, transport-protocol=UDP
        notifier notifier: event-id=8194, maximum-segment-length=0, transport-protocol=UDP
      someip field deployment SessionStateField_Field: field=SessionStateField
        get getter: maximum-segment-length-request=0, maximum-segment-length-response=0, method-id=8195, transport-protocol=UDP
        notifier notifier: event-id=8195, maximum-segment-length=0, transport-protocol=UDP
      8 x someip method deployment, all with transport-protocol=UDP:
        PMStateInfo_Method: method=PMStateInfo, maximum-segment-length-request=0, method-id=4105
        RegisterShutdownNode_Method: method=RegisterShutdownNode, maximum-segment-length-request=0, maximum-segment-length-response=0, method-id=4098
        SetSessionState_Method: method=SetSessionState, maximum-segment-length-request=0, maximum-segment-length-response=0, method-id=4099
        ShutdownPendingRequest_Method: method=ShutdownPendingRequest, maximum-segment-length-request=0, method-id=4103
        ShutdownRequestComplete_Method: method=ShutdownRequestComplete, maximum-segment-length-request=0, method-id=4100
        SystemControlRequest_Method: method=SystemControlRequest, maximum-segment-length-request=0, method-id=4101
        TriggerSelfUpdateHeartbeat_Method: method=StateManager/TriggerSelfUpdateHeartbeat, maximum-segment-length-request=0, method-id=4104
        VpushReceived_Method: method=VpushReceived, maximum-segment-length-response=0, method-id=4102
      someip event group NewEventGroup: event-group-id=1, event=APState_Field/notifier
      someip event group NewEventGroup1: event-group-id=2, event=NetRequest_Field/notifier
      someip event group NewEventGroup2: event-group-id=3, event=SessionStateField_Field/notifier
    Status_Someip: service-interface=Status, service-interface-id=3135, service-interface-version={major-version=1, minor-version=0}
      12 x someip method deployment, all with maximum-segment-length-response=0, transport-protocol=UDP:
        GetAppliedPolicyStatus_Method: method=GetAppliedPolicyStatus, method-id=4101
        GetClientSystemStatusByDiag_Method: method=GetClientSystemStatusByDiag, maximum-segment-length-request=0, method-id=4104
        GetDownloadedPolicyStatus_Method: method=GetDownloadedPolicyStatus, method-id=4099
        GetGeneralSystemStatusByDiag_Method: method=GetGeneralSystemStatusByDiag, method-id=4103
        GetInstalledPolicyStatus_Method: method=GetInstalledPolicyStatus, method-id=4100
        GetNfsClientStatus_Method: method=GetNfsClientStatus, method-id=4107
        GetNfsTarget_Method: method=GetNfsTarget, method-id=4108
        GetNvmeStatus_Method: method=GetNvmeStatus, method-id=4098
        GetSystemStatus_Method: method=GetSystemStatus, method-id=4097
        ResetClientShareByDiag_Method: method=ResetClientShareByDiag, maximum-segment-length-request=0, method-id=4105
        ResetClientShareStatusByDiag_Method: method=ResetClientShareStatusByDiag, method-id=4106
        ResetToFactoryPolicy_Method: method=ResetToFactoryPolicy, maximum-segment-length-request=0, method-id=4102
    Support_Someip: service-interface=Support, service-interface-id=4054, service-interface-version={major-version=1, minor-version=1}
      someip field deployment FodVin_Field: field=FodVin
        get getter: maximum-segment-length-request=0, maximum-segment-length-response=0, method-id=8193, transport-protocol=UDP
        notifier notifier: event-id=8193, maximum-segment-length=0, transport-protocol=UDP
      someip method deployment SetFodVin_Method: method=SetFodVin, maximum-segment-length-request=0, maximum-segment-length-response=0, method-id=4097, transport-protocol=UDP
      someip event group NewEventGroup: event-group-id=1, event=FodVin_Field/notifier
    SysInfoManager_Someip: service-interface=SysInfoManager, service-interface-id=3074, service-interface-version={major-version=1, minor-version=4}
      someip field deployment DiagRoutingActiveInfo_Field: field=DiagRoutingActiveInfo
        get getter: maximum-segment-length-request=0, maximum-segment-length-response=0, method-id=8194, transport-protocol=UDP
        notifier notifier: event-id=8194, maximum-segment-length=0, transport-protocol=UDP
        set setter: maximum-segment-length-request=0, maximum-segment-length-response=0, method-id=12290, transport-protocol=UDP
      someip field deployment SecureAccessActiveInfo_Field: field=SecureAccessActiveInfo
        get getter: maximum-segment-length-request=0, maximum-segment-length-response=0, method-id=8193, transport-protocol=UDP
        notifier notifier: event-id=8193, maximum-segment-length=0, transport-protocol=UDP
        set setter: maximum-segment-length-request=0, maximum-segment-length-response=0, method-id=12289, transport-protocol=UDP
      7 x someip method deployment, all with transport-protocol=UDP:
        ControlLogLevel_Method: method=ControlLogLevel, maximum-segment-length-request=0, maximum-segment-length-response=0, method-id=4103
        GetBootReasonMCU_Method: method=GetBootReasonMCU, maximum-segment-length-response=0, method-id=4097
        GetNumValue_Method: method=GetNumValue, maximum-segment-length-request=0, maximum-segment-length-response=0, method-id=4098
        GetStringValue_Method: method=GetStringValue, maximum-segment-length-request=0, maximum-segment-length-response=0, method-id=4099
        SetNumValue_Method: method=SetNumValue, maximum-segment-length-request=0, method-id=4100
        SetStringValue_Method: method=SetStringValue, maximum-segment-length-request=0, method-id=4101
        SetVIN_Method: method=SetVIN, maximum-segment-length-request=0, method-id=4102
      someip event group NewEventGroup: event-group-id=1, event=SecureAccessActiveInfo_Field/notifier
      someip event group NewEventGroup1: event-group-id=2, event=DiagRoutingActiveInfo_Field/notifier
    TAD_Someip: service-interface=TAD, service-interface-id=3132, service-interface-version={major-version=1, minor-version=0}
      someip method deployment SetPwrStatus_Method: method=SetPwrStatus, maximum-segment-length-request=0, maximum-segment-length-response=0, method-id=4097, transport-protocol=UDP
      someip method deployment SetWireInput_Method: method=SetWireInput, maximum-segment-length-request=0, maximum-segment-length-response=0, method-id=4098, transport-protocol=UDP
    TimeManager_Someip: service-interface=TimeManager, service-interface-id=3075, service-interface-version={major-version=1, minor-version=1}
      someip field deployment CurrentTimeMode_Field: field=CurrentTimeMode
        get getter: maximum-segment-length-request=0, maximum-segment-length-response=0, method-id=8193, transport-protocol=UDP
        notifier notifier: event-id=8193, maximum-segment-length=0, transport-protocol=UDP
      8 x someip method deployment, all with maximum-segment-length-response=0, transport-protocol=UDP:
        GetCurrentEpochTime_Method: method=GetCurrentEpochTime, method-id=4097
        GetCurrentTime_Method: method=GetCurrentTime, method-id=4098
        GetMCUSysTick_Method: method=GetMCUSysTick, method-id=4104
        GetRtcWakeupTimer_Method: method=TimeManager/GetRtcWakeupTimer, method-id=4101
        GetSourceTimeValidity_Method: method=GetSourceTimeValidity, method-id=4103
        GetSystemTickOffset_Method: method=GetSystemTickOffset, method-id=4099
        SetRtcWakeupTimer_Method: method=TimeManager/SetRtcWakeupTimer, maximum-segment-length-request=0, method-id=4100
        StopRtcWakeupTimer_Method: method=TimeManager/StopRtcWakeupTimer, maximum-segment-length-request=0, method-id=4102
      someip event group NewEventGroup: event-group-id=1, event=CurrentTimeMode_Field/notifier
    Time_Someip: service-interface=Service/Time, service-interface-id=5251, service-interface-version={major-version=1, minor-version=1}
      7 x someip field deployment:
        ClockSource_Field: field=ClockSource
          get getter: maximum-segment-length-request=0, maximum-segment-length-response=0, method-id=8199, transport-protocol=UDP
          notifier notifier: event-id=8199, maximum-segment-length=0, transport-protocol=UDP
        DaylightSavingTime_Field: field=DaylightSavingTime
          get getter: maximum-segment-length-request=0, maximum-segment-length-response=0, method-id=8194, transport-protocol=UDP
          notifier notifier: event-id=8194, maximum-segment-length=0, transport-protocol=UDP
        DisplayedTime_Field: field=DisplayedTime
          get getter: maximum-segment-length-request=0, maximum-segment-length-response=0, method-id=8197, transport-protocol=UDP
          notifier notifier: event-id=8197, maximum-segment-length=0, transport-protocol=UDP
        SystemTime_Field: field=Time/SystemTime
          get getter: maximum-segment-length-request=0, maximum-segment-length-response=0, method-id=8193, transport-protocol=UDP
          notifier notifier: event-id=8193, maximum-segment-length=0, transport-protocol=UDP
        TimeZoneID_Field: field=TimeZoneID
          get getter: maximum-segment-length-request=0, maximum-segment-length-response=0, method-id=8195, transport-protocol=UDP
          notifier notifier: event-id=8195, maximum-segment-length=0, transport-protocol=UDP
        UTCOffset_Field: field=UTCOffset
          get getter: maximum-segment-length-request=0, maximum-segment-length-response=0, method-id=8196, transport-protocol=UDP
          notifier notifier: event-id=8196, maximum-segment-length=0, transport-protocol=UDP
        UserOffset_Field: field=UserOffset
          get getter: maximum-segment-length-request=0, maximum-segment-length-response=0, method-id=8198, transport-protocol=UDP
          notifier notifier: event-id=8198, maximum-segment-length=0, transport-protocol=UDP
      someip event group SomeIpEventGroups: event-group-id=4097, event=[ClockSource_Field/notifier, DaylightSavingTime_Field/notifier, DisplayedTime_Field/notifier, SystemTime_Field/notifier, TimeZoneID_Field/notifier, UTCOffset_Field/notifier, UserOffset_Field/notifier]
    Time_Someip: service-interface=Service/Time, service-interface-id=5763, service-interface-version={major-version=1, minor-version=0}
      someip field deployment LocationUTCTime_Field: field=LocationUTCTime
        get getter: maximum-segment-length-request=0, maximum-segment-length-response=0, method-id=8193, transport-protocol=UDP
        notifier notifier: event-id=8193, maximum-segment-length=0, transport-protocol=UDP
      someip field deployment TimeSource_Field: field=TimeSource
        get getter: maximum-segment-length-request=0, maximum-segment-length-response=0, method-id=8194, transport-protocol=UDP
        notifier notifier: event-id=8194, maximum-segment-length=0, transport-protocol=UDP
      someip event group SomeIpEventGroups: event-group-id=4097, event=[LocationUTCTime_Field/notifier, TimeSource_Field/notifier]
    Time_Someip: service-interface=Service/Time, service-interface-id=6405, service-interface-version={major-version=2, minor-version=2}
      someip field deployment SystemTime_Field: field=Time/SystemTime
        get getter: maximum-segment-length-request=0, maximum-segment-length-response=0, method-id=8193, transport-protocol=TCP
        notifier notifier: event-id=8193, maximum-segment-length=0, transport-protocol=TCP
      someip field deployment UtcOffset_Field: field=UtcOffset
        get getter: maximum-segment-length-request=0, maximum-segment-length-response=0, method-id=8194, transport-protocol=TCP
        notifier notifier: event-id=8194, maximum-segment-length=0, transport-protocol=TCP
      someip event group SomeIpEventGroups: event-group-id=1, event=[SystemTime_Field/notifier, UtcOffset_Field/notifier]
    UdsReprogram_Someip: service-interface=UdsReprogram, service-interface-id=3122, service-interface-version={major-version=1, minor-version=0}
      someip field deployment UpdateVehicleSystemDiagClient_Field: field=UpdateVehicleSystemDiagClient
        get getter: maximum-segment-length-request=0, maximum-segment-length-response=0, method-id=8194, transport-protocol=UDP
        notifier notifier: event-id=8194, maximum-segment-length=0, transport-protocol=UDP
      someip field deployment UpdateVehicleSystemStatus_Field: field=UpdateVehicleSystemStatus
        get getter: maximum-segment-length-request=0, maximum-segment-length-response=0, method-id=8193, transport-protocol=UDP
        notifier notifier: event-id=8193, maximum-segment-length=0, transport-protocol=UDP
      someip method deployment RequestUdsReprogramCCU_Method: method=RequestUdsReprogramCCU, maximum-segment-length-request=0, maximum-segment-length-response=0, method-id=4097, transport-protocol=UDP
      someip method deployment RequestUdsUpdateVehicleSystem_Method: method=RequestUdsUpdateVehicleSystem, maximum-segment-length-request=0, maximum-segment-length-response=0, method-id=4098, transport-protocol=UDP
      someip event group NewEventGroup: event-group-id=1, event=UpdateVehicleSystemDiagClient_Field/notifier
      someip event group NewEventGroup1: event-group-id=2, event=UpdateVehicleSystemStatus_Field/notifier
    UpdateRequest_Someip: service-interface=UpdateRequest, service-interface-id=4050, service-interface-version={major-version=1, minor-version=0}
      6 x someip method deployment, all with maximum-segment-length-request=0, transport-protocol=UDP:
        PrepareRollback_Method: method=PrepareRollback, method-id=4102
        PrepareUpdate_Method: method=PrepareUpdate, method-id=4100
        ResetMachine_Method: method=ResetMachine, method-id=4097
        StartUpdateSession_Method: method=StartUpdateSession, method-id=4099
        StopUpdateSession_Method: method=StopUpdateSession, method-id=4098
        VerifyUpdate_Method: method=UpdateRequest/VerifyUpdate, method-id=4101
    UpdateStandard_Someip: service-interface=UpdateStandard, service-interface-id=3131, service-interface-version={major-version=1, minor-version=2}
      4 x someip field deployment:
        CureentSDSAuthenticationLevel_Field: field=UpdateStandard/CureentSDSAuthenticationLevel
          get getter: maximum-segment-length-request=0, maximum-segment-length-response=0, method-id=8196, transport-protocol=UDP
          notifier notifier: event-id=8196, maximum-segment-length=0, transport-protocol=UDP
        CurrentAuthenticationLevel_Field: field=UpdateStandard/CurrentAuthenticationLevel
          get getter: maximum-segment-length-request=0, maximum-segment-length-response=0, method-id=8195, transport-protocol=UDP
          notifier notifier: event-id=8195, maximum-segment-length=0, transport-protocol=UDP
        CurrentDiagSession_Field: field=UpdateStandard/CurrentDiagSession
          get getter: maximum-segment-length-request=0, maximum-segment-length-response=0, method-id=8193, transport-protocol=UDP
          notifier notifier: event-id=8193, maximum-segment-length=0, transport-protocol=UDP
        CurrentSecurityLevel_Field: field=UpdateStandard/CurrentSecurityLevel
          get getter: maximum-segment-length-request=0, maximum-segment-length-response=0, method-id=8194, transport-protocol=UDP
          notifier notifier: event-id=8194, maximum-segment-length=0, transport-protocol=UDP
      7 x someip method deployment, all with transport-protocol=UDP:
        CommunicationControl_Method: method=CommunicationControl, maximum-segment-length-request=0, maximum-segment-length-response=0, method-id=4100
        ControlDTCSetting_Method: method=ControlDTCSetting, maximum-segment-length-request=0, maximum-segment-length-response=0, method-id=4099
        GetId_Method: method=UpdateStandard/GetId, maximum-segment-length-response=0, method-id=4098
        RoutineControl_Method: method=RoutineControl, maximum-segment-length-request=0, maximum-segment-length-response=0, method-id=4103
        SecurityAccess_Method: method=SecurityAccess, maximum-segment-length-request=0, maximum-segment-length-response=0, method-id=4101
        SessionControl_Method: method=SessionControl, maximum-segment-length-request=0, maximum-segment-length-response=0, method-id=4102
        SetId_Method: method=SetId, maximum-segment-length-request=0, method-id=4097
      4 x someip event group:
        NewEventGroup: event-group-id=1, event=CurrentAuthenticationLevel_Field/notifier
        NewEventGroup1: event-group-id=2, event=CurrentDiagSession_Field/notifier
        NewEventGroup2: event-group-id=3, event=CurrentSecurityLevel_Field/notifier
        NewEventGroup4: event-group-id=4, event=CureentSDSAuthenticationLevel_Field/notifier
    Variant_Someip: service-interface=Variant, service-interface-id=5253, service-interface-version={major-version=1, minor-version=7}
      someip field deployment Variants_Field: field=Variants
        get getter: maximum-segment-length-request=0, maximum-segment-length-response=0, method-id=8193, transport-protocol=UDP
        notifier notifier: event-id=8193, maximum-segment-length=0, transport-protocol=UDP
      someip event group SomeIpEventGroups: event-group-id=1, event=Variants_Field/notifier
    Variation_Someip: service-interface=Variation, service-interface-id=6404, service-interface-version={major-version=3, minor-version=0}
      someip method deployment GetVariation_Method: method=GetVariation, maximum-segment-length-response=0, method-id=4097, transport-protocol=TCP
    VehicleAPI_Someip: service-interface=VehicleAPI, service-interface-id=4053, service-interface-version={major-version=2, minor-version=1}
      someip event deployment Subscription_1_Event: event=Subscription_1, event-id=4097, maximum-segment-length=0, transport-protocol=UDP
      5 x someip method deployment, all with maximum-segment-length-request=0, maximum-segment-length-response=0, transport-protocol=UDP:
        CheckAvailability_Method: method=CheckAvailability, method-id=4101
        Read_Method: method=Read, method-id=4097
        Subscribe_1_Method: method=Subscribe_1, method-id=4099
        Unsubscribe_1_Method: method=Unsubscribe_1, method-id=4100
        Update_Method: method=Update, method-id=4098
      someip event group NewEventGroup: event-group-id=1, event=Subscription_1_Event
    VoiceCallManager_Someip: service-interface=VoiceCallManager, service-interface-id=6340, service-interface-version={major-version=2, minor-version=0}
      someip event deployment RecvTones_Event: event=RecvTones, event-id=4097, maximum-segment-length=0, transport-protocol=UDP
      someip field deployment CallSession_Field: field=CallSession
        get getter: maximum-segment-length-request=0, maximum-segment-length-response=0, method-id=8193, transport-protocol=TCP
        notifier notifier: event-id=8193, maximum-segment-length=0, transport-protocol=TCP
      4 x someip method deployment, all with maximum-segment-length-response=0, transport-protocol=TCP:
        Answer_Method: method=Answer, maximum-segment-length-request=0, method-id=4098
        Dial_Method: method=Dial, maximum-segment-length-request=0, method-id=4097
        HangupAll_Method: method=HangupAll, method-id=4099
        SendTones_Method: method=SendTones, maximum-segment-length-request=0, method-id=4100
      someip event group SomeIpEventGroups: event-group-id=4097, event=[CallSession_Field/notifier, RecvTones_Event]
package /System/Service/Endpoint
  618 x someip service instance to machine mapping, all with communication-connector=CCUCommunicationConnector:
    ARA_SM_FunctionGroupState_ProvidedServiceInstanceToMachine: service-instance=ARA_SM_FunctionGroupState, udp-port=61441
    ARA_SM_FunctionGroupState_RequiredServiceInstanceToMachine: service-instance=R_ARA_SM_FunctionGroupState, udp-port=63492
    ARA_SM_UpdateRequest_ProvidedServiceInstanceToMachine: service-instance=ARA_SM_UpdateRequest, udp-port=61441
    ARA_SM_UpdateRequest_RequiredServiceInstanceToMachine: service-instance=R_ARA_SM_UpdateRequest, udp-port=63492
    ARA_UCM_PackageManagement_ProvidedServiceInstanceToMachine: service-instance=ARA_UCM_PackageManagement, udp-port=61441
    ARA_UCM_PackageManagement_RequiredServiceInstanceToMachine: service-instance=Instance/R_ARA_UCM_PackageManagement, udp-port=63494
    ARA_UCM_PackageManagement_RequiredServiceInstanceToMachine: service-instance=Instance/R_ARA_UCM_PackageManagement, udp-port=63493
    ARA_UCM_PackageManagement_RequiredServiceInstanceToMachine: service-instance=Instance/R_ARA_UCM_PackageManagement, udp-port=63492
    ARA_UCM_PackageManagement_RequiredServiceInstanceToMachine: service-instance=Instance/R_ARA_UCM_PackageManagement, udp-port=63495
    BltnCam_DrivingEvent_Manager_RequiredServiceInstanceToMachine: service-instance=R_BltnCam_DrivingEvent_Manager, tcp-port=63492, udp-port=63492
    BltnCam_ParkingEvent_Manager_RequiredServiceInstanceToMachine: service-instance=R_BltnCam_ParkingEvent_Manager, tcp-port=63492, udp-port=63492
    BltnCam_System_Manager_RequiredServiceInstanceToMachine: service-instance=R_BltnCam_System_Manager, udp-port=63492
    CCU_Cloud_Communicator_ProvidedServiceInstanceToMachine: service-instance=CCU_Cloud_Communicator, tcp-port=61441
    CCU_Cloud_Communicator_RequiredServiceInstanceToMachine: service-instance=Instance/R_CCU_Cloud_Communicator, tcp-port=63493
    CCU_Cloud_Communicator_RequiredServiceInstanceToMachine: service-instance=Instance/R_CCU_Cloud_Communicator, tcp-port=63495
    CCU_Cloud_Communicator_RequiredServiceInstanceToMachine: service-instance=Instance/R_CCU_Cloud_Communicator, tcp-port=63496
    CCU_Cloud_Communicator_RequiredServiceInstanceToMachine: service-instance=Instance/R_CCU_Cloud_Communicator, tcp-port=63494
    CCU_Cloud_Communicator_RequiredServiceInstanceToMachine: service-instance=Instance/R_CCU_Cloud_Communicator, tcp-port=63492
    CCU_Cloud_ProvisioningTable_ProvidedServiceInstanceToMachine: service-instance=CCU_Cloud_ProvisioningTable, tcp-port=61441
    CCU_ExternalNetwork_Manager2_ProvidedServiceInstanceToMachine: service-instance=CCU_ExternalNetwork_Manager2, tcp-port=61441
    CCU_FoD_Screen_ProvidedServiceInstanceToMachine: service-instance=CCU_FoD_Screen, tcp-port=61441, udp-port=61441
    CCU_Mode_Routines_ProvidedServiceInstanceToMachine: service-instance=CCU_Mode_Routines, tcp-port=61441, udp-port=61441
    CCU_SharedStorage_Share_ProvidedServiceInstanceToMachine: service-instance=CCU_SharedStorage_Share, udp-port=61441
    CCU_System_EngineeringMode_ProvidedServiceInstanceToMachine: service-instance=CCU_System_EngineeringMode, udp-port=61441
    CCU_Update_Screen_ProvidedServiceInstanceToMachine: service-instance=CCU_Update_Screen, udp-port=61441
    CCU_Vehicle_DiagnosticRouting_ProvidedServiceInstanceToMachine: service-instance=CCU_Vehicle_DiagnosticRouting, tcp-port=61441
    CCU_Vehicle_DiagnosticService_ProvidedServiceInstanceToMachine: service-instance=CCU_Vehicle_DiagnosticService, tcp-port=61441
    CCU_Vehicle_DiagnosticService_RequiredServiceInstanceToMachine: service-instance=Instance/R_CCU_Vehicle_DiagnosticService, tcp-port=63496
    CCU_Vehicle_DiagnosticService_RequiredServiceInstanceToMachine: service-instance=Instance/R_CCU_Vehicle_DiagnosticService, tcp-port=63495
    CCU_Vehicle_DiagnosticService_RequiredServiceInstanceToMachine: service-instance=Instance/R_CCU_Vehicle_DiagnosticService, tcp-port=63493
    CCU_Vehicle_DiagnosticService_RequiredServiceInstanceToMachine: service-instance=Instance/R_CCU_Vehicle_DiagnosticService, tcp-port=63492
    CCU_Vehicle_DiagnosticService_RequiredServiceInstanceToMachine: service-instance=Instance/R_CCU_Vehicle_DiagnosticService, tcp-port=63497
    CCU_Vehicle_DiagnosticService_RequiredServiceInstanceToMachine: service-instance=Instance/R_CCU_Vehicle_DiagnosticService, tcp-port=63494
    CCU_Vehicle_S2S_ProvidedServiceInstanceToMachine: service-instance=CCU_Vehicle_S2S, udp-port=61441
    DCU_System_PowerManagement_RequiredServiceInstanceToMachine: service-instance=R_DCU_System_PowerManagement, tcp-port=63492
    DCU_System_Time_RequiredServiceInstanceToMachine: service-instance=R_DCU_System_Time, tcp-port=63492
    DCU_System_Variation_RequiredServiceInstanceToMachine: service-instance=R_DCU_System_Variation, tcp-port=63492
    DCU_Telephony_ConnectionContext_1_RequiredServiceInstanceToMachine: service-instance=R_DCU_Telephony_ConnectionContext_1, tcp-port=63493
    DCU_Telephony_ConnectionContext_2_RequiredServiceInstanceToMachine: service-instance=R_DCU_Telephony_ConnectionContext_2, tcp-port=63494
    DCU_Telephony_ConnectionContext_3_RequiredServiceInstanceToMachine: service-instance=R_DCU_Telephony_ConnectionContext_3, tcp-port=63495
    DCU_Telephony_ConnectionContext_RequiredServiceInstanceToMachine: service-instance=R_DCU_Telephony_ConnectionContext, tcp-port=63492
    DCU_Telephony_ConnectionManager_RequiredServiceInstanceToMachine: service-instance=R_DCU_Telephony_ConnectionManager, tcp-port=63492, udp-port=63492
    DCU_Telephony_EngineeringMode_RequiredServiceInstanceToMachine: service-instance=R_DCU_Telephony_EngineeringMode, tcp-port=63492
    DCU_Telephony_MessageManager_RequiredServiceInstanceToMachine: service-instance=R_DCU_Telephony_MessageManager, tcp-port=63492, udp-port=63492
    DCU_Telephony_ModemManager_RequiredServiceInstanceToMachine: service-instance=R_DCU_Telephony_ModemManager, tcp-port=63492
    DCU_Telephony_NetworkInformation_RequiredServiceInstanceToMachine: service-instance=R_DCU_Telephony_NetworkInformation, tcp-port=63492
    DCU_Telephony_SimManager_RequiredServiceInstanceToMachine: service-instance=R_DCU_Telephony_SimManager, tcp-port=63492
    DCU_Telephony_VoiceCallManager_RequiredServiceInstanceToMachine: service-instance=R_DCU_Telephony_VoiceCallManager, tcp-port=63492, udp-port=63492
    Info_Cloud_EngineeringMode_RequiredServiceInstanceToMachine: service-instance=Instance/R_Info_Cloud_EngineeringMode, tcp-port=63493
    Info_Cloud_EngineeringMode_RequiredServiceInstanceToMachine: service-instance=Instance/R_Info_Cloud_EngineeringMode, tcp-port=63492
    Info_Cloud_ProvisioningTable_RequiredServiceInstanceToMachine: service-instance=Instance/R_Info_Cloud_ProvisioningTable, tcp-port=63493
    Info_Cloud_ProvisioningTable_RequiredServiceInstanceToMachine: service-instance=Instance/R_Info_Cloud_ProvisioningTable, tcp-port=63492
    Info_Cluster_InformationProvider_RequiredServiceInstanceToMachine: service-instance=R_Info_Cluster_InformationProvider, udp-port=63492
    Info_Location_GNSS_RequiredServiceInstanceToMachine: service-instance=Instance/R_Info_Location_GNSS, udp-port=63495
    Info_Location_GNSS_RequiredServiceInstanceToMachine: service-instance=Instance/R_Info_Location_GNSS, udp-port=63494
    Info_Location_GNSS_RequiredServiceInstanceToMachine: service-instance=Instance/R_Info_Location_GNSS, udp-port=63492
    Info_Location_GNSS_RequiredServiceInstanceToMachine: service-instance=Instance/R_Info_Location_GNSS, udp-port=63496
    Info_Location_GNSS_RequiredServiceInstanceToMachine: service-instance=Instance/R_Info_Location_GNSS, udp-port=63493
    Info_Location_MapMatching_RequiredServiceInstanceToMachine: service-instance=Instance/R_Info_Location_MapMatching, udp-port=63494
    Info_Location_MapMatching_RequiredServiceInstanceToMachine: service-instance=Instance/R_Info_Location_MapMatching, udp-port=63493
    Info_Location_MapMatching_RequiredServiceInstanceToMachine: service-instance=Instance/R_Info_Location_MapMatching, udp-port=63495
    Info_Location_MapMatching_RequiredServiceInstanceToMachine: service-instance=Instance/R_Info_Location_MapMatching, udp-port=63492
    Info_Location_Time_RequiredServiceInstanceToMachine: service-instance=Instance/R_Info_Location_Time, udp-port=63495
    Info_Location_Time_RequiredServiceInstanceToMachine: service-instance=Instance/R_Info_Location_Time, udp-port=63494
    Info_Location_Time_RequiredServiceInstanceToMachine: service-instance=Instance/R_Info_Location_Time, udp-port=63492
    Info_Location_Time_RequiredServiceInstanceToMachine: service-instance=Instance/R_Info_Location_Time, udp-port=63496
    Info_Location_Time_RequiredServiceInstanceToMachine: service-instance=Instance/R_Info_Location_Time, udp-port=63493
    Info_Setup_GeneralSettings_RequiredServiceInstanceToMachine: service-instance=Instance/R_Info_Setup_GeneralSettings, udp-port=63492
    Info_Setup_GeneralSettings_RequiredServiceInstanceToMachine: service-instance=Instance/R_Info_Setup_GeneralSettings, udp-port=63493
    Info_System_EngineeringMode_RequiredServiceInstanceToMachine: service-instance=Instance/R_Info_System_EngineeringMode, tcp-port={63492..63494}
    Info_System_Time_RequiredServiceInstanceToMachine: service-instance=R_Info_System_Time, udp-port=63492
    Info_System_Variant_RequiredServiceInstanceToMachine: service-instance=R_Info_System_Variant, udp-port=63492
    Info_Update_InteractionManager_RequiredServiceInstanceToMachine: service-instance=Instance/R_Info_Update_InteractionManager, udp-port=63492
    Info_Update_InteractionManager_RequiredServiceInstanceToMachine: service-instance=Instance/R_Info_Update_InteractionManager, udp-port=63493
    Info_Update_RFSManager_RequiredServiceInstanceToMachine: service-instance=Instance/R_Info_Update_RFSManager, udp-port=63493
    Info_Update_RFSManager_RequiredServiceInstanceToMachine: service-instance=Instance/R_Info_Update_RFSManager, udp-port=63492
    Info_Update_RFSManager_RequiredServiceInstanceToMachine: service-instance=Instance/R_Info_Update_RFSManager, udp-port=63494
    Info_Update_RFSManager_RequiredServiceInstanceToMachine: service-instance=Instance/R_Info_Update_RFSManager, udp-port=63495
    Update_USS_UpdateStandard_ProvidedServiceInstanceToMachine: service-instance=Update_USS_UpdateStandard, udp-port=61441
    Update_USS_UpdateStandard_RequiredServiceInstanceToMachine: service-instance=Instance/R_Update_USS_UpdateStandard, udp-port=63495
    Update_USS_UpdateStandard_RequiredServiceInstanceToMachine: service-instance=Instance/R_Update_USS_UpdateStandard, udp-port=63493
    Update_USS_UpdateStandard_RequiredServiceInstanceToMachine: service-instance=Instance/R_Update_USS_UpdateStandard, udp-port=63492
    Update_USS_UpdateStandard_RequiredServiceInstanceToMachine: service-instance=Instance/R_Update_USS_UpdateStandard, udp-port=63494
    Vehicle_ApSysMgr_BootModeManager_ProvidedServiceInstanceToMachine: service-instance=Vehicle_ApSysMgr_BootModeManager, udp-port=61441
    Vehicle_ApSysMgr_BootModeManager_RequiredServiceInstanceToMachine: service-instance=R_Vehicle_ApSysMgr_BootModeManager, udp-port=63492
    Vehicle_ApSysMgr_IOManager_ProvidedServiceInstanceToMachine: service-instance=Vehicle_ApSysMgr_IOManager, udp-port=61441
    Vehicle_ApSysMgr_IOManager_RequiredServiceInstanceToMachine: service-instance=Instance/R_Vehicle_ApSysMgr_IOManager, udp-port=63494
    Vehicle_ApSysMgr_IOManager_RequiredServiceInstanceToMachine: service-instance=Instance/R_Vehicle_ApSysMgr_IOManager, udp-port=63505
    Vehicle_ApSysMgr_IOManager_RequiredServiceInstanceToMachine: service-instance=Instance/R_Vehicle_ApSysMgr_IOManager, udp-port=63513
    Vehicle_ApSysMgr_IOManager_RequiredServiceInstanceToMachine: service-instance=Instance/R_Vehicle_ApSysMgr_IOManager, udp-port=63506
    Vehicle_ApSysMgr_IOManager_RequiredServiceInstanceToMachine: service-instance=Instance/R_Vehicle_ApSysMgr_IOManager, udp-port=63512
    Vehicle_ApSysMgr_IOManager_RequiredServiceInstanceToMachine: service-instance=Instance/R_Vehicle_ApSysMgr_IOManager, udp-port=63507
    Vehicle_ApSysMgr_IOManager_RequiredServiceInstanceToMachine: service-instance=Instance/R_Vehicle_ApSysMgr_IOManager, udp-port=63509
    Vehicle_ApSysMgr_IOManager_RequiredServiceInstanceToMachine: service-instance=Instance/R_Vehicle_ApSysMgr_IOManager, udp-port=63500
    Vehicle_ApSysMgr_IOManager_RequiredServiceInstanceToMachine: service-instance=Instance/R_Vehicle_ApSysMgr_IOManager, udp-port=63510
    Vehicle_ApSysMgr_IOManager_RequiredServiceInstanceToMachine: service-instance=Instance/R_Vehicle_ApSysMgr_IOManager, udp-port=63508
    Vehicle_ApSysMgr_IOManager_RequiredServiceInstanceToMachine: service-instance=Instance/R_Vehicle_ApSysMgr_IOManager, udp-port=63496
    Vehicle_ApSysMgr_IOManager_RequiredServiceInstanceToMachine: service-instance=Instance/R_Vehicle_ApSysMgr_IOManager, udp-port=63502
    Vehicle_ApSysMgr_IOManager_RequiredServiceInstanceToMachine: service-instance=Instance/R_Vehicle_ApSysMgr_IOManager, udp-port=63493
    Vehicle_ApSysMgr_IOManager_RequiredServiceInstanceToMachine: service-instance=Instance/R_Vehicle_ApSysMgr_IOManager, udp-port=63497
    Vehicle_ApSysMgr_IOManager_RequiredServiceInstanceToMachine: service-instance=Instance/R_Vehicle_ApSysMgr_IOManager, udp-port=63492
    Vehicle_ApSysMgr_IOManager_RequiredServiceInstanceToMachine: service-instance=Instance/R_Vehicle_ApSysMgr_IOManager, udp-port=63499
    Vehicle_ApSysMgr_IOManager_RequiredServiceInstanceToMachine: service-instance=Instance/R_Vehicle_ApSysMgr_IOManager, udp-port=63495
    Vehicle_ApSysMgr_IOManager_RequiredServiceInstanceToMachine: service-instance=Instance/R_Vehicle_ApSysMgr_IOManager, udp-port=63503
    Vehicle_ApSysMgr_IOManager_RequiredServiceInstanceToMachine: service-instance=Instance/R_Vehicle_ApSysMgr_IOManager, udp-port=63501
    Vehicle_ApSysMgr_IOManager_RequiredServiceInstanceToMachine: service-instance=Instance/R_Vehicle_ApSysMgr_IOManager, udp-port=63511
    Vehicle_ApSysMgr_IOManager_RequiredServiceInstanceToMachine: service-instance=Instance/R_Vehicle_ApSysMgr_IOManager, udp-port=63498
    Vehicle_ApSysMgr_IOManager_RequiredServiceInstanceToMachine: service-instance=Instance/R_Vehicle_ApSysMgr_IOManager, udp-port=63504
    Vehicle_ApSysMgr_NetManager_ProvidedServiceInstanceToMachine: service-instance=Vehicle_ApSysMgr_NetManager, udp-port=61441
    Vehicle_ApSysMgr_NetManager_RequiredServiceInstanceToMachine: service-instance=Instance/R_Vehicle_ApSysMgr_NetManager, udp-port=63494
    Vehicle_ApSysMgr_NetManager_RequiredServiceInstanceToMachine: service-instance=Instance/R_Vehicle_ApSysMgr_NetManager, udp-port=63505
    Vehicle_ApSysMgr_NetManager_RequiredServiceInstanceToMachine: service-instance=Instance/R_Vehicle_ApSysMgr_NetManager, udp-port=63506
    Vehicle_ApSysMgr_NetManager_RequiredServiceInstanceToMachine: service-instance=Instance/R_Vehicle_ApSysMgr_NetManager, udp-port=63501
    Vehicle_ApSysMgr_NetManager_RequiredServiceInstanceToMachine: service-instance=Instance/R_Vehicle_ApSysMgr_NetManager, udp-port=63507
    Vehicle_ApSysMgr_NetManager_RequiredServiceInstanceToMachine: service-instance=Instance/R_Vehicle_ApSysMgr_NetManager, udp-port=63509
    Vehicle_ApSysMgr_NetManager_RequiredServiceInstanceToMachine: service-instance=Instance/R_Vehicle_ApSysMgr_NetManager, udp-port=63500
    Vehicle_ApSysMgr_NetManager_RequiredServiceInstanceToMachine: service-instance=Instance/R_Vehicle_ApSysMgr_NetManager, udp-port=63510
    Vehicle_ApSysMgr_NetManager_RequiredServiceInstanceToMachine: service-instance=Instance/R_Vehicle_ApSysMgr_NetManager, udp-port=63508
    Vehicle_ApSysMgr_NetManager_RequiredServiceInstanceToMachine: service-instance=Instance/R_Vehicle_ApSysMgr_NetManager, udp-port=63496
    Vehicle_ApSysMgr_NetManager_RequiredServiceInstanceToMachine: service-instance=Instance/R_Vehicle_ApSysMgr_NetManager, udp-port=63503
    Vehicle_ApSysMgr_NetManager_RequiredServiceInstanceToMachine: service-instance=Instance/R_Vehicle_ApSysMgr_NetManager, udp-port=63493
    Vehicle_ApSysMgr_NetManager_RequiredServiceInstanceToMachine: service-instance=Instance/R_Vehicle_ApSysMgr_NetManager, udp-port=63497
    Vehicle_ApSysMgr_NetManager_RequiredServiceInstanceToMachine: service-instance=Instance/R_Vehicle_ApSysMgr_NetManager, udp-port=63492
    Vehicle_ApSysMgr_NetManager_RequiredServiceInstanceToMachine: service-instance=Instance/R_Vehicle_ApSysMgr_NetManager, udp-port=63502
    Vehicle_ApSysMgr_NetManager_RequiredServiceInstanceToMachine: service-instance=Instance/R_Vehicle_ApSysMgr_NetManager, udp-port=63511
    Vehicle_ApSysMgr_NetManager_RequiredServiceInstanceToMachine: service-instance=Instance/R_Vehicle_ApSysMgr_NetManager, udp-port=63499
    Vehicle_ApSysMgr_NetManager_RequiredServiceInstanceToMachine: service-instance=Instance/R_Vehicle_ApSysMgr_NetManager, udp-port=63495
    Vehicle_ApSysMgr_NetManager_RequiredServiceInstanceToMachine: service-instance=Instance/R_Vehicle_ApSysMgr_NetManager, udp-port=63504
    Vehicle_ApSysMgr_NetManager_RequiredServiceInstanceToMachine: service-instance=Instance/R_Vehicle_ApSysMgr_NetManager, udp-port=63498
    Vehicle_ApSysMgr_SysInfoManager_ProvidedServiceInstanceToMachine: service-instance=Vehicle_ApSysMgr_SysInfoManager, udp-port=61441
    Vehicle_ApSysMgr_SysInfoManager_RequiredServiceInstanceToMachine: service-instance=Instance/R_Vehicle_ApSysMgr_SysInfoManager, udp-port=63495
    Vehicle_ApSysMgr_SysInfoManager_RequiredServiceInstanceToMachine: service-instance=Instance/R_Vehicle_ApSysMgr_SysInfoManager, udp-port=63507
    Vehicle_ApSysMgr_SysInfoManager_RequiredServiceInstanceToMachine: service-instance=Instance/R_Vehicle_ApSysMgr_SysInfoManager, udp-port=63508
    Vehicle_ApSysMgr_SysInfoManager_RequiredServiceInstanceToMachine: service-instance=Instance/R_Vehicle_ApSysMgr_SysInfoManager, udp-port=63503
    Vehicle_ApSysMgr_SysInfoManager_RequiredServiceInstanceToMachine: service-instance=Instance/R_Vehicle_ApSysMgr_SysInfoManager, udp-port=63516
    Vehicle_ApSysMgr_SysInfoManager_RequiredServiceInstanceToMachine: service-instance=Instance/R_Vehicle_ApSysMgr_SysInfoManager, udp-port=63509
    Vehicle_ApSysMgr_SysInfoManager_RequiredServiceInstanceToMachine: service-instance=Instance/R_Vehicle_ApSysMgr_SysInfoManager, udp-port=63511
    Vehicle_ApSysMgr_SysInfoManager_RequiredServiceInstanceToMachine: service-instance=Instance/R_Vehicle_ApSysMgr_SysInfoManager, udp-port=63502
    Vehicle_ApSysMgr_SysInfoManager_RequiredServiceInstanceToMachine: service-instance=Instance/R_Vehicle_ApSysMgr_SysInfoManager, udp-port=63494
    Vehicle_ApSysMgr_SysInfoManager_RequiredServiceInstanceToMachine: service-instance=Instance/R_Vehicle_ApSysMgr_SysInfoManager, udp-port=63512
    Vehicle_ApSysMgr_SysInfoManager_RequiredServiceInstanceToMachine: service-instance=Instance/R_Vehicle_ApSysMgr_SysInfoManager, udp-port=63510
    Vehicle_ApSysMgr_SysInfoManager_RequiredServiceInstanceToMachine: service-instance=Instance/R_Vehicle_ApSysMgr_SysInfoManager, udp-port=63514
    Vehicle_ApSysMgr_SysInfoManager_RequiredServiceInstanceToMachine: service-instance=Instance/R_Vehicle_ApSysMgr_SysInfoManager, udp-port=63498
    Vehicle_ApSysMgr_SysInfoManager_RequiredServiceInstanceToMachine: service-instance=Instance/R_Vehicle_ApSysMgr_SysInfoManager, udp-port=63500
    Vehicle_ApSysMgr_SysInfoManager_RequiredServiceInstanceToMachine: service-instance=Instance/R_Vehicle_ApSysMgr_SysInfoManager, udp-port=63501
    Vehicle_ApSysMgr_SysInfoManager_RequiredServiceInstanceToMachine: service-instance=Instance/R_Vehicle_ApSysMgr_SysInfoManager, udp-port=63505
    Vehicle_ApSysMgr_SysInfoManager_RequiredServiceInstanceToMachine: service-instance=Instance/R_Vehicle_ApSysMgr_SysInfoManager, udp-port=63493
    Vehicle_ApSysMgr_SysInfoManager_RequiredServiceInstanceToMachine: service-instance=Instance/R_Vehicle_ApSysMgr_SysInfoManager, udp-port=63492
    Vehicle_ApSysMgr_SysInfoManager_RequiredServiceInstanceToMachine: service-instance=Instance/R_Vehicle_ApSysMgr_SysInfoManager, udp-port=63496
    Vehicle_ApSysMgr_SysInfoManager_RequiredServiceInstanceToMachine: service-instance=Instance/R_Vehicle_ApSysMgr_SysInfoManager, udp-port=63506
    Vehicle_ApSysMgr_SysInfoManager_RequiredServiceInstanceToMachine: service-instance=Instance/R_Vehicle_ApSysMgr_SysInfoManager, udp-port=63504
    Vehicle_ApSysMgr_SysInfoManager_RequiredServiceInstanceToMachine: service-instance=Instance/R_Vehicle_ApSysMgr_SysInfoManager, udp-port=63513
    Vehicle_ApSysMgr_SysInfoManager_RequiredServiceInstanceToMachine: service-instance=Instance/R_Vehicle_ApSysMgr_SysInfoManager, udp-port=63515
    Vehicle_ApSysMgr_SysInfoManager_RequiredServiceInstanceToMachine: service-instance=Instance/R_Vehicle_ApSysMgr_SysInfoManager, udp-port=63499
    Vehicle_ApSysMgr_SysInfoManager_RequiredServiceInstanceToMachine: service-instance=Instance/R_Vehicle_ApSysMgr_SysInfoManager, udp-port=63497
    Vehicle_ApSysMgr_TAD_ProvidedServiceInstanceToMachine: service-instance=Vehicle_ApSysMgr_TAD, udp-port=61441
    Vehicle_ApSysMgr_TAD_RequiredServiceInstanceToMachine: service-instance=R_Vehicle_ApSysMgr_TAD, udp-port=63492
    Vehicle_ApSysMgr_TimeManager_ProvidedServiceInstanceToMachine: service-instance=Vehicle_ApSysMgr_TimeManager, udp-port=61441
    Vehicle_ApSysMgr_TimeManager_RequiredServiceInstanceToMachine: service-instance=Instance/R_Vehicle_ApSysMgr_TimeManager, udp-port=63493
    Vehicle_ApSysMgr_TimeManager_RequiredServiceInstanceToMachine: service-instance=Instance/R_Vehicle_ApSysMgr_TimeManager, udp-port=63498
    Vehicle_ApSysMgr_TimeManager_RequiredServiceInstanceToMachine: service-instance=Instance/R_Vehicle_ApSysMgr_TimeManager, udp-port=63496
    Vehicle_ApSysMgr_TimeManager_RequiredServiceInstanceToMachine: service-instance=Instance/R_Vehicle_ApSysMgr_TimeManager, udp-port=63499
    Vehicle_ApSysMgr_TimeManager_RequiredServiceInstanceToMachine: service-instance=Instance/R_Vehicle_ApSysMgr_TimeManager, udp-port=63492
    Vehicle_ApSysMgr_TimeManager_RequiredServiceInstanceToMachine: service-instance=Instance/R_Vehicle_ApSysMgr_TimeManager, udp-port=63500
    Vehicle_ApSysMgr_TimeManager_RequiredServiceInstanceToMachine: service-instance=Instance/R_Vehicle_ApSysMgr_TimeManager, udp-port=63497
    Vehicle_ApSysMgr_TimeManager_RequiredServiceInstanceToMachine: service-instance=Instance/R_Vehicle_ApSysMgr_TimeManager, udp-port=63495
    Vehicle_ApSysMgr_TimeManager_RequiredServiceInstanceToMachine: service-instance=Instance/R_Vehicle_ApSysMgr_TimeManager, udp-port=63501
    Vehicle_ApSysMgr_TimeManager_RequiredServiceInstanceToMachine: service-instance=Instance/R_Vehicle_ApSysMgr_TimeManager, udp-port=63494
    Vehicle_BSM_BootSyncManager_ProvidedServiceInstanceToMachine: service-instance=Vehicle_BSM_BootSyncManager, udp-port=61441
    Vehicle_BSM_BootSyncManager_RequiredServiceInstanceToMachine: service-instance=Instance/R_Vehicle_BSM_BootSyncManager, udp-port=63496
    Vehicle_BSM_BootSyncManager_RequiredServiceInstanceToMachine: service-instance=Instance/R_Vehicle_BSM_BootSyncManager, udp-port=63492
    Vehicle_BSM_BootSyncManager_RequiredServiceInstanceToMachine: service-instance=Instance/R_Vehicle_BSM_BootSyncManager, udp-port=63494
    Vehicle_BSM_BootSyncManager_RequiredServiceInstanceToMachine: service-instance=Instance/R_Vehicle_BSM_BootSyncManager, udp-port=63493
    Vehicle_BSM_BootSyncManager_RequiredServiceInstanceToMachine: service-instance=Instance/R_Vehicle_BSM_BootSyncManager, udp-port=63495
    Vehicle_CCS_Monitoring_ProvidedServiceInstanceToMachine: service-instance=Vehicle_CCS_Monitoring, udp-port=61441
    Vehicle_CCS_Monitoring_RequiredServiceInstanceToMachine: service-instance=Instance/R_Vehicle_CCS_Monitoring, udp-port=63502
    Vehicle_CCS_Monitoring_RequiredServiceInstanceToMachine: service-instance=Instance/R_Vehicle_CCS_Monitoring, udp-port=63508
    Vehicle_CCS_Monitoring_RequiredServiceInstanceToMachine: service-instance=Instance/R_Vehicle_CCS_Monitoring, udp-port=63494
    Vehicle_CCS_Monitoring_RequiredServiceInstanceToMachine: service-instance=Instance/R_Vehicle_CCS_Monitoring, udp-port=63506
    Vehicle_CCS_Monitoring_RequiredServiceInstanceToMachine: service-instance=Instance/R_Vehicle_CCS_Monitoring, udp-port=63505
    Vehicle_CCS_Monitoring_RequiredServiceInstanceToMachine: service-instance=Instance/R_Vehicle_CCS_Monitoring, udp-port=63496
    Vehicle_CCS_Monitoring_RequiredServiceInstanceToMachine: service-instance=Instance/R_Vehicle_CCS_Monitoring, udp-port=63492
    Vehicle_CCS_Monitoring_RequiredServiceInstanceToMachine: service-instance=Instance/R_Vehicle_CCS_Monitoring, udp-port=63509
    Vehicle_CCS_Monitoring_RequiredServiceInstanceToMachine: service-instance=Instance/R_Vehicle_CCS_Monitoring, udp-port=63497
    Vehicle_CCS_Monitoring_RequiredServiceInstanceToMachine: service-instance=Instance/R_Vehicle_CCS_Monitoring, udp-port=63504
    Vehicle_CCS_Monitoring_RequiredServiceInstanceToMachine: service-instance=Instance/R_Vehicle_CCS_Monitoring, udp-port=63499
    Vehicle_CCS_Monitoring_RequiredServiceInstanceToMachine: service-instance=Instance/R_Vehicle_CCS_Monitoring, udp-port=63493
    Vehicle_CCS_Monitoring_RequiredServiceInstanceToMachine: service-instance=Instance/R_Vehicle_CCS_Monitoring, udp-port=63500
    Vehicle_CCS_Monitoring_RequiredServiceInstanceToMachine: service-instance=Instance/R_Vehicle_CCS_Monitoring, udp-port=63507
    Vehicle_CCS_Monitoring_RequiredServiceInstanceToMachine: service-instance=Instance/R_Vehicle_CCS_Monitoring, udp-port=63495
    Vehicle_CCS_Monitoring_RequiredServiceInstanceToMachine: service-instance=Instance/R_Vehicle_CCS_Monitoring, udp-port=63501
    Vehicle_CCS_Monitoring_RequiredServiceInstanceToMachine: service-instance=Instance/R_Vehicle_CCS_Monitoring, udp-port=63503
    Vehicle_CCS_Monitoring_RequiredServiceInstanceToMachine: service-instance=Instance/R_Vehicle_CCS_Monitoring, udp-port=63498
    Vehicle_CIDS_CIDSDiagInfo_ProvidedServiceInstanceToMachine: service-instance=Vehicle_CIDS_CIDSDiagInfo, udp-port=61441
    Vehicle_CIDS_CIDSDiagInfo_RequiredServiceInstanceToMachine: service-instance=Instance/R_Vehicle_CIDS_CIDSDiagInfo, udp-port=63492
    Vehicle_CIDS_CIDSDiagInfo_RequiredServiceInstanceToMachine: service-instance=Instance/R_Vehicle_CIDS_CIDSDiagInfo, udp-port=63493
    Vehicle_CIDS_CIDSInfo_ProvidedServiceInstanceToMachine: service-instance=Vehicle_CIDS_CIDSInfo, udp-port=61441
    Vehicle_CIDS_CIDSInfo_RequiredServiceInstanceToMachine: service-instance=R_Vehicle_CIDS_CIDSInfo, udp-port=63492
    Vehicle_CIDS_ReportSender_ProvidedServiceInstanceToMachine: service-instance=Vehicle_CIDS_ReportSender, udp-port=61441
    Vehicle_CIDS_ReportSender_RequiredServiceInstanceToMachine: service-instance=R_Vehicle_CIDS_ReportSender, udp-port=63492
    Vehicle_CM_OTA_ProvidedServiceInstanceToMachine: service-instance=Vehicle_CM_OTA, udp-port=61441
    Vehicle_CM_OTA_RequiredServiceInstanceToMachine: service-instance=Instance/R_Vehicle_CM_OTA, udp-port=63492
    Vehicle_CM_OTA_RequiredServiceInstanceToMachine: service-instance=Instance/R_Vehicle_CM_OTA, udp-port=63493
    Vehicle_CM_PackageManagement_ProvidedServiceInstanceToMachine: service-instance=Vehicle_CM_PackageManagement, udp-port=61441
    Vehicle_CM_PackageManagement_RequiredServiceInstanceToMachine: service-instance=Instance/R_Vehicle_CM_PackageManagement, udp-port=63493
    Vehicle_CM_PackageManagement_RequiredServiceInstanceToMachine: service-instance=Instance/R_Vehicle_CM_PackageManagement, udp-port=63492
    Vehicle_CM_PackageManagement_RequiredServiceInstanceToMachine: service-instance=Instance/R_Vehicle_CM_PackageManagement, udp-port=63494
    Vehicle_DPM_Policy_ProvidedServiceInstanceToMachine: service-instance=Vehicle_DPM_Policy, udp-port=61441
    Vehicle_DPM_Policy_RequiredServiceInstanceToMachine: service-instance=Instance/R_Vehicle_DPM_Policy, udp-port=63493
    Vehicle_DPM_Policy_RequiredServiceInstanceToMachine: service-instance=Instance/R_Vehicle_DPM_Policy, udp-port=63498
    Vehicle_DPM_Policy_RequiredServiceInstanceToMachine: service-instance=Instance/R_Vehicle_DPM_Policy, udp-port=63496
    Vehicle_DPM_Policy_RequiredServiceInstanceToMachine: service-instance=Instance/R_Vehicle_DPM_Policy, udp-port=63495
    Vehicle_DPM_Policy_RequiredServiceInstanceToMachine: service-instance=Instance/R_Vehicle_DPM_Policy, udp-port=63497
    Vehicle_DPM_Policy_RequiredServiceInstanceToMachine: service-instance=Instance/R_Vehicle_DPM_Policy, udp-port=63492
    Vehicle_DPM_Policy_RequiredServiceInstanceToMachine: service-instance=Instance/R_Vehicle_DPM_Policy, udp-port=63494
    Vehicle_DPM_Policy_RequiredServiceInstanceToMachine: service-instance=Instance/R_Vehicle_DPM_Policy, udp-port=63499
    Vehicle_DiagMgr_RoutingDiag_ProvidedServiceInstanceToMachine: service-instance=Vehicle_DiagMgr_RoutingDiag, udp-port=61441
    Vehicle_DiagMgr_RoutingDiag_RequiredServiceInstanceToMachine: service-instance=Instance/R_Vehicle_DiagMgr_RoutingDiag, udp-port=63497
    Vehicle_DiagMgr_RoutingDiag_RequiredServiceInstanceToMachine: service-instance=Instance/R_Vehicle_DiagMgr_RoutingDiag, udp-port=63494
    Vehicle_DiagMgr_RoutingDiag_RequiredServiceInstanceToMachine: service-instance=Instance/R_Vehicle_DiagMgr_RoutingDiag, udp-port=63503
    Vehicle_DiagMgr_RoutingDiag_RequiredServiceInstanceToMachine: service-instance=Instance/R_Vehicle_DiagMgr_RoutingDiag, udp-port=63498
    Vehicle_DiagMgr_RoutingDiag_RequiredServiceInstanceToMachine: service-instance=Instance/R_Vehicle_DiagMgr_RoutingDiag, udp-port=63500
    Vehicle_DiagMgr_RoutingDiag_RequiredServiceInstanceToMachine: service-instance=Instance/R_Vehicle_DiagMgr_RoutingDiag, udp-port=63493
    Vehicle_DiagMgr_RoutingDiag_RequiredServiceInstanceToMachine: service-instance=Instance/R_Vehicle_DiagMgr_RoutingDiag, udp-port=63502
    Vehicle_DiagMgr_RoutingDiag_RequiredServiceInstanceToMachine: service-instance=Instance/R_Vehicle_DiagMgr_RoutingDiag, udp-port=63499
    Vehicle_DiagMgr_RoutingDiag_RequiredServiceInstanceToMachine: service-instance=Instance/R_Vehicle_DiagMgr_RoutingDiag, udp-port=63492
    Vehicle_DiagMgr_RoutingDiag_RequiredServiceInstanceToMachine: service-instance=Instance/R_Vehicle_DiagMgr_RoutingDiag, udp-port=63495
    Vehicle_DiagMgr_RoutingDiag_RequiredServiceInstanceToMachine: service-instance=Instance/R_Vehicle_DiagMgr_RoutingDiag, udp-port=63501
    Vehicle_DiagMgr_RoutingDiag_RequiredServiceInstanceToMachine: service-instance=Instance/R_Vehicle_DiagMgr_RoutingDiag, udp-port=63496
    Vehicle_DiagMgr_RoutingTP_ProvidedServiceInstanceToMachine: service-instance=Vehicle_DiagMgr_RoutingTP, udp-port=61441
    Vehicle_DiagMgr_RoutingTP_RequiredServiceInstanceToMachine: service-instance=R_Vehicle_DiagMgr_RoutingTP, udp-port=63492
    Vehicle_EIDS_EIDSDiagInfo_ProvidedServiceInstanceToMachine: service-instance=Vehicle_EIDS_EIDSDiagInfo, udp-port=61441
    Vehicle_EIDS_EIDSDiagInfo_RequiredServiceInstanceToMachine: service-instance=R_Vehicle_EIDS_EIDSDiagInfo, udp-port=63492
    Vehicle_EIDS_EIDSInfo_ProvidedServiceInstanceToMachine: service-instance=Vehicle_EIDS_EIDSInfo, udp-port=61441
    Vehicle_EIDS_EIDSInfo_RequiredServiceInstanceToMachine: service-instance=R_Vehicle_EIDS_EIDSInfo, udp-port=63492
    Vehicle_EIDS_ReportSender_ProvidedServiceInstanceToMachine: service-instance=Vehicle_EIDS_ReportSender, udp-port=61441
    Vehicle_EIDS_ReportSender_RequiredServiceInstanceToMachine: service-instance=R_Vehicle_EIDS_ReportSender, udp-port=63492
    Vehicle_EthHandler_EthernetSwitchMgr_ProvidedServiceInstanceToMachine: service-instance=Vehicle_EthHandler_EthernetSwitchMgr, udp-port=61441
    Vehicle_EthHandler_EthernetSwitchMgr_RequiredServiceInstanceToMachine: service-instance=Instance/R_Vehicle_EthHandler_EthernetSwitchMgr, udp-port=63494
    Vehicle_EthHandler_EthernetSwitchMgr_RequiredServiceInstanceToMachine: service-instance=Instance/R_Vehicle_EthHandler_EthernetSwitchMgr, udp-port=63501
    Vehicle_EthHandler_EthernetSwitchMgr_RequiredServiceInstanceToMachine: service-instance=Instance/R_Vehicle_EthHandler_EthernetSwitchMgr, udp-port=63495
    Vehicle_EthHandler_EthernetSwitchMgr_RequiredServiceInstanceToMachine: service-instance=Instance/R_Vehicle_EthHandler_EthernetSwitchMgr, udp-port=63499
    Vehicle_EthHandler_EthernetSwitchMgr_RequiredServiceInstanceToMachine: service-instance=Instance/R_Vehicle_EthHandler_EthernetSwitchMgr, udp-port=63492
    Vehicle_EthHandler_EthernetSwitchMgr_RequiredServiceInstanceToMachine: service-instance=Instance/R_Vehicle_EthHandler_EthernetSwitchMgr, udp-port=63497
    Vehicle_EthHandler_EthernetSwitchMgr_RequiredServiceInstanceToMachine: service-instance=Instance/R_Vehicle_EthHandler_EthernetSwitchMgr, udp-port=63498
    Vehicle_EthHandler_EthernetSwitchMgr_RequiredServiceInstanceToMachine: service-instance=Instance/R_Vehicle_EthHandler_EthernetSwitchMgr, udp-port=63493
    Vehicle_EthHandler_EthernetSwitchMgr_RequiredServiceInstanceToMachine: service-instance=Instance/R_Vehicle_EthHandler_EthernetSwitchMgr, udp-port=63496
    Vehicle_EthHandler_EthernetSwitchMgr_RequiredServiceInstanceToMachine: service-instance=Instance/R_Vehicle_EthHandler_EthernetSwitchMgr, udp-port=63500
    Vehicle_EthHandler_EthernetSwitchMgr_RequiredServiceInstanceToMachine: service-instance=Instance/R_Vehicle_EthHandler_EthernetSwitchMgr, udp-port=63503
    Vehicle_EthHandler_EthernetSwitchMgr_RequiredServiceInstanceToMachine: service-instance=Instance/R_Vehicle_EthHandler_EthernetSwitchMgr, udp-port=63502
    Vehicle_EthNM_NM_ProvidedServiceInstanceToMachine: service-instance=Vehicle_EthNM_NM, udp-port=61441
    Vehicle_EthNM_NM_RequiredServiceInstanceToMachine: service-instance=Instance/R_Vehicle_EthNM_NM, udp-port=63495
    Vehicle_EthNM_NM_RequiredServiceInstanceToMachine: service-instance=Instance/R_Vehicle_EthNM_NM, udp-port={63492..63494}
    Vehicle_EthNM_NM_RequiredServiceInstanceToMachine: service-instance=Instance/R_Vehicle_EthNM_NM, udp-port=63496
    Vehicle_FlashingAdaptor_PackageManagement_ProvidedServiceInstanceToMachine: service-instance=Vehicle_FlashingAdaptor_PackageManagement, udp-port=61441
    Vehicle_FlashingAdaptor_PackageManagement_RequiredServiceInstanceToMachine: service-instance=Instance/R_Vehicle_FlashingAdaptor_PackageManagement, udp-port=63493
    Vehicle_FlashingAdaptor_PackageManagement_RequiredServiceInstanceToMachine: service-instance=Instance/R_Vehicle_FlashingAdaptor_PackageManagement, udp-port=63492
    Vehicle_FoDClient_ActivationManager_ProvidedServiceInstanceToMachine: service-instance=Vehicle_FoDClient_ActivationManager, udp-port=61441
    Vehicle_FoDClient_ActivationManager_RequiredServiceInstanceToMachine: service-instance=R_Vehicle_FoDClient_ActivationManager, udp-port=63492
    Vehicle_FoDMaster_Support_ProvidedServiceInstanceToMachine: service-instance=Vehicle_FoDMaster_Support, udp-port=61441
    Vehicle_FoDMaster_Support_RequiredServiceInstanceToMachine: service-instance=Instance/R_Vehicle_FoDMaster_Support, udp-port=63492
    Vehicle_FoDMaster_Support_RequiredServiceInstanceToMachine: service-instance=Instance/R_Vehicle_FoDMaster_Support, udp-port=63493
    Vehicle_IPCHandler_RoutingIPC_ProvidedServiceInstanceToMachine: service-instance=Vehicle_IPCHandler_RoutingIPC, udp-port=61441
    Vehicle_IPCHandler_RoutingIPC_RequiredServiceInstanceToMachine: service-instance=Instance/R_Vehicle_IPCHandler_RoutingIPC, udp-port=63497
    Vehicle_IPCHandler_RoutingIPC_RequiredServiceInstanceToMachine: service-instance=Instance/R_Vehicle_IPCHandler_RoutingIPC, udp-port=63499
    Vehicle_IPCHandler_RoutingIPC_RequiredServiceInstanceToMachine: service-instance=Instance/R_Vehicle_IPCHandler_RoutingIPC, udp-port=63500
    Vehicle_IPCHandler_RoutingIPC_RequiredServiceInstanceToMachine: service-instance=Instance/R_Vehicle_IPCHandler_RoutingIPC, udp-port=63498
    Vehicle_IPCHandler_RoutingIPC_RequiredServiceInstanceToMachine: service-instance=Instance/R_Vehicle_IPCHandler_RoutingIPC, udp-port=63495
    Vehicle_IPCHandler_RoutingIPC_RequiredServiceInstanceToMachine: service-instance=Instance/R_Vehicle_IPCHandler_RoutingIPC, udp-port=63492
    Vehicle_IPCHandler_RoutingIPC_RequiredServiceInstanceToMachine: service-instance=Instance/R_Vehicle_IPCHandler_RoutingIPC, udp-port=63494
    Vehicle_IPCHandler_RoutingIPC_RequiredServiceInstanceToMachine: service-instance=Instance/R_Vehicle_IPCHandler_RoutingIPC, udp-port=63493
    Vehicle_IPCHandler_RoutingIPC_RequiredServiceInstanceToMachine: service-instance=Instance/R_Vehicle_IPCHandler_RoutingIPC, udp-port=63496
    Vehicle_LogCollection_DebugSnapshot_ProvidedServiceInstanceToMachine: service-instance=Vehicle_LogCollection_DebugSnapshot, udp-port=61441
    Vehicle_LogCollection_DebugSnapshot_RequiredServiceInstanceToMachine: service-instance=Instance/R_Vehicle_LogCollection_DebugSnapshot, udp-port=63494
    Vehicle_LogCollection_DebugSnapshot_RequiredServiceInstanceToMachine: service-instance=Instance/R_Vehicle_LogCollection_DebugSnapshot, udp-port=63499
    Vehicle_LogCollection_DebugSnapshot_RequiredServiceInstanceToMachine: service-instance=Instance/R_Vehicle_LogCollection_DebugSnapshot, udp-port=63493
    Vehicle_LogCollection_DebugSnapshot_RequiredServiceInstanceToMachine: service-instance=Instance/R_Vehicle_LogCollection_DebugSnapshot, udp-port={63496..63498}
    Vehicle_LogCollection_DebugSnapshot_RequiredServiceInstanceToMachine: service-instance=Instance/R_Vehicle_LogCollection_DebugSnapshot, udp-port=63500
    Vehicle_LogCollection_DebugSnapshot_RequiredServiceInstanceToMachine: service-instance=Instance/R_Vehicle_LogCollection_DebugSnapshot, udp-port=63492
    Vehicle_LogCollection_DebugSnapshot_RequiredServiceInstanceToMachine: service-instance=Instance/R_Vehicle_LogCollection_DebugSnapshot, udp-port=63495
    Vehicle_LogCollection_Logging_ProvidedServiceInstanceToMachine: service-instance=Vehicle_LogCollection_Logging, udp-port=61441
    Vehicle_LogCollection_Logging_RequiredServiceInstanceToMachine: service-instance=Instance/R_Vehicle_LogCollection_Logging, udp-port=63499
    Vehicle_LogCollection_Logging_RequiredServiceInstanceToMachine: service-instance=Instance/R_Vehicle_LogCollection_Logging, udp-port=63493
    Vehicle_LogCollection_Logging_RequiredServiceInstanceToMachine: service-instance=Instance/R_Vehicle_LogCollection_Logging, udp-port={63496..63498}
    Vehicle_LogCollection_Logging_RequiredServiceInstanceToMachine: service-instance=Instance/R_Vehicle_LogCollection_Logging, udp-port=63494
    Vehicle_LogCollection_Logging_RequiredServiceInstanceToMachine: service-instance=Instance/R_Vehicle_LogCollection_Logging, udp-port=63500
    Vehicle_LogCollection_Logging_RequiredServiceInstanceToMachine: service-instance=Instance/R_Vehicle_LogCollection_Logging, udp-port=63492
    Vehicle_LogCollection_Logging_RequiredServiceInstanceToMachine: service-instance=Instance/R_Vehicle_LogCollection_Logging, udp-port=63495
    Vehicle_MSM_APNManager_ProvidedServiceInstanceToMachine: service-instance=Vehicle_MSM_APNManager, udp-port=61441
    Vehicle_MSM_APNManager_RequiredServiceInstanceToMachine: service-instance=Instance/R_Vehicle_MSM_APNManager, udp-port=63495
    Vehicle_MSM_APNManager_RequiredServiceInstanceToMachine: service-instance=Instance/R_Vehicle_MSM_APNManager, udp-port=63494
    Vehicle_MSM_APNManager_RequiredServiceInstanceToMachine: service-instance=Instance/R_Vehicle_MSM_APNManager, udp-port=63493
    Vehicle_MSM_APNManager_RequiredServiceInstanceToMachine: service-instance=Instance/R_Vehicle_MSM_APNManager, udp-port=63492
    Vehicle_MSM_MessageManager_ProvidedServiceInstanceToMachine: service-instance=Vehicle_MSM_MessageManager, udp-port=61441
    Vehicle_MSM_MessageManager_RequiredServiceInstanceToMachine: service-instance=Instance/R_Vehicle_MSM_MessageManager, udp-port=63495
    Vehicle_MSM_MessageManager_RequiredServiceInstanceToMachine: service-instance=Instance/R_Vehicle_MSM_MessageManager, udp-port=63494
    Vehicle_MSM_MessageManager_RequiredServiceInstanceToMachine: service-instance=Instance/R_Vehicle_MSM_MessageManager, udp-port=63492
    Vehicle_MSM_MessageManager_RequiredServiceInstanceToMachine: service-instance=Instance/R_Vehicle_MSM_MessageManager, udp-port=63493
    Vehicle_MSM_ModemManager_ProvidedServiceInstanceToMachine: service-instance=Vehicle_MSM_ModemManager, udp-port=61441
    Vehicle_MSM_ModemManager_RequiredServiceInstanceToMachine: service-instance=Instance/R_Vehicle_MSM_ModemManager, udp-port=63494
    Vehicle_MSM_ModemManager_RequiredServiceInstanceToMachine: service-instance=Instance/R_Vehicle_MSM_ModemManager, udp-port=63493
    Vehicle_MSM_ModemManager_RequiredServiceInstanceToMachine: service-instance=Instance/R_Vehicle_MSM_ModemManager, udp-port=63492
    Vehicle_MSM_NetworkManager_ProvidedServiceInstanceToMachine: service-instance=Vehicle_MSM_NetworkManager, udp-port=61441
    Vehicle_MSM_NetworkManager_RequiredServiceInstanceToMachine: service-instance=Instance/R_Vehicle_MSM_NetworkManager, udp-port=63494
    Vehicle_MSM_NetworkManager_RequiredServiceInstanceToMachine: service-instance=Instance/R_Vehicle_MSM_NetworkManager, udp-port=63493
    Vehicle_MSM_NetworkManager_RequiredServiceInstanceToMachine: service-instance=Instance/R_Vehicle_MSM_NetworkManager, udp-port=63492
    Vehicle_MSM_SimManager_ProvidedServiceInstanceToMachine: service-instance=Vehicle_MSM_SimManager, udp-port=61441
    Vehicle_MSM_SimManager_RequiredServiceInstanceToMachine: service-instance=Instance/R_Vehicle_MSM_SimManager, udp-port=63495
    Vehicle_MSM_SimManager_RequiredServiceInstanceToMachine: service-instance=Instance/R_Vehicle_MSM_SimManager, udp-port=63494
    Vehicle_MSM_SimManager_RequiredServiceInstanceToMachine: service-instance=Instance/R_Vehicle_MSM_SimManager, udp-port=63493
    Vehicle_MSM_SimManager_RequiredServiceInstanceToMachine: service-instance=Instance/R_Vehicle_MSM_SimManager, udp-port=63492
    Vehicle_NSD_NonSleep_ProvidedServiceInstanceToMachine: service-instance=Vehicle_NSD_NonSleep, udp-port=61441
    Vehicle_NSD_NonSleep_RequiredServiceInstanceToMachine: service-instance=Instance/R_Vehicle_NSD_NonSleep, udp-port=63493
    Vehicle_NSD_NonSleep_RequiredServiceInstanceToMachine: service-instance=Instance/R_Vehicle_NSD_NonSleep, udp-port=63492
    Vehicle_RFSM_RemoteFileSystemManager_ProvidedServiceInstanceToMachine: service-instance=Vehicle_RFSM_RemoteFileSystemManager, udp-port=61441
    Vehicle_RFSM_RemoteFileSystemManager_RequiredServiceInstanceToMachine: service-instance=Instance/R_Vehicle_RFSM_RemoteFileSystemManager, udp-port={63492..63494}
    Vehicle_SDE_SelfDiagnosis_ProvidedServiceInstanceToMachine: service-instance=Vehicle_SDE_SelfDiagnosis, udp-port=61441
    Vehicle_SDE_SelfDiagnosis_RequiredServiceInstanceToMachine: service-instance=Instance/R_Vehicle_SDE_SelfDiagnosis, udp-port=63495
    Vehicle_SDE_SelfDiagnosis_RequiredServiceInstanceToMachine: service-instance=Instance/R_Vehicle_SDE_SelfDiagnosis, udp-port=63502
    Vehicle_SDE_SelfDiagnosis_RequiredServiceInstanceToMachine: service-instance=Instance/R_Vehicle_SDE_SelfDiagnosis, udp-port=63501
    Vehicle_SDE_SelfDiagnosis_RequiredServiceInstanceToMachine: service-instance=Instance/R_Vehicle_SDE_SelfDiagnosis, udp-port=63497
    Vehicle_SDE_SelfDiagnosis_RequiredServiceInstanceToMachine: service-instance=Instance/R_Vehicle_SDE_SelfDiagnosis, udp-port=63500
    Vehicle_SDE_SelfDiagnosis_RequiredServiceInstanceToMachine: service-instance=Instance/R_Vehicle_SDE_SelfDiagnosis, udp-port=63504
    Vehicle_SDE_SelfDiagnosis_RequiredServiceInstanceToMachine: service-instance=Instance/R_Vehicle_SDE_SelfDiagnosis, udp-port=63503
    Vehicle_SDE_SelfDiagnosis_RequiredServiceInstanceToMachine: service-instance=Instance/R_Vehicle_SDE_SelfDiagnosis, udp-port=63492
    Vehicle_SDE_SelfDiagnosis_RequiredServiceInstanceToMachine: service-instance=Instance/R_Vehicle_SDE_SelfDiagnosis, udp-port=63499
    Vehicle_SDE_SelfDiagnosis_RequiredServiceInstanceToMachine: service-instance=Instance/R_Vehicle_SDE_SelfDiagnosis, udp-port=63494
    Vehicle_SDE_SelfDiagnosis_RequiredServiceInstanceToMachine: service-instance=Instance/R_Vehicle_SDE_SelfDiagnosis, udp-port=63493
    Vehicle_SDE_SelfDiagnosis_RequiredServiceInstanceToMachine: service-instance=Instance/R_Vehicle_SDE_SelfDiagnosis, udp-port=63496
    Vehicle_SDE_SelfDiagnosis_RequiredServiceInstanceToMachine: service-instance=Instance/R_Vehicle_SDE_SelfDiagnosis, udp-port=63498
    Vehicle_SM_StateManager_ProvidedServiceInstanceToMachine: service-instance=Vehicle_SM_StateManager, udp-port=61441
    Vehicle_SM_StateManager_RequiredServiceInstanceToMachine: service-instance=Instance/R_Vehicle_SM_StateManager, udp-port=63496
    Vehicle_SM_StateManager_RequiredServiceInstanceToMachine: service-instance=Instance/R_Vehicle_SM_StateManager, udp-port=63509
    Vehicle_SM_StateManager_RequiredServiceInstanceToMachine: service-instance=Instance/R_Vehicle_SM_StateManager, udp-port={63511..63513}
    Vehicle_SM_StateManager_RequiredServiceInstanceToMachine: service-instance=Instance/R_Vehicle_SM_StateManager, udp-port=63515
    Vehicle_SM_StateManager_RequiredServiceInstanceToMachine: service-instance=Instance/R_Vehicle_SM_StateManager, udp-port=63505
    Vehicle_SM_StateManager_RequiredServiceInstanceToMachine: service-instance=Instance/R_Vehicle_SM_StateManager, udp-port=63495
    Vehicle_SM_StateManager_RequiredServiceInstanceToMachine: service-instance=Instance/R_Vehicle_SM_StateManager, udp-port=63516
    Vehicle_SM_StateManager_RequiredServiceInstanceToMachine: service-instance=Instance/R_Vehicle_SM_StateManager, udp-port=63514
    Vehicle_SM_StateManager_RequiredServiceInstanceToMachine: service-instance=Instance/R_Vehicle_SM_StateManager, udp-port=63504
    Vehicle_SM_StateManager_RequiredServiceInstanceToMachine: service-instance=Instance/R_Vehicle_SM_StateManager, udp-port=63499
    Vehicle_SM_StateManager_RequiredServiceInstanceToMachine: service-instance=Instance/R_Vehicle_SM_StateManager, udp-port=63492
    Vehicle_SM_StateManager_RequiredServiceInstanceToMachine: service-instance=Instance/R_Vehicle_SM_StateManager, udp-port=63503
    Vehicle_SM_StateManager_RequiredServiceInstanceToMachine: service-instance=Instance/R_Vehicle_SM_StateManager, udp-port=63506
    Vehicle_SM_StateManager_RequiredServiceInstanceToMachine: service-instance=Instance/R_Vehicle_SM_StateManager, udp-port=63494
    Vehicle_SM_StateManager_RequiredServiceInstanceToMachine: service-instance=Instance/R_Vehicle_SM_StateManager, udp-port=63493
    Vehicle_SM_StateManager_RequiredServiceInstanceToMachine: service-instance=Instance/R_Vehicle_SM_StateManager, udp-port=63502
    Vehicle_SM_StateManager_RequiredServiceInstanceToMachine: service-instance=Instance/R_Vehicle_SM_StateManager, udp-port=63497
    Vehicle_SM_StateManager_RequiredServiceInstanceToMachine: service-instance=Instance/R_Vehicle_SM_StateManager, udp-port=63507
    Vehicle_SM_StateManager_RequiredServiceInstanceToMachine: service-instance=Instance/R_Vehicle_SM_StateManager, udp-port=63517
    Vehicle_SM_StateManager_RequiredServiceInstanceToMachine: service-instance=Instance/R_Vehicle_SM_StateManager, udp-port=63501
    Vehicle_SM_StateManager_RequiredServiceInstanceToMachine: service-instance=Instance/R_Vehicle_SM_StateManager, udp-port=63498
    Vehicle_SM_StateManager_RequiredServiceInstanceToMachine: service-instance=Instance/R_Vehicle_SM_StateManager, udp-port=63508
    Vehicle_SM_StateManager_RequiredServiceInstanceToMachine: service-instance=Instance/R_Vehicle_SM_StateManager, udp-port=63510
    Vehicle_SM_StateManager_RequiredServiceInstanceToMachine: service-instance=Instance/R_Vehicle_SM_StateManager, udp-port=63500
    Vehicle_SOAAdaptor_Body1_ProvidedServiceInstanceToMachine: service-instance=Vehicle_SOAAdaptor_Body1, udp-port=61442
    Vehicle_SOAAdaptor_Body1_RequiredServiceInstanceToMachine: service-instance=Instance/R_Vehicle_SOAAdaptor_Body1, udp-port=63501
    Vehicle_SOAAdaptor_Body1_RequiredServiceInstanceToMachine: service-instance=Instance/R_Vehicle_SOAAdaptor_Body1, udp-port=63495
    Vehicle_SOAAdaptor_Body1_RequiredServiceInstanceToMachine: service-instance=Instance/R_Vehicle_SOAAdaptor_Body1, udp-port=63500
    Vehicle_SOAAdaptor_Body1_RequiredServiceInstanceToMachine: service-instance=Instance/R_Vehicle_SOAAdaptor_Body1, udp-port=63498
    Vehicle_SOAAdaptor_Body1_RequiredServiceInstanceToMachine: service-instance=Instance/R_Vehicle_SOAAdaptor_Body1, udp-port=63492
    Vehicle_SOAAdaptor_Body1_RequiredServiceInstanceToMachine: service-instance=Instance/R_Vehicle_SOAAdaptor_Body1, udp-port=63499
    Vehicle_SOAAdaptor_Body1_RequiredServiceInstanceToMachine: service-instance=Instance/R_Vehicle_SOAAdaptor_Body1, udp-port=63502
    Vehicle_SOAAdaptor_Body1_RequiredServiceInstanceToMachine: service-instance=Instance/R_Vehicle_SOAAdaptor_Body1, udp-port=63497
    Vehicle_SOAAdaptor_Body1_RequiredServiceInstanceToMachine: service-instance=Instance/R_Vehicle_SOAAdaptor_Body1, udp-port=63496
    Vehicle_SOAAdaptor_Body1_RequiredServiceInstanceToMachine: service-instance=Instance/R_Vehicle_SOAAdaptor_Body1, udp-port=63493
    Vehicle_SOAAdaptor_Body1_RequiredServiceInstanceToMachine: service-instance=Instance/R_Vehicle_SOAAdaptor_Body1, udp-port=63494
    Vehicle_SOAAdaptor_Body2_ProvidedServiceInstanceToMachine: service-instance=Vehicle_SOAAdaptor_Body2, udp-port=61443
    Vehicle_SOAAdaptor_Body2_RequiredServiceInstanceToMachine: service-instance=Instance/R_Vehicle_SOAAdaptor_Body2, udp-port=63498
    Vehicle_SOAAdaptor_Body2_RequiredServiceInstanceToMachine: service-instance=Instance/R_Vehicle_SOAAdaptor_Body2, udp-port=63496
    Vehicle_SOAAdaptor_Body2_RequiredServiceInstanceToMachine: service-instance=Instance/R_Vehicle_SOAAdaptor_Body2, udp-port=63492
    Vehicle_SOAAdaptor_Body2_RequiredServiceInstanceToMachine: service-instance=Instance/R_Vehicle_SOAAdaptor_Body2, udp-port=63497
    Vehicle_SOAAdaptor_Body2_RequiredServiceInstanceToMachine: service-instance=Instance/R_Vehicle_SOAAdaptor_Body2, udp-port=63495
    Vehicle_SOAAdaptor_Body2_RequiredServiceInstanceToMachine: service-instance=Instance/R_Vehicle_SOAAdaptor_Body2, udp-port=63494
    Vehicle_SOAAdaptor_Body2_RequiredServiceInstanceToMachine: service-instance=Instance/R_Vehicle_SOAAdaptor_Body2, udp-port=63493
    Vehicle_SOAAdaptor_CANoverIP_ProvidedServiceInstanceToMachine: service-instance=Vehicle_SOAAdaptor_CANoverIP, udp-port=61451
    Vehicle_SOAAdaptor_CANoverIP_RequiredServiceInstanceToMachine: service-instance=Instance/R_Vehicle_SOAAdaptor_CANoverIP, udp-port=63494
    Vehicle_SOAAdaptor_CANoverIP_RequiredServiceInstanceToMachine: service-instance=Instance/R_Vehicle_SOAAdaptor_CANoverIP, udp-port=63501
    Vehicle_SOAAdaptor_CANoverIP_RequiredServiceInstanceToMachine: service-instance=Instance/R_Vehicle_SOAAdaptor_CANoverIP, udp-port=63495
    Vehicle_SOAAdaptor_CANoverIP_RequiredServiceInstanceToMachine: service-instance=Instance/R_Vehicle_SOAAdaptor_CANoverIP, udp-port=63500
    Vehicle_SOAAdaptor_CANoverIP_RequiredServiceInstanceToMachine: service-instance=Instance/R_Vehicle_SOAAdaptor_CANoverIP, udp-port=63498
    Vehicle_SOAAdaptor_CANoverIP_RequiredServiceInstanceToMachine: service-instance=Instance/R_Vehicle_SOAAdaptor_CANoverIP, udp-port=63492
    Vehicle_SOAAdaptor_CANoverIP_RequiredServiceInstanceToMachine: service-instance=Instance/R_Vehicle_SOAAdaptor_CANoverIP, udp-port=63499
    Vehicle_SOAAdaptor_CANoverIP_RequiredServiceInstanceToMachine: service-instance=Instance/R_Vehicle_SOAAdaptor_CANoverIP, udp-port=63502
    Vehicle_SOAAdaptor_CANoverIP_RequiredServiceInstanceToMachine: service-instance=Instance/R_Vehicle_SOAAdaptor_CANoverIP, udp-port=63497
    Vehicle_SOAAdaptor_CANoverIP_RequiredServiceInstanceToMachine: service-instance=Instance/R_Vehicle_SOAAdaptor_CANoverIP, udp-port=63496
    Vehicle_SOAAdaptor_CANoverIP_RequiredServiceInstanceToMachine: service-instance=Instance/R_Vehicle_SOAAdaptor_CANoverIP, udp-port=63493
    Vehicle_SOAAdaptor_Chassis_ProvidedServiceInstanceToMachine: service-instance=Vehicle_SOAAdaptor_Chassis, udp-port=61450
    Vehicle_SOAAdaptor_Chassis_RequiredServiceInstanceToMachine: service-instance=Instance/R_Vehicle_SOAAdaptor_Chassis, udp-port=63498
    Vehicle_SOAAdaptor_Chassis_RequiredServiceInstanceToMachine: service-instance=Instance/R_Vehicle_SOAAdaptor_Chassis, udp-port=63496
    Vehicle_SOAAdaptor_Chassis_RequiredServiceInstanceToMachine: service-instance=Instance/R_Vehicle_SOAAdaptor_Chassis, udp-port=63492
    Vehicle_SOAAdaptor_Chassis_RequiredServiceInstanceToMachine: service-instance=Instance/R_Vehicle_SOAAdaptor_Chassis, udp-port=63497
    Vehicle_SOAAdaptor_Chassis_RequiredServiceInstanceToMachine: service-instance=Instance/R_Vehicle_SOAAdaptor_Chassis, udp-port=63499
    Vehicle_SOAAdaptor_Chassis_RequiredServiceInstanceToMachine: service-instance=Instance/R_Vehicle_SOAAdaptor_Chassis, udp-port=63495
    Vehicle_SOAAdaptor_Chassis_RequiredServiceInstanceToMachine: service-instance=Instance/R_Vehicle_SOAAdaptor_Chassis, udp-port=63494
    Vehicle_SOAAdaptor_Chassis_RequiredServiceInstanceToMachine: service-instance=Instance/R_Vehicle_SOAAdaptor_Chassis, udp-port=63493
    Vehicle_SOAAdaptor_DataCollection_ProvidedServiceInstanceToMachine: service-instance=Vehicle_SOAAdaptor_DataCollection, udp-port=61449
    Vehicle_SOAAdaptor_DataCollection_RequiredServiceInstanceToMachine: service-instance=Instance/R_Vehicle_SOAAdaptor_DataCollection, udp-port=63494
    Vehicle_SOAAdaptor_DataCollection_RequiredServiceInstanceToMachine: service-instance=Instance/R_Vehicle_SOAAdaptor_DataCollection, udp-port=63492
    Vehicle_SOAAdaptor_DataCollection_RequiredServiceInstanceToMachine: service-instance=Instance/R_Vehicle_SOAAdaptor_DataCollection, udp-port=63493
    Vehicle_SOAAdaptor_DynamicRouting_ProvidedServiceInstanceToMachine: service-instance=Vehicle_SOAAdaptor_DynamicRouting, udp-port=61454
    Vehicle_SOAAdaptor_Extended_ProvidedServiceInstanceToMachine: service-instance=Vehicle_SOAAdaptor_Extended, udp-port=61444
    Vehicle_SOAAdaptor_Extended_RequiredServiceInstanceToMachine: service-instance=Instance/R_Vehicle_SOAAdaptor_Extended, udp-port=63499
    Vehicle_SOAAdaptor_Extended_RequiredServiceInstanceToMachine: service-instance=Instance/R_Vehicle_SOAAdaptor_Extended, udp-port=63494
    Vehicle_SOAAdaptor_Extended_RequiredServiceInstanceToMachine: service-instance=Instance/R_Vehicle_SOAAdaptor_Extended, udp-port=63497
    Vehicle_SOAAdaptor_Extended_RequiredServiceInstanceToMachine: service-instance=Instance/R_Vehicle_SOAAdaptor_Extended, udp-port=63492
    Vehicle_SOAAdaptor_Extended_RequiredServiceInstanceToMachine: service-instance=Instance/R_Vehicle_SOAAdaptor_Extended, udp-port=63498
    Vehicle_SOAAdaptor_Extended_RequiredServiceInstanceToMachine: service-instance=Instance/R_Vehicle_SOAAdaptor_Extended, udp-port=63500
    Vehicle_SOAAdaptor_Extended_RequiredServiceInstanceToMachine: service-instance=Instance/R_Vehicle_SOAAdaptor_Extended, udp-port=63496
    Vehicle_SOAAdaptor_Extended_RequiredServiceInstanceToMachine: service-instance=Instance/R_Vehicle_SOAAdaptor_Extended, udp-port=63495
    Vehicle_SOAAdaptor_Extended_RequiredServiceInstanceToMachine: service-instance=Instance/R_Vehicle_SOAAdaptor_Extended, udp-port=63493
    Vehicle_SOAAdaptor_Location_ProvidedServiceInstanceToMachine: service-instance=Vehicle_SOAAdaptor_Location, udp-port=61448
    Vehicle_SOAAdaptor_Location_RequiredServiceInstanceToMachine: service-instance=R_Vehicle_SOAAdaptor_Location, udp-port=63495
    Vehicle_SOAAdaptor_Location_RequiredServiceInstanceToMachine: service-instance=R_Vehicle_SOAAdaptor_Location, udp-port=63492
    Vehicle_SOAAdaptor_Location_RequiredServiceInstanceToMachine: service-instance=R_Vehicle_SOAAdaptor_Location, udp-port=63496
    Vehicle_SOAAdaptor_Location_RequiredServiceInstanceToMachine: service-instance=R_Vehicle_SOAAdaptor_Location, udp-port=63494
    Vehicle_SOAAdaptor_Location_RequiredServiceInstanceToMachine: service-instance=R_Vehicle_SOAAdaptor_Location, udp-port=63493
    Vehicle_SOAAdaptor_Location_RequiredServiceInstanceToMachine: service-instance=R_Vehicle_SOAAdaptor_Location, udp-port=63497
    Vehicle_SOAAdaptor_MultiMedia_ProvidedServiceInstanceToMachine: service-instance=Vehicle_SOAAdaptor_MultiMedia, udp-port=61446
    Vehicle_SOAAdaptor_MultiMedia_RequiredServiceInstanceToMachine: service-instance=R_Vehicle_SOAAdaptor_MultiMedia, udp-port=63500
    Vehicle_SOAAdaptor_MultiMedia_RequiredServiceInstanceToMachine: service-instance=R_Vehicle_SOAAdaptor_MultiMedia, udp-port=63495
    Vehicle_SOAAdaptor_MultiMedia_RequiredServiceInstanceToMachine: service-instance=R_Vehicle_SOAAdaptor_MultiMedia, udp-port=63498
    Vehicle_SOAAdaptor_MultiMedia_RequiredServiceInstanceToMachine: service-instance=R_Vehicle_SOAAdaptor_MultiMedia, udp-port=63493
    Vehicle_SOAAdaptor_MultiMedia_RequiredServiceInstanceToMachine: service-instance=R_Vehicle_SOAAdaptor_MultiMedia, udp-port=63499
    Vehicle_SOAAdaptor_MultiMedia_RequiredServiceInstanceToMachine: service-instance=R_Vehicle_SOAAdaptor_MultiMedia, udp-port=63501
    Vehicle_SOAAdaptor_MultiMedia_RequiredServiceInstanceToMachine: service-instance=R_Vehicle_SOAAdaptor_MultiMedia, udp-port=63497
    Vehicle_SOAAdaptor_MultiMedia_RequiredServiceInstanceToMachine: service-instance=R_Vehicle_SOAAdaptor_MultiMedia, udp-port=63496
    Vehicle_SOAAdaptor_MultiMedia_RequiredServiceInstanceToMachine: service-instance=R_Vehicle_SOAAdaptor_MultiMedia, udp-port=63494
    Vehicle_SOAAdaptor_MultiMedia_RequiredServiceInstanceToMachine: service-instance=R_Vehicle_SOAAdaptor_MultiMedia, udp-port=63492
    Vehicle_SOAAdaptor_PowerTrain1_ProvidedServiceInstanceToMachine: service-instance=Vehicle_SOAAdaptor_PowerTrain1, udp-port=61447
    Vehicle_SOAAdaptor_PowerTrain1_RequiredServiceInstanceToMachine: service-instance=R_Vehicle_SOAAdaptor_PowerTrain1, udp-port=63499
    Vehicle_SOAAdaptor_PowerTrain1_RequiredServiceInstanceToMachine: service-instance=R_Vehicle_SOAAdaptor_PowerTrain1, udp-port=63498
    Vehicle_SOAAdaptor_PowerTrain1_RequiredServiceInstanceToMachine: service-instance=R_Vehicle_SOAAdaptor_PowerTrain1, udp-port=63496
    Vehicle_SOAAdaptor_PowerTrain1_RequiredServiceInstanceToMachine: service-instance=R_Vehicle_SOAAdaptor_PowerTrain1, udp-port=63492
    Vehicle_SOAAdaptor_PowerTrain1_RequiredServiceInstanceToMachine: service-instance=R_Vehicle_SOAAdaptor_PowerTrain1, udp-port=63497
    Vehicle_SOAAdaptor_PowerTrain1_RequiredServiceInstanceToMachine: service-instance=R_Vehicle_SOAAdaptor_PowerTrain1, udp-port=63500
    Vehicle_SOAAdaptor_PowerTrain1_RequiredServiceInstanceToMachine: service-instance=R_Vehicle_SOAAdaptor_PowerTrain1, udp-port=63495
    Vehicle_SOAAdaptor_PowerTrain1_RequiredServiceInstanceToMachine: service-instance=R_Vehicle_SOAAdaptor_PowerTrain1, udp-port=63494
    Vehicle_SOAAdaptor_PowerTrain1_RequiredServiceInstanceToMachine: service-instance=R_Vehicle_SOAAdaptor_PowerTrain1, udp-port=63493
    Vehicle_SOAAdaptor_PowerTrain2_ProvidedServiceInstanceToMachine: service-instance=Vehicle_SOAAdaptor_PowerTrain2, udp-port=61452
    Vehicle_SOAAdaptor_PowerTrain2_RequiredServiceInstanceToMachine: service-instance=R_Vehicle_SOAAdaptor_PowerTrain2, udp-port=63499
    Vehicle_SOAAdaptor_PowerTrain2_RequiredServiceInstanceToMachine: service-instance=R_Vehicle_SOAAdaptor_PowerTrain2, udp-port=63498
    Vehicle_SOAAdaptor_PowerTrain2_RequiredServiceInstanceToMachine: service-instance=R_Vehicle_SOAAdaptor_PowerTrain2, udp-port=63496
    Vehicle_SOAAdaptor_PowerTrain2_RequiredServiceInstanceToMachine: service-instance=R_Vehicle_SOAAdaptor_PowerTrain2, udp-port=63492
    Vehicle_SOAAdaptor_PowerTrain2_RequiredServiceInstanceToMachine: service-instance=R_Vehicle_SOAAdaptor_PowerTrain2, udp-port=63497
    Vehicle_SOAAdaptor_PowerTrain2_RequiredServiceInstanceToMachine: service-instance=R_Vehicle_SOAAdaptor_PowerTrain2, udp-port=63500
    Vehicle_SOAAdaptor_PowerTrain2_RequiredServiceInstanceToMachine: service-instance=R_Vehicle_SOAAdaptor_PowerTrain2, udp-port=63495
    Vehicle_SOAAdaptor_PowerTrain2_RequiredServiceInstanceToMachine: service-instance=R_Vehicle_SOAAdaptor_PowerTrain2, udp-port=63494
    Vehicle_SOAAdaptor_PowerTrain2_RequiredServiceInstanceToMachine: service-instance=R_Vehicle_SOAAdaptor_PowerTrain2, udp-port=63493
    Vehicle_Security_ASKMaster_ProvidedServiceInstanceToMachine: service-instance=Vehicle_Security_ASKMaster, udp-port=61441
    Vehicle_Security_ASKMaster_RequiredServiceInstanceToMachine: service-instance=R_Vehicle_Security_ASKMaster, udp-port=63493
    Vehicle_Security_ASKMaster_RequiredServiceInstanceToMachine: service-instance=R_Vehicle_Security_ASKMaster, udp-port=63496
    Vehicle_Security_ASKMaster_RequiredServiceInstanceToMachine: service-instance=R_Vehicle_Security_ASKMaster, udp-port=63494
    Vehicle_Security_ASKMaster_RequiredServiceInstanceToMachine: service-instance=R_Vehicle_Security_ASKMaster, udp-port=63495
    Vehicle_Security_ASKMaster_RequiredServiceInstanceToMachine: service-instance=R_Vehicle_Security_ASKMaster, udp-port=63492
    Vehicle_Security_EcDec_ProvidedServiceInstanceToMachine: service-instance=Vehicle_Security_EcDec, udp-port=61441
    Vehicle_Security_EcDec_RequiredServiceInstanceToMachine: service-instance=R_Vehicle_Security_EcDec, udp-port=63493
    Vehicle_Security_EcDec_RequiredServiceInstanceToMachine: service-instance=R_Vehicle_Security_EcDec, udp-port=63495
    Vehicle_Security_EcDec_RequiredServiceInstanceToMachine: service-instance=R_Vehicle_Security_EcDec, udp-port=63497
    Vehicle_Security_EcDec_RequiredServiceInstanceToMachine: service-instance=R_Vehicle_Security_EcDec, udp-port=63496
    Vehicle_Security_EcDec_RequiredServiceInstanceToMachine: service-instance=R_Vehicle_Security_EcDec, udp-port=63494
    Vehicle_Security_EcDec_RequiredServiceInstanceToMachine: service-instance=R_Vehicle_Security_EcDec, udp-port=63492
    Vehicle_Security_EcDec_RequiredServiceInstanceToMachine: service-instance=R_Vehicle_Security_EcDec, udp-port=63499
    Vehicle_Security_EcDec_RequiredServiceInstanceToMachine: service-instance=R_Vehicle_Security_EcDec, udp-port=63500
    Vehicle_Security_EcDec_RequiredServiceInstanceToMachine: service-instance=R_Vehicle_Security_EcDec, udp-port=63498
    Vehicle_Security_EcDec_RequiredServiceInstanceToMachine: service-instance=R_Vehicle_Security_EcDec, udp-port=63501
    Vehicle_Security_IVPA_ProvidedServiceInstanceToMachine: service-instance=Vehicle_Security_IVPA, udp-port=61441
    Vehicle_Security_IVPA_RequiredServiceInstanceToMachine: service-instance=R_Vehicle_Security_IVPA, udp-port=63492
    Vehicle_Security_MassProc_ProvidedServiceInstanceToMachine: service-instance=Vehicle_Security_MassProc, udp-port=61441
    Vehicle_Security_MassProc_RequiredServiceInstanceToMachine: service-instance=R_Vehicle_Security_MassProc, udp-port=63492
    Vehicle_Security_OEUK_ProvidedServiceInstanceToMachine: service-instance=Vehicle_Security_OEUK, udp-port=61441
    Vehicle_Security_OEUK_RequiredServiceInstanceToMachine: service-instance=R_Vehicle_Security_OEUK, udp-port=63494
    Vehicle_Security_OEUK_RequiredServiceInstanceToMachine: service-instance=R_Vehicle_Security_OEUK, udp-port=63493
    Vehicle_Security_OEUK_RequiredServiceInstanceToMachine: service-instance=R_Vehicle_Security_OEUK, udp-port=63492
    Vehicle_Security_SecureFlash2_ProvidedServiceInstanceToMachine: service-instance=Vehicle_Security_SecureFlash2, udp-port=61441
    Vehicle_Security_SecureFlash2_RequiredServiceInstanceToMachine: service-instance=R_Vehicle_Security_SecureFlash2, udp-port=63496
    Vehicle_Security_SecureFlash2_RequiredServiceInstanceToMachine: service-instance=R_Vehicle_Security_SecureFlash2, udp-port=63492
    Vehicle_Security_SecureFlash2_RequiredServiceInstanceToMachine: service-instance=R_Vehicle_Security_SecureFlash2, udp-port=63497
    Vehicle_Security_SecureFlash2_RequiredServiceInstanceToMachine: service-instance=R_Vehicle_Security_SecureFlash2, udp-port=63494
    Vehicle_Security_SecureFlash2_RequiredServiceInstanceToMachine: service-instance=R_Vehicle_Security_SecureFlash2, udp-port=63493
    Vehicle_Security_SecureFlash2_RequiredServiceInstanceToMachine: service-instance=R_Vehicle_Security_SecureFlash2, udp-port=63495
    Vehicle_Security_SecureFlash2_RequiredServiceInstanceToMachine: service-instance=R_Vehicle_Security_SecureFlash2, udp-port=63498
    Vehicle_SelfUpdateEngine_DeltaUpdate_ProvidedServiceInstanceToMachine: service-instance=Vehicle_SelfUpdateEngine_DeltaUpdate, udp-port=61441
    Vehicle_SelfUpdateEngine_DeltaUpdate_RequiredServiceInstanceToMachine: service-instance=R_Vehicle_SelfUpdateEngine_DeltaUpdate, udp-port=63494
    Vehicle_SelfUpdateEngine_DeltaUpdate_RequiredServiceInstanceToMachine: service-instance=R_Vehicle_SelfUpdateEngine_DeltaUpdate, udp-port=63492
    Vehicle_SelfUpdateEngine_DeltaUpdate_RequiredServiceInstanceToMachine: service-instance=R_Vehicle_SelfUpdateEngine_DeltaUpdate, udp-port=63493
    Vehicle_SharedStorage_Share_ProvidedServiceInstanceToMachine: service-instance=Vehicle_SharedStorage_Share, udp-port=61441
    Vehicle_SharedStorage_Share_RequiredServiceInstanceToMachine: service-instance=R_Vehicle_SharedStorage_Share, udp-port=63493
    Vehicle_SharedStorage_Share_RequiredServiceInstanceToMachine: service-instance=R_Vehicle_SharedStorage_Share, udp-port=63496
    Vehicle_SharedStorage_Share_RequiredServiceInstanceToMachine: service-instance=R_Vehicle_SharedStorage_Share, udp-port=63494
    Vehicle_SharedStorage_Share_RequiredServiceInstanceToMachine: service-instance=R_Vehicle_SharedStorage_Share, udp-port=63492
    Vehicle_SharedStorage_Share_RequiredServiceInstanceToMachine: service-instance=R_Vehicle_SharedStorage_Share, udp-port=63495
    Vehicle_SharedStorage_Share_RequiredServiceInstanceToMachine: service-instance=R_Vehicle_SharedStorage_Share, udp-port=63497
    Vehicle_SharedStorage_Status_ProvidedServiceInstanceToMachine: service-instance=Vehicle_SharedStorage_Status, udp-port=61441
    Vehicle_SharedStorage_Status_RequiredServiceInstanceToMachine: service-instance=R_Vehicle_SharedStorage_Status, udp-port={63492..63494}
    Vehicle_TAD_NetManager_ProvidedServiceInstanceToMachine: service-instance=Vehicle_TAD_NetManager, udp-port=61441
    Vehicle_TAD_NetManager_RequiredServiceInstanceToMachine: service-instance=R_Vehicle_TAD_NetManager, udp-port=63492
    Vehicle_TAD_NetManager_RequiredServiceInstanceToMachine: service-instance=R_Vehicle_TAD_NetManager, udp-port=63493
    Vehicle_Telemanager_Communicator_ProvidedServiceInstanceToMachine: service-instance=Vehicle_Telemanager_Communicator, udp-port=61441
    Vehicle_Telemanager_Communicator_RequiredServiceInstanceToMachine: service-instance=R_Vehicle_Telemanager_Communicator, udp-port=63492
    Vehicle_Telemanager_Communicator_RequiredServiceInstanceToMachine: service-instance=R_Vehicle_Telemanager_Communicator, udp-port=63494
    Vehicle_Telemanager_Communicator_RequiredServiceInstanceToMachine: service-instance=R_Vehicle_Telemanager_Communicator, udp-port=63495
    Vehicle_Telemanager_Communicator_RequiredServiceInstanceToMachine: service-instance=R_Vehicle_Telemanager_Communicator, udp-port=63493
    Vehicle_Telemanager_HTTPSimple_ProvidedServiceInstanceToMachine: service-instance=Vehicle_Telemanager_HTTPSimple, udp-port=61441
    Vehicle_Telemanager_HTTPSimple_RequiredServiceInstanceToMachine: service-instance=R_Vehicle_Telemanager_HTTPSimple, udp-port=63494
    Vehicle_Telemanager_HTTPSimple_RequiredServiceInstanceToMachine: service-instance=R_Vehicle_Telemanager_HTTPSimple, udp-port=63497
    Vehicle_Telemanager_HTTPSimple_RequiredServiceInstanceToMachine: service-instance=R_Vehicle_Telemanager_HTTPSimple, udp-port=63493
    Vehicle_Telemanager_HTTPSimple_RequiredServiceInstanceToMachine: service-instance=R_Vehicle_Telemanager_HTTPSimple, udp-port=63498
    Vehicle_Telemanager_HTTPSimple_RequiredServiceInstanceToMachine: service-instance=R_Vehicle_Telemanager_HTTPSimple, udp-port=63496
    Vehicle_Telemanager_HTTPSimple_RequiredServiceInstanceToMachine: service-instance=R_Vehicle_Telemanager_HTTPSimple, udp-port=63495
    Vehicle_Telemanager_HTTPSimple_RequiredServiceInstanceToMachine: service-instance=R_Vehicle_Telemanager_HTTPSimple, udp-port=63492
    Vehicle_Telemanager_HTTPSimple_RequiredServiceInstanceToMachine: service-instance=R_Vehicle_Telemanager_HTTPSimple, udp-port=63499
    Vehicle_Telemanager_HTTP_ProvidedServiceInstanceToMachine: service-instance=Vehicle_Telemanager_HTTP, udp-port=61441
    Vehicle_Telemanager_HTTP_RequiredServiceInstanceToMachine: service-instance=R_Vehicle_Telemanager_HTTP, udp-port=63496
    Vehicle_Telemanager_HTTP_RequiredServiceInstanceToMachine: service-instance=R_Vehicle_Telemanager_HTTP, udp-port=63500
    Vehicle_Telemanager_HTTP_RequiredServiceInstanceToMachine: service-instance=R_Vehicle_Telemanager_HTTP, udp-port=63503
    Vehicle_Telemanager_HTTP_RequiredServiceInstanceToMachine: service-instance=R_Vehicle_Telemanager_HTTP, udp-port=63494
    Vehicle_Telemanager_HTTP_RequiredServiceInstanceToMachine: service-instance=R_Vehicle_Telemanager_HTTP, udp-port=63505
    Vehicle_Telemanager_HTTP_RequiredServiceInstanceToMachine: service-instance=R_Vehicle_Telemanager_HTTP, udp-port=63501
    Vehicle_Telemanager_HTTP_RequiredServiceInstanceToMachine: service-instance=R_Vehicle_Telemanager_HTTP, udp-port=63498
    Vehicle_Telemanager_HTTP_RequiredServiceInstanceToMachine: service-instance=R_Vehicle_Telemanager_HTTP, udp-port=63492
    Vehicle_Telemanager_HTTP_RequiredServiceInstanceToMachine: service-instance=R_Vehicle_Telemanager_HTTP, udp-port=63507
    Vehicle_Telemanager_MQTT_ProvidedServiceInstanceToMachine: service-instance=Vehicle_Telemanager_MQTT, udp-port=61441
    Vehicle_Telemanager_MQTT_RequiredServiceInstanceToMachine: service-instance=R_Vehicle_Telemanager_MQTT, udp-port=63494
    Vehicle_Telemanager_MQTT_RequiredServiceInstanceToMachine: service-instance=R_Vehicle_Telemanager_MQTT, udp-port=63496
    Vehicle_Telemanager_MQTT_RequiredServiceInstanceToMachine: service-instance=R_Vehicle_Telemanager_MQTT, udp-port=63498
    Vehicle_Telemanager_MQTT_RequiredServiceInstanceToMachine: service-instance=R_Vehicle_Telemanager_MQTT, udp-port=63493
    Vehicle_Telemanager_MQTT_RequiredServiceInstanceToMachine: service-instance=R_Vehicle_Telemanager_MQTT, udp-port=63500
    Vehicle_Telemanager_MQTT_RequiredServiceInstanceToMachine: service-instance=R_Vehicle_Telemanager_MQTT, udp-port=63497
    Vehicle_Telemanager_MQTT_RequiredServiceInstanceToMachine: service-instance=R_Vehicle_Telemanager_MQTT, udp-port=63495
    Vehicle_Telemanager_MQTT_RequiredServiceInstanceToMachine: service-instance=R_Vehicle_Telemanager_MQTT, udp-port=63492
    Vehicle_Telemanager_MQTT_RequiredServiceInstanceToMachine: service-instance=R_Vehicle_Telemanager_MQTT, udp-port=63499
    Vehicle_Telemanager_MobileMessage_ProvidedServiceInstanceToMachine: service-instance=Vehicle_Telemanager_MobileMessage, udp-port=61441
    Vehicle_Telemanager_MobileMessage_RequiredServiceInstanceToMachine: service-instance=R_Vehicle_Telemanager_MobileMessage, udp-port=63494
    Vehicle_Telemanager_MobileMessage_RequiredServiceInstanceToMachine: service-instance=R_Vehicle_Telemanager_MobileMessage, udp-port=63493
    Vehicle_Telemanager_MobileMessage_RequiredServiceInstanceToMachine: service-instance=R_Vehicle_Telemanager_MobileMessage, udp-port=63492
    Vehicle_Telemanager_Provisioning_ProvidedServiceInstanceToMachine: service-instance=Vehicle_Telemanager_Provisioning, udp-port=61441
    Vehicle_Telemanager_Provisioning_RequiredServiceInstanceToMachine: service-instance=R_Vehicle_Telemanager_Provisioning, udp-port=63495
    Vehicle_Telemanager_Provisioning_RequiredServiceInstanceToMachine: service-instance=R_Vehicle_Telemanager_Provisioning, udp-port=63499
    Vehicle_Telemanager_Provisioning_RequiredServiceInstanceToMachine: service-instance=R_Vehicle_Telemanager_Provisioning, udp-port=63500
    Vehicle_Telemanager_Provisioning_RequiredServiceInstanceToMachine: service-instance=R_Vehicle_Telemanager_Provisioning, udp-port=63502
    Vehicle_Telemanager_Provisioning_RequiredServiceInstanceToMachine: service-instance=R_Vehicle_Telemanager_Provisioning, udp-port=63498
    Vehicle_Telemanager_Provisioning_RequiredServiceInstanceToMachine: service-instance=R_Vehicle_Telemanager_Provisioning, udp-port=63494
    Vehicle_Telemanager_Provisioning_RequiredServiceInstanceToMachine: service-instance=R_Vehicle_Telemanager_Provisioning, udp-port=63503
    Vehicle_Telemanager_Provisioning_RequiredServiceInstanceToMachine: service-instance=R_Vehicle_Telemanager_Provisioning, udp-port=63501
    Vehicle_Telemanager_Provisioning_RequiredServiceInstanceToMachine: service-instance=R_Vehicle_Telemanager_Provisioning, udp-port=63497
    Vehicle_Telemanager_Provisioning_RequiredServiceInstanceToMachine: service-instance=R_Vehicle_Telemanager_Provisioning, udp-port=63496
    Vehicle_Telemanager_Provisioning_RequiredServiceInstanceToMachine: service-instance=R_Vehicle_Telemanager_Provisioning, udp-port=63492
    Vehicle_Telemanager_Provisioning_RequiredServiceInstanceToMachine: service-instance=R_Vehicle_Telemanager_Provisioning, udp-port=63505
    Vehicle_Telemanager_Provisioning_RequiredServiceInstanceToMachine: service-instance=R_Vehicle_Telemanager_Provisioning, udp-port=63493
    Vehicle_Telemanager_Provisioning_RequiredServiceInstanceToMachine: service-instance=R_Vehicle_Telemanager_Provisioning, udp-port=63504
    Vehicle_TraceEngine_Log_ProvidedServiceInstanceToMachine: service-instance=Vehicle_TraceEngine_Log, udp-port=61441
    Vehicle_TraceEngine_Log_RequiredServiceInstanceToMachine: service-instance=R_Vehicle_TraceEngine_Log, udp-port=63492
    Vehicle_TraceEngine_Log_RequiredServiceInstanceToMachine: service-instance=R_Vehicle_TraceEngine_Log, udp-port=63493
    Vehicle_UpdateMaster_PackageManagement_ProvidedServiceInstanceToMachine: service-instance=Vehicle_UpdateMaster_PackageManagement, udp-port=61441
    Vehicle_UpdateMaster_PackageManagement_RequiredServiceInstanceToMachine: service-instance=R_Vehicle_UpdateMaster_PackageManagement, udp-port=63497
    Vehicle_UpdateMaster_PackageManagement_RequiredServiceInstanceToMachine: service-instance=R_Vehicle_UpdateMaster_PackageManagement, udp-port=63498
    Vehicle_UpdateMaster_PackageManagement_RequiredServiceInstanceToMachine: service-instance=R_Vehicle_UpdateMaster_PackageManagement, udp-port=63495
    Vehicle_UpdateMaster_PackageManagement_RequiredServiceInstanceToMachine: service-instance=R_Vehicle_UpdateMaster_PackageManagement, udp-port=63499
    Vehicle_UpdateMaster_PackageManagement_RequiredServiceInstanceToMachine: service-instance=R_Vehicle_UpdateMaster_PackageManagement, udp-port=63500
    Vehicle_UpdateMaster_PackageManagement_RequiredServiceInstanceToMachine: service-instance=R_Vehicle_UpdateMaster_PackageManagement, udp-port=63493
    Vehicle_UpdateMaster_PackageManagement_RequiredServiceInstanceToMachine: service-instance=R_Vehicle_UpdateMaster_PackageManagement, udp-port=63492
    Vehicle_UpdateMaster_PackageManagement_RequiredServiceInstanceToMachine: service-instance=R_Vehicle_UpdateMaster_PackageManagement, udp-port=63494
    Vehicle_UpdateMaster_PackageManagement_RequiredServiceInstanceToMachine: service-instance=R_Vehicle_UpdateMaster_PackageManagement, udp-port=63496
    Vehicle_UpdateMaster_PackageManagement_RequiredServiceInstanceToMachine: service-instance=R_Vehicle_UpdateMaster_PackageManagement, udp-port=63501
    Vehicle_VAM_Mode_ProvidedServiceInstanceToMachine: service-instance=Vehicle_VAM_Mode, udp-port=61441
    Vehicle_VAM_Mode_RequiredServiceInstanceToMachine: service-instance=R_Vehicle_VAM_Mode, udp-port=63492
    Vehicle_VAS_VehicleAPI_ProvidedServiceInstanceToMachine: service-instance=Vehicle_VAS_VehicleAPI, udp-port=61441
    Vehicle_VAS_VehicleAPI_RequiredServiceInstanceToMachine: service-instance=R_Vehicle_VAS_VehicleAPI, udp-port=63493
    Vehicle_VAS_VehicleAPI_RequiredServiceInstanceToMachine: service-instance=R_Vehicle_VAS_VehicleAPI, udp-port=63492
    Vehicle_VSM_SafeStatusManagement_ProvidedServiceInstanceToMachine: service-instance=Vehicle_VSM_SafeStatusManagement, udp-port=61441
    Vehicle_VSM_SafeStatusManagement_RequiredServiceInstanceToMachine: service-instance=R_Vehicle_VSM_SafeStatusManagement, udp-port=63493
    Vehicle_VSM_SafeStatusManagement_RequiredServiceInstanceToMachine: service-instance=R_Vehicle_VSM_SafeStatusManagement, udp-port=63494
    Vehicle_VSM_SafeStatusManagement_RequiredServiceInstanceToMachine: service-instance=R_Vehicle_VSM_SafeStatusManagement, udp-port=63492
    Vehicle_VSUA_UdsReprogram_ProvidedServiceInstanceToMachine: service-instance=Vehicle_VSUA_UdsReprogram, udp-port=61441
    Vehicle_VSUA_UdsReprogram_RequiredServiceInstanceToMachine: service-instance=R_Vehicle_VSUA_UdsReprogram, udp-port=63492
    Vehicle_VSUA_UdsReprogram_RequiredServiceInstanceToMachine: service-instance=R_Vehicle_VSUA_UdsReprogram, udp-port=63493
    Vehicle_Vcc_Manager_ProvidedServiceInstanceToMachine: service-instance=Vehicle_Vcc_Manager, udp-port=61441
    Vehicle_Vcc_Manager_RequiredServiceInstanceToMachine: service-instance=R_Vehicle_Vcc_Manager, udp-port=63494
    Vehicle_Vcc_Manager_RequiredServiceInstanceToMachine: service-instance=R_Vehicle_Vcc_Manager, udp-port=63498
    Vehicle_Vcc_Manager_RequiredServiceInstanceToMachine: service-instance=R_Vehicle_Vcc_Manager, udp-port=63500
    Vehicle_Vcc_Manager_RequiredServiceInstanceToMachine: service-instance=R_Vehicle_Vcc_Manager, udp-port=63493
    Vehicle_Vcc_Manager_RequiredServiceInstanceToMachine: service-instance=R_Vehicle_Vcc_Manager, udp-port=63501
    Vehicle_Vcc_Manager_RequiredServiceInstanceToMachine: service-instance=R_Vehicle_Vcc_Manager, udp-port=63499
    Vehicle_Vcc_Manager_RequiredServiceInstanceToMachine: service-instance=R_Vehicle_Vcc_Manager, udp-port=63495
    Vehicle_Vcc_Manager_RequiredServiceInstanceToMachine: service-instance=R_Vehicle_Vcc_Manager, udp-port=63492
    Vehicle_Vcc_Manager_RequiredServiceInstanceToMachine: service-instance=R_Vehicle_Vcc_Manager, udp-port=63497
    Vehicle_Vcc_Manager_RequiredServiceInstanceToMachine: service-instance=R_Vehicle_Vcc_Manager, udp-port=63502
    Vehicle_Vcc_Manager_RequiredServiceInstanceToMachine: service-instance=R_Vehicle_Vcc_Manager, udp-port=63496
    Vehicle_Vcc_NetworkStatistics_ProvidedServiceInstanceToMachine: service-instance=Vehicle_Vcc_NetworkStatistics, udp-port=61441
    Vehicle_Vcc_NetworkStatistics_RequiredServiceInstanceToMachine: service-instance=R_Vehicle_Vcc_NetworkStatistics, udp-port=63493
    Vehicle_Vcc_NetworkStatistics_RequiredServiceInstanceToMachine: service-instance=R_Vehicle_Vcc_NetworkStatistics, udp-port=63492
    Vehicle_Vcc_NetworkStatistics_RequiredServiceInstanceToMachine: service-instance=R_Vehicle_Vcc_NetworkStatistics, udp-port=63494
    Vehicle_Vcc_Policy_ProvidedServiceInstanceToMachine: service-instance=Vehicle_Vcc_Policy, udp-port=61441
    Vehicle_Vcc_Policy_RequiredServiceInstanceToMachine: service-instance=R_Vehicle_Vcc_Policy, udp-port=63494
    Vehicle_Vcc_Policy_RequiredServiceInstanceToMachine: service-instance=R_Vehicle_Vcc_Policy, udp-port=63496
    Vehicle_Vcc_Policy_RequiredServiceInstanceToMachine: service-instance=R_Vehicle_Vcc_Policy, udp-port=63498
    Vehicle_Vcc_Policy_RequiredServiceInstanceToMachine: service-instance=R_Vehicle_Vcc_Policy, udp-port=63499
    Vehicle_Vcc_Policy_RequiredServiceInstanceToMachine: service-instance=R_Vehicle_Vcc_Policy, udp-port=63493
    Vehicle_Vcc_Policy_RequiredServiceInstanceToMachine: service-instance=R_Vehicle_Vcc_Policy, udp-port=63492
    Vehicle_Vcc_Policy_RequiredServiceInstanceToMachine: service-instance=R_Vehicle_Vcc_Policy, udp-port=63495
    Vehicle_Vcc_Policy_RequiredServiceInstanceToMachine: service-instance=R_Vehicle_Vcc_Policy, udp-port=63497
    Vehicle_Vcc_ServiceGroup_ProvidedServiceInstanceToMachine: service-instance=Vehicle_Vcc_ServiceGroup, udp-port=61441
    Vehicle_Vcc_ServiceGroup_RequiredServiceInstanceToMachine: service-instance=R_Vehicle_Vcc_ServiceGroup, udp-port=63492
