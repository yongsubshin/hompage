AUTOSAR XML (schema 00049)
package /SwComponent/AdaptiveApplication
  adaptive application sw component type CM
  adaptive application sw component type Consumer
    require port RPort: required-interface=TestSrv
  adaptive application sw component type Provider
    provide port PPort: provided-interface=TestSrv
package /AdaptiveApplication/DltConfig
  6 x dlt log channel to process mapping:
    DltLogChannelToProcessMapping_CM_TO_CM: dlt-log-channel=CM, process=CM
    DltLogChannelToProcessMapping_Consumer1_TO_Consumer1: dlt-log-channel=Consumer, process=Consumer
    DltLogChannelToProcessMapping_EM_TO_EM: dlt-log-channel=EM, process=EM
    DltLogChannelToProcessMapping_Provider2_TO_Provider2: dlt-log-channel=Provider2, process=Provider2
    DltLogChannelToProcessMapping_Provider3_TO_Provider3: dlt-log-channel=Provider3, process=Provider3
    DltLogChannelToProcessMapping_Provider_TO_Provider: dlt-log-channel=Provider1, process=Provider1
package /AdaptiveApplication/Executable
  6 x executable, all with logging-behavior=USES-LOGGING, reporting-behavior=REPORTS-EXECUTION-STATE, version=1.0.0:
    CM: category=PLATFORM_LEVEL
      root sw component prototype PARA: application-type=CM
    Consumer: category=APPLICATION_LEVEL
      root sw component prototype AA: application-type=Consumer
    EM: category=PLATFORM_LEVEL, build-type=BUILD-TYPE-RELEASE
    Provider1: category=APPLICATION_LEVEL
      root sw component prototype AA: application-type=Provider
    Provider2: category=APPLICATION_LEVEL
      root sw component prototype AA: application-type=Provider
    Provider3: category=APPLICATION_LEVEL
      root sw component prototype AA: application-type=Provider
package /AdaptiveApplication/Manifest
  4 x service instance to port prototype mapping:
    Consumer_AA_RPort: port-prototype=AA.RPort, service-instance=Consumer_TestSrv
    Provider{1..3}_AA_PPort: port-prototype=AA.PPort, service-instance=Provider_TestSrv{1..3}
package /AdaptiveApplication/Process
  6 x process:
    CM: executable=CM, state-dependent-startup-config{function-group-state=[MachineFG.Startup, MachineFG.Shutdown, MachineFG.Restart, MachineFG.Verify], resource-group=ResourceGroup, startup-config=CM}
      process state machine CM: type=ProcessState
    Consumer: executable=Consumer, state-dependent-startup-config{execution-dependency=CM.Running, function-group-state=MachineFG.Startup, resource-group=ResourceGroup, startup-config=Consumer}
      process state machine Consumer: type=ProcessState
    EM: executable=EM
    Provider1: executable=Provider1, state-dependent-startup-config{execution-dependency=CM.Running, function-group-state=MachineFG.Startup, resource-group=ResourceGroup, startup-config=Provider1}
      process state machine Provider1: type=ProcessState
    Provider2: executable=Provider2, state-dependent-startup-config{execution-dependency=CM.Running, function-group-state=MachineFG.Startup, resource-group=ResourceGroup, startup-config=Provider2}
      process state machine Provider2: type=ProcessState
    Provider3: executable=Provider3, state-dependent-startup-config{execution-dependency=CM.Running, function-group-state=MachineFG.Startup, resource-group=ResourceGroup, startup-config=Provider3}
      process state machine Provider3: type=ProcessState
package /AdaptiveApplication/StartupConfig
  startup config set StartupConfigSet
    5 x startup config, all with scheduling-policy=SCHED_OTHER, scheduling-priority=0, timeout={enter-timeout-value=1.0, exit-timeout-value=1.0}:
      CM
      Consumer
      Provider{1..3}
package /DataType/Implementation/CPP
  14 x std cpp implementation data type:
    ArithmeticType: compu {0=Add, 1=Sub, 2=Mul, 3=Div}, type-reference=uint8_t
      namespaces:
        symbol props ptest
        symbol props type
    TString: category=STRING
      namespaces:
        symbol props ptest
        symbol props type
    TStructure: category=STRUCTURE
      namespaces:
        symbol props ptest
        symbol props type
      5 x cpp implementation data type element:
        Byte: type-reference=int8_t
        Short: type-reference=int16_t
        Long: type-reference=int32_t
        LLong: type-reference=int64_t
        Real: type-reference=double
    bool: category=VALUE, type-emitter=FundamentalType
    double: category=VALUE, type-emitter=FundamentalType
    float: category=VALUE, type-emitter=FundamentalType
    int16_t: category=VALUE, header-file=cstdint
    int32_t: category=VALUE, header-file=cstdint
    int64_t: category=VALUE, header-file=cstdint
    int8_t: category=VALUE, header-file=cstdint
    uint16_t: category=VALUE, header-file=cstdint
    uint32_t: category=VALUE, header-file=cstdint
    uint64_t: category=VALUE, header-file=cstdint
    uint8_t: category=VALUE, header-file=cstdint
package /PortInterface/Service
  service interface TestSrv
    namespaces:
      symbol props ptest
      symbol props srv
    events:
      data TEvent: type=TStructure
    field TField: type=TStructure, has-getter=true, has-notifier=true, has-setter=true
    methods:
      operation TMethod: fire-and-forget=false
        4 x arg:
          a: type=int64_t, direction=IN
          cmd: type=ArithmeticType, direction=IN
          b: type=int64_t, direction=IN
          result: type=int64_t, direction=OUT
package /Platform
  machine Machine: machine-design=Ecu, trusted-platform-executable-launch-behavior=NO-TRUSTED-PLATFORM-SUPPORT
    module-instantiations:
      generic module instantiation CmInstantiation: category=COMMUNICATION_MANAGEMENT
      log and trace instantiation Log: dlt-ecu-id=Ecu
        6 x dlt log channel, all with log-trace-log-modes=CONSOLE:
          CM: application-id=CM, context-id=CM, log-trace-default-log-level=ERROR
          Consumer: application-id=CONS, context-id=CONS, log-trace-default-log-level=INFO
          EM: application-id=EM, context-id=EM, log-trace-default-log-level=ERROR
          Provider{1..3}: application-id=PRV{1..3}, context-id=PRV{1..3}, log-trace-default-log-level=INFO
      os module instantiation POSIX
        resource group ResourceGroup
    processor CPU
      processor core Core: core-id=0
package /Platform/FunctionGroup
  function group set FunctionGroupSet
    function-groups:
      mode declaration group prototype MachineFG: type=MachineState
package /Platform/ProcessToMachine
  process to machine mapping set ProcessToMachineMappingSet
    6 x process to machine mapping, all with machine=Machine:
      ProcessToMachineMapping_CM_TO_Machine_TO_UnknownModule: process=CM
      ProcessToMachineMapping_Consumer1_TO_Machine_TO_UnknownModule: process=Consumer
      ProcessToMachineMapping_EM_TO_Machine_TO_UnknownModule: process=EM
      ProcessToMachineMapping_Provider2_TO_Machine_TO_UnknownModule: process=Provider2
      ProcessToMachineMapping_Provider3_TO_Machine_TO_UnknownModule: process=Provider3
      ProcessToMachineMapping_Provider_TO_Machine_TO_UnknownModule: process=Provider1
package /System
  system System: category=SYSTEM_DESIGN_DESCRIPTION, system-version=1.0.0;PARA
package /System/Service/Deployment
  someip service interface deployment TestSrv: service-interface=TestSrv, service-interface-id=60, service-interface-version={major-version=1, minor-version=0}
    someip event deployment TEvent: event=TEvent, event-id=1, transport-protocol=UDP
    someip field deployment TField: field=TField
      get Get_TField: method-id=11, transport-protocol=UDP
      notifier Notification_TField: event-id=21, transport-protocol=UDP
      set Set_TField: method-id=12, transport-protocol=UDP
    someip method deployment TMethod: method=TMethod, method-id=1, transport-protocol=UDP
    someip event group Eventgroup_Notification_TField: event-group-id=2, event=Notification_TField
    someip event group Eventgroup_TEvent: event-group-id=1, event=TEvent
package /System/Service/Endpoint
  4 x someip service instance to machine mapping, all with communication-connector=eth0:
    SomeipConsumers: service-instance=Consumer_TestSrv, tcp-port=33000, udp-port=33000
    SomeipProvider1: service-instance=Provider_TestSrv1, tcp-port=31000, udp-port=31000
    SomeipProvider2: service-instance=Provider_TestSrv2, tcp-port=31001, udp-port=31001
    SomeipProvider3: service-instance=Provider_TestSrv3, tcp-port=31002, udp-port=31002
package /System/Service/Instance
  required someip service instance Consumer_TestSrv: service-interface-deployment=TestSrv, method-request-propss=[Get_TField, Set_TField, TMethod], required-minor-version=ANY, required-service-instance-id=ANY, sd-client-config=SdClientConfig, version-driven-find-behavior=EXACT-OR-ANY-MINOR-VERSION
    someip required event group Eventgroup_Notification_TField: event-group=Eventgroup_Notification_TField, sd-client-event-group-timing-config=SdEventgroupConfig
    someip required event group Eventgroup_TEvent: event-group=Eventgroup_TEvent, sd-client-event-group-timing-config=SdEventgroupConfig
  provided someip service instance Provider_TestSrv1: service-interface-deployment=TestSrv, event-propss=[TEvent, Notification_TField], method-response-propss=[Get_TField, Set_TField, TMethod], sd-server-config=SdServerConfig, service-instance-id=1
    someip provided event group Eventgroup_Notification_TField: event-group=Eventgroup_Notification_TField, multicast-threshold=0
    someip provided event group Eventgroup_TEvent: event-group=Eventgroup_TEvent, multicast-threshold=0
  provided someip service instance Provider_TestSrv2: service-interface-deployment=TestSrv, event-propss=[TEvent, Notification_TField], method-response-propss=[Get_TField, Set_TField, TMethod], sd-server-config=SdServerConfig, service-instance-id=2
    someip provided event group Eventgroup_Notification_TField: event-group=Eventgroup_Notification_TField, multicast-threshold=0
    someip provided event group Eventgroup_TEvent: event-group=Eventgroup_TEvent, multicast-threshold=0
  provided someip service instance Provider_TestSrv3: service-interface-deployment=TestSrv, event-propss=[TEvent, Notification_TField], method-response-propss=[Get_TField, Set_TField, TMethod], sd-server-config=SdServerConfig, service-instance-id=3
    someip provided event group Eventgroup_Notification_TField: event-group=Eventgroup_Notification_TField, multicast-threshold=0
    someip provided event group Eventgroup_TEvent: event-group=Eventgroup_TEvent, multicast-threshold=0
package /System/Service/TimingConfig
  someip sd client service instance config SdClientConfig: initial-find-behavior={initial-delay-max-value=0.2, initial-delay-min-value=0.1, initial-repetitions-base-delay=0.1, initial-repetitions-max=3}, service-find-time-to-live=16777215
  someip sd client event group timing config SdEventgroupConfig: request-response-delay={max-value=0.0, min-value=0.0}, time-to-live=16777215
  someip sd server service instance config SdServerConfig: initial-offer-behavior={initial-delay-max-value=0.2, initial-delay-min-value=0.1, initial-repetitions-base-delay=0.1, initial-repetitions-max=3}, offer-cyclic-delay=0.5, request-response-delay={max-value=0.0, min-value=0.0}, service-offer-time-to-live=16777215
package /System/VehicleTopology/Cluster
  ethernet cluster EthernetCluster
    ethernet physical channel PhysicalChannel: category=WIRED, comm-connectors=eth0
      network endpoint EcuEndpoint: network-endpoint-addresses=ipv-4-configuration=ipv-4-address=127.0.0.1
      network endpoint SdEndpoint: network-endpoint-addresses=ipv-4-configuration=ipv-4-address=224.0.0.1
package /System/VehicleTopology/Ecu
  machine design Ecu: service-discover-configs=someip-service-discovery={multicast-sd-ip-address=SdEndpoint, someip-service-discovery-port=30490}
    user defined communication connector IPC
    ethernet communication connector eth0: unicast-network-endpoint=EcuEndpoint
package /StateMachine
  mode declaration group MachineState: initial-mode=Off
    5 x mode:
      Off
      Restart
      Shutdown
      Startup
      Verify
  mode declaration group ProcessState: initial-mode=Idle
    4 x mode:
      Idle
      Running
      Starting
      Terminated
